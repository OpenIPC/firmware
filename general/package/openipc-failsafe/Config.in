## general/package/openipc-failsafe/Config.in
```kconfig
config BR2_PACKAGE_OPENIPC_FAILSAFE
	bool "OpenIPC failsafe rescue + crash capture"
	help
	  Recovery machinery for SoC families whose U-Boot keeps a boot
	  counter in a reserved DRAM word and whose kernel reserves that
	  word and enables pstore/ramoops (currently Goke gk7205v200 and
	  gk7205v300).

	  Ships three pieces, none of which touch flash:

	    - failsafe-rescue: brings a camera up on network + SSH only,
	      skipping the SDK and streamer, when the bootloader has fallen
	      into failsafe after repeated failed boots;
	    - S99bootok: clears the DRAM boot counter once the image is
	      proven healthy, so a camera that boots but never streams still
	      escalates to failsafe instead of looping forever;
	    - S98crashlog: preserves the pstore crash log across a reboot for
	      the owner-pull crash report.

	  Enable it only on boards that reserve the counter; the address is
	  read from the board DTS, so on an image that does not reserve it
	  the counter writes are a safe no-op, but the scripts are dead
	  weight there and cost rootfs space.
```

## general/package/rda5995-openipc/Config.in
```kconfig
config BR2_PACKAGE_RDA5995_OPENIPC
	bool "rda5995-openipc"
	depends on BR2_LINUX_KERNEL
	help
	  Rdamicro RDA5995 USB wireless driver (rdawfmac, 1e04:8888).

	  https://github.com/openipc/rda-wlan

if BR2_PACKAGE_RDA5995_OPENIPC

choice
	prompt "Driver"
	default BR2_PACKAGE_RDA5995_OPENIPC_RDAWLAN

config BR2_PACKAGE_RDA5995_OPENIPC_RDAWLAN
	bool "rdawlan"
	help
	  The driver with its firmware compiled in.

config BR2_PACKAGE_RDA5995_OPENIPC_RDAWLAN_RDA5995
	bool "rdawlan-rda5995"
	help
	  The USB driver for Linux 4.19 that loads its firmware from
	  /lib/firmware, where this package installs it.

endchoice

endif
```

## general/package/reset-button/Config.in
```kconfig
config BR2_PACKAGE_RESET_BUTTON
	bool "reset-button"
	# The beeps go through majestic's /play_audio with the curl BINARY,
	# as quirc-openipc's do. The binary is a sub-option of libcurl-openipc,
	# so both symbols are needed.
	select BR2_PACKAGE_LIBCURL_OPENIPC
	select BR2_PACKAGE_LIBCURL_OPENIPC_CURL
	help
	  Reboot or factory-reset the camera from its button. Hold it
	  and let go: under 5 s nothing, 5 to 15 s reboot (one beep at
	  5 s), 15 to 30 s factory reset with firstboot (two beeps at
	  15 s), over 30 s nothing, as a button stuck down. firstboot
	  wipes the overlay, so the camera comes back unclaimed with its
	  settings gone; the U-Boot environment, WiFi credentials
	  included, is kept.

	  The pin is button=N in /usr/share/openipc/gpio.conf, the
	  per-device pin map; pressed is low, or high with
	  button_active=1. A board whose gpio.conf has no button, or
	  button=-1, starts nothing, and a pin already exported as an
	  output is refused. The pin is polled every 100 ms, as many SoC
	  GPIOs cannot raise an edge interrupt. The beeps go through
	  majestic's /play_audio; with no speaker or no majestic the
	  button works the same, silently.

	  https://openipc.org
```

## general/package/rtl8xxxu-openipc/Config.in
```kconfig
config BR2_PACKAGE_RTL8XXXU_OPENIPC
	bool "rtl8xxxu-openipc"
	depends on BR2_LINUX_KERNEL
	select BR2_PACKAGE_LINUX_FIRMWARE_OPENIPC_RTL_8188FU
	help
	  Mainline rtl8xxxu mac80211 driver (RTL8188F backport to
	  kernel 3.4.43). Replaces the vendor rtl8188fu driver and
	  fixes the WPA2 4-way handshake failure seen with the
	  vendor driver on the GK7102.
```

## general/package/rv1103-usb-host/Config.in
```kconfig
config BR2_PACKAGE_RV1103_USB_HOST
	bool "rv1103-usb-host"
	help
	  Force the RV1103 USB2 PHY OTG port into host mode during boot.
	  This is required for USB peripherals such as Wi-Fi adapters on
	  boards whose boot firmware leaves the port in OTG/device mode.
```

## general/package/ssv6020-openipc/Config.in
```kconfig
config BR2_PACKAGE_SSV6020_OPENIPC
	bool "ssv6020-openipc"
	depends on BR2_LINUX_KERNEL
	help
	  iComm SSV6020 (Turismo E) SDIO wireless driver, sdio:v5653d2060:
	  the SSV6020B/C, sold as the SSV6158M on Xiongmai XM533 boards.
	  Loads ssv6x5x-sw.bin from /lib/firmware.
```

## general/package/usb-dual-role/Config.in
```kconfig
config BR2_PACKAGE_USB_DUAL_ROLE
	bool "USB dual-role (host / UVC gadget) switching"
	help
	  Runtime switching of a dual-role DWC3 USB port between host and
	  device.

	  In host mode a USB webcam plugged into the camera is served as a
	  second camera; in device mode the camera presents itself to a PC
	  as an ordinary USB webcam over the UVC gadget. One port, one role
	  at a time, chosen with usb-mode and remembered in /etc/usbmode.

	  Only useful where the device tree wires dwc3 as dual-role and the
	  kernel is built with CONFIG_USB_DWC3_DUAL_ROLE. Device mode also
	  needs a V4L2 stack: the package asks the kernel for the gadget
	  symbols it modprobes, but CONFIG_USB_CONFIGFS_F_UVC depends on
	  VIDEO_V4L2 and VIDEO_DEV, so on a board without those the host half
	  works and the UVC gadget is unavailable. It is a separate
	  option rather than part of the shared overlay because these images
	  live at the edge of their flash partitions, and a board that
	  cannot switch roles should not pay for the scripts that do it.

	  The UVC gadget's descriptors are composed from majestic's
	  configuration, so device mode wants BR2_PACKAGE_MAJESTIC too.
```

## general/package/vigil/Config.in
```kconfig
config BR2_PACKAGE_VIGIL
	bool "vigil"
	depends on BR2_OPENIPC_SOC_FAMILY = "hi3536dv100"
	depends on BR2_LINUX_KERNEL
	depends on !BR2_PACKAGE_MAJESTIC
	depends on !BR2_PACKAGE_VDEC_OPENIPC
	select BR2_PACKAGE_HISILICON_OSDRV_HI3536DV100
	select BR2_PACKAGE_YAML_CLI
	help
	  vigil - DVR/NVR application: network cameras (RTSP, NETIP)
	  decoded to HDMI in a 2x2 view with a status UI, and recorded
	  without re-encoding.

	  Installs /usr/bin/vigild, /etc/init.d/S95vigil (started at
	  boot and restarted after a crash, as majestic is) and
	  /etc/vigil.yaml (cameras and recording).

	  https://github.com/OpenIPC/vigil
```

## general/package/waybeam/Config.in
```kconfig
config BR2_PACKAGE_WAYBEAM
	bool "waybeam"
	depends on BR2_TOOLCHAIN_HAS_THREADS
	# Each arm names the family whose backend the makefile would pick for it,
	# because the driver packages themselves carry no family guard: the
	# star6e backend is built for every family that is not hi3516cv6xx, so
	# without this a tree with the SigmaStar driver enabled on another SoC
	# could select waybeam and get an encoder for the wrong hardware.
	depends on (BR2_PACKAGE_SIGMASTAR_OSDRV_INFINITY6E && \
		BR2_OPENIPC_SOC_FAMILY = "infinity6e") || \
		(BR2_PACKAGE_HISILICON_OSDRV_HI3516CV6XX && \
		 BR2_PACKAGE_HISILICON_OPENSDK && \
		 BR2_OPENIPC_SOC_FAMILY = "hi3516cv6xx")
	depends on !BR2_PACKAGE_MAJESTIC
	help
	  Standalone H.265 video encoder and streamer with one backend
	  per SoC: SigmaStar Infinity6E (SSC338Q/SSC30KQ) and Hisilicon
	  Hi3516CV610 (V5). Drives the sensor and encoder directly and
	  exposes an HTTP configuration API.

	  On Hi3516CV610 the backend compiles against the public
	  OpenHisilicon V5 headers, links the vendor MPP userspace
	  libraries and drives the sensors as userspace plugins it
	  dlopens by name from /usr/lib/sensors. This package builds
	  the IMX662 plugin from the waybeam tree, where it carries the
	  mode table and ISP seeds the backend was developed against,
	  and hisilicon-opensdk skips its own build of that sensor so
	  only one copy ships. The IMX335 plugin is built from
	  OpenIPC/openhisilicon by hisilicon-opensdk -- one source and
	  one pin. The vendor MPP kernel modules stay the ones S70vendor
	  loads at boot; the backend re-inits the graph around them and
	  never reloads them.

	  Infinity6C (SSC378QE) is not offered here even though the
	  encoder has a backend for it: waybeam's I6C backend targets
	  the 2024-06-18 SigmaStar MI libraries and
	  sigmastar-osdrv-infinity6c ships 2022-09-07. The pipeline
	  streams against those, but AE never actuates and the image
	  is black. I6C returns once the two agree.

	  It is an alternative to the Majestic streamer and cannot be
	  built alongside it: both drive the same sensor and encoder
	  hardware, so only one of the two can own the graph. On
	  SigmaStar they additionally share the OSDRV MI libraries,
	  which OSDRV installs only when Majestic is not selected.

	  Installs:
	    - /usr/bin/waybeam
	    - /etc/waybeam.json
	    - /etc/init.d/S95waybeam
	    - SigmaStar Infinity6E: /usr/bin/json_cli and unlocked
	      imx335/imx415 sensor modules, compiled here against this
	      board's kernel
	    - Hi3516CV610: libsns_imx662.so, compiled here (the
	      hisilicon-opensdk build of the same sensor is filtered
	      out, so this is the only copy); libsns_imx335.so comes
	      from hisilicon-opensdk

	  https://github.com/OpenIPC/waybeam
```

## general/package/wireguard-tools-openipc/Config.in
```kconfig
config BR2_PACKAGE_WIREGUARD_TOOLS_OPENIPC
	bool "wireguard-tools-openipc"
	depends on !BR2_PACKAGE_WIREGUARD_TOOLS # both install /usr/bin/wg
	help
	  The wg tool for configuring WireGuard tunnels.

	  Buildroot's wireguard-tools requires kernel headers >= 3.10, the
	  oldest kernel the out-of-tree module supports. That rules out
	  toolchains built for a 3.0 vendor kernel even when the board runs
	  a modern kernel with WireGuard in-tree (the neo variants). wg only
	  talks generic netlink to the running kernel and builds against 3.0
	  headers with the NLM_F_DUMP_INTR fallback patch.

	  https://git.zx2c4.com/wireguard-tools
```

## general/package/wpa_supplicant-openipc/Config.in
```kconfig
config BR2_PACKAGE_WPA_SUPPLICANT_OPENIPC
	bool "wpa_supplicant-openipc"
	depends on BR2_USE_MMU # fork()
	depends on BR2_TOOLCHAIN_HAS_THREADS # libnl
	depends on !BR2_PACKAGE_WPA_SUPPLICANT
	select BR2_PACKAGE_LIBNL
	select BR2_PACKAGE_MBEDTLS_OPENIPC
	help
	  wpa_supplicant 2.11 for the camera as a Wi-Fi station: WPA2-PSK
	  and WPA3-SAE (plus OWE), nl80211 and wext drivers, control
	  interface. Crypto comes from the mbedtls library the images
	  already ship, so it is smaller than the Buildroot package with
	  WPA3 (which needs OpenSSL) and does not carry a second copy of
	  internal crypto code.

	  https://w1.fi/wpa_supplicant/ (source: https://w1.fi/releases/)

if BR2_PACKAGE_WPA_SUPPLICANT_OPENIPC

config BR2_PACKAGE_WPA_SUPPLICANT_OPENIPC_CLI
	bool "Install wpa_cli binary"
	default y

config BR2_PACKAGE_WPA_SUPPLICANT_OPENIPC_PASSPHRASE
	bool "Install wpa_passphrase binary"
	default y

endif
```

## general/package/xiongmai-opensdk-xm510/Config.in
```kconfig
config BR2_PACKAGE_XIONGMAI_OPENSDK_XM510
	bool "xiongmai-opensdk-xm510"
	depends on BR2_LINUX_KERNEL
	help
	  Library for running uclibc applications in musl environment,
	  the open MMZ (open_mmz), H.264 encoder (open_h264), video input
	  (open_vi), ISP (open_isp) and region (open_rgn) kernel modules,
	  and xmispd, the open ISP daemon, from OpenIPC/openxiongmai.
	  xmispd takes the vendor isp daemon's place after
	  "fw_setenv xmispd 1" and a reboot, for the sensors it has.

	  https://github.com/OpenIPC/openxiongmai
```

## general/package/xiongmai-opensdk-xm530v200/Config.in
```kconfig
config BR2_PACKAGE_XIONGMAI_OPENSDK_XM530V200
	bool "xiongmai-opensdk-xm530v200"
	help
	  The open media pipeline of the V200 series (XM530V200, XM533,
	  XM535D1/D2/W1; libxmv200) on the vendor kernel modules:
	  sensors, ISP bring-up, VPSS, H.265 encoding and AE/AWB,
	  without the vendor userspace. Installs xmv200-test (brings a
	  board's pipeline up and encodes its streams to files), and
	  libxmv200 for applications to link.

	  https://github.com/OpenIPC/openxiongmai
```

## general/package/xiongmai-opensdk/Config.in
```kconfig
config BR2_PACKAGE_XIONGMAI_OPENSDK
	bool "xiongmai-opensdk"
	depends on BR2_LINUX_KERNEL
	default n
	help
	  Opensource Xiongmai SoCs SDK: the XM530 sensor libraries
	  (libsns_X50_XM530.so, libsns_X123_XM530.so) and the ISP
	  application layer (libispapp_XM530.so), built from source,
	  and the open VI and MMZ drivers (open_vi.ko, open_mmz.ko).

	  It also installs the open ISP library
	  (/usr/lib/openxiongmai/libisp_XM530.so, for every sensor the
	  two sensor libraries start)
	  beside the vendor's. Majestic uses it in the vendor's place
	  when system.openIsp is on.

	  https://github.com/OpenIPC/openxiongmai
```

## general/package/xiongmai-osdrv-xm530v200/Config.in
```kconfig
config BR2_PACKAGE_XIONGMAI_OSDRV_XM530V200
	bool "xiongmai-osdrv-xm530v200"
	help
	  xiongmai-osdrv-xm530v200 - XiongMai V200-series (XM530V200,
	  XM533, XM535) kernel modules

	  https://openipc.org
```

## general/package/xmnpu-models/Config.in
```kconfig
config BR2_PACKAGE_XMNPU_MODELS
	bool "xmnpu-models"
	default n
	help
	  YOLOv8n and YOLOv8s object detectors compiled for the GK7205V5x0
	  NPU, for majestic's object detection. Eight classes: person, bicycle,
	  car, motorcycle, bus, truck, cat and dog (majestic reports them as
	  human, vehicle and animal). Fine-tuned with LeakyReLU, which the
	  NPU fuses into the convolution. Installed into the NAND (UBIFS)
	  rootfs only: they do not fit a NOR image. AGPL-3.0, from the
	  Ultralytics weights.

	  https://github.com/OpenIPC/xmnpu-models
```
