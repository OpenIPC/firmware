## general/package/mqtt-bot/Config.in
```kconfig
#
# Copyright (c) OpenIPC  https://openipc.org  MIT License
#
# Config.in — Kconfig entry for the mqtt-bot package
#

config BR2_PACKAGE_MQTT_BOT
	bool "mqtt-bot"
	default n
	depends on BR2_PACKAGE_MOSQUITTO
	depends on BR2_PACKAGE_MBEDTLS_OPENIPC
	help
	  Lightweight MQTT command executor designed for routers and
	  IP cameras.

	  Subscribes to an MQTT topic, executes only explicitly whitelisted
	  commands, and publishes their stdout/stderr output back to a
	  configurable response topic.

	  Built-in "snap" command fetches a JPEG frame from the local HTTP
	  server (http://localhost/image.jpg) and publishes the raw binary
	  data over MQTT.

	  TLS is provided by mosquitto compiled against mbedTLS — no OpenSSL
	  dependency, suitable for size-constrained embedded targets.

	  https://openipc.org
```

## general/package/mt7601u-ap-openipc/Config.in
```kconfig
config BR2_PACKAGE_MT7601U_AP_OPENIPC
	bool "mt7601u-ap-openipc"
	depends on BR2_LINUX_KERNEL
	help
	  Wireless driver mt7601u with AP mode.

comment "MT7601U_AP_OPENIPC needs a Linux kernel to be built"
	depends on !BR2_LINUX_KERNEL
```

## general/package/mt7601u-openipc/Config.in
```kconfig
config BR2_PACKAGE_MT7601U_OPENIPC
	bool "mt7601u-openipc"
	depends on BR2_LINUX_KERNEL
	help
	  Wireless driver MT7601U
```

## general/package/n3n-openipc/Config.in
```kconfig
#
# Copyright (c) OpenIPC  https://openipc.org  MIT License
#
# Config.in — Buildroot package Kconfig menu
#
config BR2_PACKAGE_N3N_OPENIPC
	bool "n3n-openipc"
	help
	  n3n is a light VPN software which makes it easy to create
	  virtual networks bypassing intermediate firewalls

	  https://github.com/n42n/n3n
```

## general/package/nabto/Config.in
```kconfig
config BR2_PACKAGE_NABTO
	bool "nabto embedded sdk"
	help
		The Nabto Edge platform makes it possible to communicate
		directly between two entities:  Instead of interacting
		indirectly with a device through a cloud service, the platform
		makes it simple to communicate directly with the actual device
		to invoke services or transfer data - also through firewalls.

		https://github.com/nabto/nabto-embedded-sdk
```

## general/package/netblink/Config.in
```kconfig
#
# Copyright (c) OpenIPC  https://openipc.org  MIT License
#
# Config.in — Kconfig entry for the netblink package
#

config BR2_PACKAGE_NETBLINK
bool "netblink"
default n
help
  A minimal Linux command-line utility that monitors network
  connectivity or traffic and indicates status via a GPIO-driven
  LED using the sysfs interface.

  Two modes are supported:
    ping     — periodically ping a host; blink LED based on RTT.
    traffic  — monitor interface tx+rx; blink LED based on rate.

  Usage:
    netblink <gpio> ping <host> [interval_sec [timeout_sec]]
    netblink <gpio> traffic [interface]

  https://openipc.org
```

## general/package/node-exporter/Config.in
```kconfig
config BR2_PACKAGE_NODE_EXPORTER
	bool "node-exporter"
	help
	  node-exporter - Monitoring Linux host metrics with Prometheus

	  https://openipc.org
```

## general/package/novatek-osdrv-nt9856x/Config.in
```kconfig
config BR2_PACKAGE_NOVATEK_OSDRV_NT9856X
	bool "novatek-osdrv-nt9856x"
	help
	  novatek-osdrv-nt9856x - Novatek kernel modules and libs

	  https://openipc.org
```

## general/package/ntfy/Config.in
```kconfig
#
# Copyright (c) OpenIPC  https://openipc.org  MIT License
#
# Config.in — Kconfig entry for the ntfy package
#

config BR2_PACKAGE_NTFY
	bool "ntfy"
	depends on BR2_USE_MMU
	depends on BR2_PACKAGE_LIBCURL_OPENIPC
	help
	  Lightweight ntfy.sh notification client for embedded Linux.

	  Publish messages to and subscribe from any ntfy-compatible
	  server (ntfy.sh or self-hosted) using a simple CLI:

	    ntfy pub <topic> <message>    — publish a notification
	    ntfy sub <topic>              — subscribe (streaming)
	    ntfy poll <topic>             — poll cached messages

	  Features: bearer and basic auth, message priority/title/tags,
	  streaming and poll modes, stdin message input for scripts.

	  Uses libcurl for HTTP/HTTPS transport.  Single small binary,
	  no other external dependencies.

	  https://openipc.org
```

## general/package/omlet-camera-app/Config.in
```kconfig
config BR2_PACKAGE_OMLET_CAMERA_APP
	bool "omlet-camera-app"
	help
	  Build the Omlet Camera application
```

## general/package/onvif-simple-server/Config.in
```kconfig
config BR2_PACKAGE_ONVIF_SIMPLE_SERVER
	bool "onvif-simple-server"
	default n
	help
	  onvif_simple_server is a C light implementation of an onvif
	  server intended for use in resource-constrained devices

	  https://github.com/roleoroleo/onvif_simple_server
```

## general/package/openhisilicon/Config.in
```kconfig
config BR2_PACKAGE_OPENHISILICON
	bool "openhisilicon"
	depends on BR2_LINUX_KERNEL
	help
	  Opensource Hisilicon SoCs SDK

	  https://github.com/OpenIPC/openhisilicon

comment "OPENHISILICON needs a Linux kernel to be built"
	depends on !BR2_LINUX_KERNEL
```

## general/package/openipc-nfs-root/Config.in
```kconfig
config BR2_PACKAGE_OPENIPC_NFS_ROOT
	bool "OpenIPC NFS root"
	depends on BR2_LINUX_KERNEL
	select BR2_LINUX_KERNEL_EXT_OPENIPC_NFS_ROOT
	help
	  NFS-root-specific files and scripts for OpenIPC builds.

	  When enabled, the post-build flow replaces /init with an NFS
	  aware init script that mounts a writable tmpfs overlay on top
	  of a readonly NFS root.

	  Add any NFS-only init scripts, helper files, or deployment
	  hooks here as the workflow is fleshed out.

if BR2_PACKAGE_OPENIPC_NFS_ROOT

config BR2_PACKAGE_OPENIPC_NFS_ROOT_TMPFS_SIZE
	string "TMPFS size"
	default "16M"
	help
	  Size passed to the tmpfs mount used for the writable overlay
	  when NFS root is mounted in readonly mode.

config BR2_PACKAGE_OPENIPC_NFS_ROOT_PASSWD
	string "Root password"
	default "12345"
	help
	  Root password to be set during boot. Useful for immutable rootfs.
	  Can be plaintext or a password hash.
	  Note: Should set password for production env. Default is 12345

config BR2_PACKAGE_OPENIPC_NFS_ROOT_TIMEZONE
	string "IANA timezone"
	default ""
	help
	  IANA timezone name used to derive a POSIX TZ rule at build time,
	  for example: America/Denver or Europe/Berlin.

	  When left empty, the build attempts to detect the timezone from the
	  build host and derives the POSIX TZ rule from that zone.

config BR2_PACKAGE_OPENIPC_NFS_ROOT_NTP_SERVER
	string "NTP server"
	default ""
	help
	  Static NTP server to use.

	  When left empty, the build uses the default route fo the NTP server.

config BR2_PACKAGE_OPENIPC_NFS_ROOT_DNS_SERVER
	string "DNS server"
	default ""
	help
	  Static DNS server to use.

	  When left empty, the build uses the default route fo the DNS server.

config BR2_PACKAGE_OPENIPC_NFS_ROOT_HOSTNAME
	string "Hostname"
	default ""
	help
	  Fallback hostname.

	  If server supplied hostname and uboot env hostname don't exist then
	  use this hostname.

endif
```

## general/package/openipc-precision-time/Config.in
```kconfig
config BR2_PACKAGE_OPENIPC_PRECISION_TIME
	bool "OpenIPC precision-time profile (PTP)"
	select BR2_PACKAGE_LINUXPTP
	help
	  Opinionated time-synchronization stack for OpenIPC cameras
	  used in multi-camera fusion, robotics, photogrammetry, and
	  scientific instrumentation. Enables linuxptp (software-stamping
	  ptp4l disciplining CLOCK_REALTIME) and installs a ready-to-run
	  /etc/ptp4l.conf plus the precision-time init script.

	  Pair with chrony or busybox ntpd if you also want a coarse
	  NTP fallback when PTP is not reachable. Enable
	  BR2_PACKAGE_CHRONY separately if needed.

	  The camera's existing /dev/openipc-frame-ts chrdev samples
	  CLOCK_REALTIME in the sensor frame-start IRQ; with this stack
	  enabled and a local PTP grandmaster on the LAN, frame
	  timestamps anchor to sub-millisecond precision instead of the
	  ~3-5 ms NTP baseline.

	  Hardware caveat: HiSilicon FE-MAC PHYs do not support hardware
	  timestamping. This package configures linuxptp for software
	  timestamping only. Expected precision on a quiet switched LAN
	  is ~100 us to 1 ms.

	  Requires a kernel built with CONFIG_PREEMPT,
	  CONFIG_HIGH_RES_TIMERS, CONFIG_HZ_1000, and CONFIG_PTP_1588_CLOCK.
	  The hi3516ev300_neo kernel config ships these by default; other
	  boards need verification.
```

## general/package/opus-openipc/Config.in
```kconfig
config BR2_PACKAGE_OPUS_OPENIPC
	bool "opus-openipc"
	help
	  The Opus codec is designed for interactive speech and audio
	  transmission over the Internet. It is designed by the IETF
	  Codec Working Group and incorporates technology from Skype's
	  SILK codec and Xiph.Org's CELT codec.

	  It is intended to suit a wide range of interactive audio
	  applications, including Voice over IP, videoconferencing,
	  in-game chat, and even remote live music performances. It
	  can scale from low bit-rate narrowband speech to very high
	  quality stereo music.

	  http://opus-codec.org

if BR2_PACKAGE_OPUS_OPENIPC

config BR2_PACKAGE_OPUS_OPENIPC_FIXED_POINT
	bool "use fixed-point" if !BR2_SOFT_FLOAT
	default y if BR2_SOFT_FLOAT
	help
	  Compile without floating point operations (for machines
	  without a fast enough FPU).

config BR2_PACKAGE_OPUS_OPENIPC_HISI_SHIM
	bool "bake in HiSilicon ot_opus_* shim"
	help
	  Add an open-source implementation of the 6 ot_opus_*
	  wrapper functions (ot_opusenc_create/_destroy/_process_frame
	  + ot_opusdec_* counterparts) to libopus.so.

	  The HiSilicon Hi3516CV6xx (V5) vendor MPP audio adapter
	  libss_mpi_audio_adp.so resolves these symbols at runtime
	  against the closed vendor libopus.so. Enabling this option
	  lets us drop the vendor blob and ship a single open libopus
	  that satisfies both the standard libopus.so.0 SONAME and the
	  vendor binary's unversioned libopus.so DT_NEEDED.

	  Only needed on SoC families whose closed userspace expects
	  the ot_opus_* surface. Leave off otherwise.

endif
```

## general/package/osd-openipc/Config.in
```kconfig
config BR2_PACKAGE_OSD_OPENIPC
	bool "osd-openipc"
	help
	  Daemon that exposes an HTTP frontend to manage OSD regions.
```

## general/package/playaudio/Config.in
```kconfig
config BR2_PACKAGE_PLAYAUDIO
	bool "playaudio"
	help
	  playaudio - play sound file on speaker
```

## general/package/rcjoystick/Config.in
```kconfig
config BR2_PACKAGE_RCJOYSTICK
	bool "rcjoystick"
	help
	  joystick /dev/input/js0 to mavlink rc_channels_override udp 127.0.0.1:14550

	  https://github.com/whoim2/rcjoystick
```

## general/package/rockchip-osdrv-rv11xx/Config.in
```kconfig
config BR2_PACKAGE_ROCKCHIP_OSDRV_RV11XX
	bool "rockchip-osdrv-rv11xx"
	help
	  rockchip-osdrv-rv11xx - Rockchip kernel modules and libs

	  https://openipc.org
```

## general/package/rtl8188eus-openipc/Config.in
```kconfig
config BR2_PACKAGE_RTL8188EUS_OPENIPC
	bool "rtl8188eus-openipc"
	depends on BR2_LINUX_KERNEL
	help
	  A standalone driver for the RTL8188EU/RTL8188EUS/RTL8188ETV
	  USB Wi-Fi adapter.

	  Make sure your target kernel has the CONFIG_WIRELESS_EXT
	  config option enabled.

	  Note: this package needs a firmware loading mechanism to
	  load the binary blob for the chip to work.

	  https://github.com/aircrack-ng/rtl8188eus/

comment "rtl8188eus needs a Linux kernel to be built"
	depends on !BR2_LINUX_KERNEL
```

## general/package/rtl8188fu-openipc/Config.in
```kconfig
config BR2_PACKAGE_RTL8188FU_OPENIPC
	bool "rtl8188fu-openipc"
	depends on BR2_LINUX_KERNEL
	help
	  RTL8188FU wireless driver
```

## general/package/rtl8188fu/Config.in
```kconfig
config BR2_PACKAGE_RTL8188FU
	bool "rtl8188fu"
	depends on BR2_LINUX_KERNEL
	help
	  RTL8188FU wireless driver
```

## general/package/rtl8189es-openipc/Config.in
```kconfig
config BR2_PACKAGE_RTL8189ES_OPENIPC
	bool "rtl8189ES-openipc"
	depends on BR2_LINUX_KERNEL
	help
	  A driver for the RTL8189ES

	  https://github.com/jwrdegoede/rtl8189ES_linux

comment "rtl8189ES needs a Linux kernel to be built"
	depends on !BR2_LINUX_KERNEL
```
