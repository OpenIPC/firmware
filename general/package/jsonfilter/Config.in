## general/package/jsonfilter/Config.in
```kconfig
config BR2_PACKAGE_JSONFILTER
	bool "jsonfilter"
	default n
	select BR2_PACKAGE_JSON_C
	select BR2_PACKAGE_LIBUBOX
	help
	  jsonfilter - simple JSON parser

	  https://lxr.openwrt.org/source/jsonpath/
```

## general/package/kc110-board-support/Config.in
```kconfig
config BR2_PACKAGE_KC110_BOARD_SUPPORT
	bool "kc110-board-support"
	depends on BR2_arm
	help
	  Board support for the TP-Link Kasa KC110 PTZ camera (HiSilicon
	  Hi3518EV200 + OV2735 MIPI sensor + 24BYJ48 stepper motors via
	  ULN2803 darlington array).

	  Installs:
	  - ptz: C binary driving pan/tilt steppers (mmap PL061) and IR-cut /
	    IR-LED via vendor-base-10 GPIO numbering. Replaces the upstream
	    gpio-motors sysfs approach which uses different pin numbers.
	  - gpio-motors: small shell shim that forwards web-GUI calls
	    (gpio-motors X Y N) to the ptz CLI.
	  - ir-control.sh: convenience wrapper for IR-LED + IR-cut filter.
	  - S94pinmux-pan-ir: boot-time init that writes 0x1 to pinmux
	    registers 0x200f00e8/ec/f0/fc/100/104 for chip7/8 pads. OpenIPC
	    kernel pinctrl doesn't auto-set this for the KC110's pan + IR-cut
	    + IR-LED pads (vendor's hn_config.sh writes them explicitly).

	  KC110 GPIO map (vendor base-10 numbering = OpenIPC PL061 pins):
	    pan:    65 / 60 / 59 / 58   (vendor 81/74/73/72)
	    tilt:   0 / 1 / 2 / 36      (vendor 0/1/2/44)
	    ir-cut: 64                  (vendor 80)
	    ir-led: 63                  (vendor 77)

	  Conflicts with the upstream gpio-motors package — this provides a
	  drop-in replacement at /usr/bin/gpio-motors that calls ptz.
```

## general/package/kc110-mipi-shim/Config.in
```kconfig
config BR2_PACKAGE_KC110_MIPI_SHIM
	bool "kc110-mipi-shim"
	depends on BR2_arm
	help
	  LD_PRELOAD shim (libfixmipi.so) that patches majestic's MIPI ioctl
	  calls in-flight on hi3518ev200/V2A boards with OV2735 sensor.

	  Upstream majestic builds combo_dev_attr_t with raw_data_type=0 and
	  VIU dev_attr with enIntfMode=DC, both rejected by the hi_mipi kernel
	  module for MIPI sensors. Without this shim, majestic fails with
	  "ioctl HI_MIPI_SET_DEV_ATTR failed" → "Cannot init sensor" → no
	  pipeline. Confirmed broken on opensdk e22d315 and b958db4 (May 2026).

	  The shim intercepts:
	    HI_MIPI_SET_DEV_ATTR (0x41306d01) → patch raw_data_type=2 (RAW10),
	      lane_id=[0,1,-1,-1,-1,-1,-1,-1]
	    VIU_DEV_ATTR_SET (variable ioctl)  → patch enIntfMode=VI_MODE_MIPI=5,
	      au32CompMask[0]=0xfff00000

	  Activation requires `LD_PRELOAD=/usr/lib/libfixmipi.so` exported in
	  /etc/init.d/S95majestic — see firmware-overlay/etc/init.d/S95majestic
	  for the export line. Both files must be present.

	  Long-term fix is an upstream majestic PR that builds combo_dev_attr_t
	  correctly for MIPI sensors. Remove this package and the LD_PRELOAD
	  export when that lands.

	  Reference: OVERLAY_INVENTORY.md category D, verified necessary
	  2026-05-27 by removing both files and confirming majestic fails.
```

## general/package/lame-openipc/Config.in
```kconfig
config BR2_PACKAGE_LAME_OPENIPC
	bool "lame-openipc"
	help
	  LAME is a high quality MPEG Audio Layer III (MP3) encoder.

	  http://lame.sourceforge.net/
```

## general/package/legacy/ambarella-osdrv-s3l/Config.in
```kconfig
config BR2_PACKAGE_AMBARELLA_OSDRV_S3L
	bool "ambarella-osdrv-s3l"
	help
	  ambarella-osdrv-s3l - Ambarella kernel modules and libs

	  https://openipc.org
```

## general/package/legacy/capjpeg/Config.in
```kconfig
config BR2_PACKAGE_CAPJPEG
	bool "capjpeg"
	help
	  Quick and dirty libimp testing for catpure still images
	  For Ingenic T31 only now

	  https://github.com/openipc/capjpeg/
```

## general/package/legacy/datalink/Config.in
```kconfig
config BR2_PACKAGE_DATALINK
	bool "datalink"
	help
	  Base package for build video link over wifi or lte.
```

## general/package/legacy/gk7205v200-motors/Config.in
```kconfig
config BR2_PACKAGE_GK7205V200_MOTORS
	bool "gk7205v200-motors"
 	default n
	help
	  Sample code to control gk7205v200 motors.
```

## general/package/legacy/hisilicon-osdrv-serdes/Config.in
```kconfig
config BR2_PACKAGE_HISILICON_OSDRV_SERDES
	bool "hisilicon-osdrv-serdes"
	help
	  HiSilicon SerDes kernel driver.
```

## general/package/legacy/lshell/Config.in
```kconfig
config BR2_PACKAGE_LSHELL
	bool "lshell"
	default n
	help
	  Miniature Shell for limited commands

	  https://github.com/ystinia/sandbox/tree/main/lshell
```

## general/package/legacy/majestic-plugins/Config.in
```kconfig
config BR2_PACKAGE_MAJESTIC_PLUGINS
	bool "majestic-plugins"
	help
	  Sample for Majestic plugins.
```

## general/package/legacy/mavlink-router/Config.in
```kconfig
config BR2_PACKAGE_MAVLINK_ROUTER
	bool "mavlink-router"
	help
	  MAVLink Router is an application to distribute MAVLink messages between multiple endpoints (connections). It distributes packets to a single port or multiple endpoints depending on the target address. Connections can be made via UART, UDP or TCP.

	  https://github.com/mavlink-router/mavlink-router
```

## general/package/legacy/microsnander/Config.in
```kconfig
config BR2_PACKAGE_MICROSNANDER
	bool "microsnander"
	default n
	depends on BR2_INSTALL_LIBUSB
	select BR2_PACKAGE_LIBUSB
	help
	  tripped down and modified version of Serial Nor/nAND/Eeprom programmeR

	  https://openipc.org
```

## general/package/legacy/mini-snmpd-openipc/Config.in
```kconfig
config BR2_PACKAGE_MINI_SNMPD_OPENIPC
	bool "mini-snmpd-openipc"
	help
	  Mini SNMPd is a minimal implementation targeted at small or
	  embedded UNIX systems with limited resources

	  http://troglobit.com/mini-snmpd.html
```

## general/package/legacy/sigmastar-motors/Config.in
```kconfig
config BR2_PACKAGE_SIGMASTAR_MOTORS
	bool "sigmastar-motors"
	help
	  Sample code to control Sigmastar motors.
```

## general/package/legacy/webui/Config.in
```kconfig
config BR2_PACKAGE_WEBUI
	bool "webui"
	select BR2_PACKAGE_HASERL
	help
	  Simple web interface based on httpd and haserl.
	  https://openipc.org
```

## general/package/libcurl-openipc/Config.in
```kconfig
config BR2_PACKAGE_LIBCURL_OPENIPC
	bool "libcurl-openipc"
	help
	  cURL is a tool for getting files from FTP, HTTP, Gopher,
	  Telnet, and Dict servers, using any of the supported
	  protocols.

	  http://curl.haxx.se/

if BR2_PACKAGE_LIBCURL_OPENIPC

config BR2_PACKAGE_LIBCURL_OPENIPC_CURL
	bool "curl binary"
	help
	  Install curl binary as well

config BR2_PACKAGE_LIBCURL_OPENIPC_VERBOSE
	bool "verbose strings"
	help
	  Enable verbose text strings

config BR2_PACKAGE_LIBCURL_OPENIPC_PROXY_SUPPORT
	bool "proxy support"
	default y
	help
	  Enable proxy support.

config BR2_PACKAGE_LIBCURL_OPENIPC_COOKIES_SUPPORT
	bool "cookies support"
	default y
	help
	  Enable support for cookies.

config BR2_PACKAGE_LIBCURL_OPENIPC_EXTRA_PROTOCOLS_FEATURES
	bool "enable extra protocols and features"
	default y
	help
	  Enable the following extra protocols and features:
	  - LDAP / LDAPS
	  - POP3 / IMAP / SMTP
	  - Telnet
	  - TFTP
	  - RTSP
	  - SMB / CIFS
	  - DICT
	  - Gopher

choice
	prompt "SSL/TLS library to use"

config BR2_PACKAGE_LIBCURL_OPENIPC_OPENSSL
	bool "OpenSSL"
	depends on BR2_PACKAGE_OPENSSL

config BR2_PACKAGE_LIBCURL_OPENIPC_GNUTLS
	bool "GnuTLS"
	depends on BR2_PACKAGE_GNUTLS

config BR2_PACKAGE_LIBCURL_OPENIPC_LIBNSS
	bool "NSS"
	depends on BR2_PACKAGE_LIBNSS

config BR2_PACKAGE_LIBCURL_OPENIPC_MBEDTLS
	bool "mbed TLS"
	depends on BR2_PACKAGE_MBEDTLS_OPENIPC

config BR2_PACKAGE_LIBCURL_OPENIPC_WOLFSSL
	bool "WolfSSL"
	depends on BR2_PACKAGE_WOLFSSL

config BR2_PACKAGE_LIBCURL_OPENIPC_TLS_NONE
	bool "None"

endchoice

endif
```

## general/package/libevent-mini/Config.in
```kconfig
config BR2_PACKAGE_LIBEVENT_MINI
	bool "libevent-mini"
	help
	  Userspace library for handling asynchronous notifications (mini)

	  http://libevent.org
```

## general/package/libhv-openipc/Config.in
```kconfig
config BR2_PACKAGE_LIBHV_OPENIPC
	bool "libhv-openipc"
	help
	  Like libevent, libev, and libuv, libhv provides event-loop
	  with non-blocking IO and timer, but simpler api and richer
	  protocols.

	  https://github.com/ithewei/libhv
```

## general/package/libhv/Config.in
```kconfig
config BR2_PACKAGE_LIBHV
	bool "libhv"
	help
	  Like libevent, libev, and libuv, libhv provides event-loop with 
	  non-blocking IO and timer, but simpler api and richer protocols.

	  https://github.com/ithewei/libhv
```

## general/package/libjpeg-openipc/Config.in
```kconfig
config BR2_PACKAGE_LIBJPEG_OPENIPC
	bool "libjpeg-openipc"
	help
	  The ubiquitous C library for manipulating JPEG images.
	  http://www.ijg.org/
```

## general/package/libogg-openipc/Config.in
```kconfig
config BR2_PACKAGE_LIBOGG_OPENIPC
	bool "libogg-openipc"
	help
	  Ogg is a multimedia container format, and the native file
	  and stream format for the Xiph.org multimedia codecs. As
	  with all Xiph.org technology is it an open format free for
	  anyone to use.

	  http://xiph.org/ogg/
```

## general/package/libre-openipc/Config.in
```kconfig
config BR2_PACKAGE_LIBRE_OPENIPC
	bool "libre-openipc"
	help
	  libre is a Generic library for real-time communications
	  with async IO support.

	  https://github.com/baresip/re
```

## general/package/librem-openipc/Config.in
```kconfig
config BR2_PACKAGE_LIBREM_OPENIPC
	bool "librem-openipc"
	select BR2_PACKAGE_LIBRE_OPENIPC
	help
	  librem is an audio and video processing media library.

	  https://github.com/baresip/rem
```

## general/package/librws/Config.in
```kconfig
config BR2_PACKAGE_LIBRWS
	bool "librws"
	help
	  librws - Tiny, cross platform websocket client C library.
```
