## general/package/ffmpeg-openipc/Config.in
```kconfig
config BR2_PACKAGE_FFMPEG_OPENIPC
	bool "ffmpeg-openipc"
	default n
	help
	  FFmpeg is a complete, cross-platform solution to record,
	  convert and stream audio and video.

	  http://www.ffmpeg.org
```

## general/package/fullhan-osdrv-fh8852/Config.in
```kconfig
config BR2_PACKAGE_FULLHAN_OSDRV_FH8852
	bool "fullhan-osdrv-fh8852"
	help
	  fullhan-osdrv-fh8852 - Fullhan kernel modules and libs

	  https://openipc.org
```

## general/package/fullhan-osdrv-fh8852v100/Config.in
```kconfig
config BR2_PACKAGE_FULLHAN_OSDRV_FH8852V100
	bool "fullhan-osdrv-fh8852v100"
	help
	  fullhan-osdrv-fh8852v100 - Fullhan kernel modules and libs

	  https://openipc.org
```

## general/package/fullhan-osdrv-fh8852v200/Config.in
```kconfig
config BR2_PACKAGE_FULLHAN_OSDRV_FH8852V200
	bool "fullhan-osdrv-fh8852v200"
	help
	  fullhan-osdrv-fh8852v200 - Fullhan kernel modules and libs

	  https://openipc.org
```

## general/package/fwprintenv-openipc/Config.in
```kconfig
config BR2_PACKAGE_FWPRINTENV_OPENIPC
	bool "fwprintenv-openipc from u-boot tools"
	default n
	help
	  Install the fw_printenv / fw_setenv tools on the target system

	  The fw_printenv and fw_setenv tools from Das U-Boot
	  bootloader, which allows access to the U-Boot environment
	  from Linux.

	  U-Boot tools - companion tools for Das U-Boot bootloader.

	  http://www.denx.de/wiki/U-Boot/WebHome
```

## general/package/gdbserver-lite/Config.in
```kconfig
config BR2_PACKAGE_GDBSERVER_LITE
	bool "gdbserver-lite"
	help
	  gdbserver-lite - A tiny debugger implement the GDB RSP

	  https://github.com/bet4it/gdbserver
```

## general/package/gk7205v200-motors/Config.in
```kconfig
config BR2_PACKAGE_GK7205V200_MOTORS
	bool "gk7205v200-motors"
	help
	  Sample code to control gk7205v200 motors.
```

## general/package/go2rtc/Config.in
```kconfig
config BR2_PACKAGE_GO2RTC
	bool "go2rtc streamer"
	default n
	help
	  Ultimate camera streaming application with support RTSP, WebRTC, HomeKit, FFmpeg, RTMP, etc.
	  Note: Binary will be UPX Compressed, binary size ~3.4mb
	  https://github.com/AlexxIT/go2rtc
```

## general/package/goke-osdrv-gk710x/Config.in
```kconfig
config BR2_PACKAGE_GOKE_OSDRV_GK710X
	bool "goke-osdrv-gk710x"
	help
	  goke-osdrv-gk710x - Goke kernel modules and libs

	  https://openipc.org
```

## general/package/goke-osdrv-gk7205v200/Config.in
```kconfig
config BR2_PACKAGE_GOKE_OSDRV_GK7205V200
	bool "goke-osdrv-gk7205v200"
	help
	  goke-osdrv-gk7205v200 - Goke kernel modules and libs

	  https://openipc.org
```

## general/package/goke-osdrv-gk7205v500/Config.in
```kconfig
config BR2_PACKAGE_GOKE_OSDRV_GK7205V500
	bool "goke-osdrv-gk7205v500"
	help
	  goke-osdrv-gk7205v500 - Goke kernel modules and libs

	  https://openipc.org
```

## general/package/goke-sns-bbi2c/Config.in
```kconfig
config BR2_PACKAGE_GOKE_SNS_BBI2C
	bool "goke-sns-bbi2c"
	depends on BR2_PACKAGE_GOKE_OSDRV_GK7205V200
	help
	  Bit-bang (GPIO) i2c sensor bring-up for gk7205v200 boards whose
	  image sensor is wired to GPIO pins instead of the SoC hardware
	  i2c controller (e.g. CP Plus CP-UNC-TA21L2C / Dahua-OEM cameras
	  with a SmartSens SC223A, chip-id 0xcb3e).

	  Builds a small kernel module that registers a software i2c
	  adapter on GPIO7_2 (SDA) / GPIO7_3 (SCL), drives the sensor
	  reset/enable line (GPIO8_7) high, sets the 27 MHz MCLK and holds
	  the MIPI-RX reference clock stable, and ships an init script that
	  points majestic's libsns at the bit-bang bus.

	  Addresses the "sensor i2c never ACKs" class of devices:
	  OpenIPC/firmware issues #1930 and #1404.
```

## general/package/gpio-motors/Config.in
```kconfig
config BR2_PACKAGE_GPIO_MOTORS
	bool "gpio-motors"
	help
	  Control stepper motors via sysfs GPIO. Confirmed working with 24BYJ48 
	  stepper motors and ULN2803s on GM8136, HI3516CV200, T21, and GK7102 
	  SOCs and should be portable to any with sysfs GPIO access.
```

## general/package/gpiod-motors/Config.in
```kconfig
config BR2_PACKAGE_GPIOD_MOTORS
	bool "gpiod-motors"
	select BR2_PACKAGE_LIBGPIOD
	help
	  Control stepper motors via libgpiod. Confirmed working with 24BYJ48
	  stepper motors and ULN2803s on GM8136, HI3516CV200, T21, and GK7102
	  SOCs and should be portable to any with sysfs GPIO access.
```

## general/package/grainmedia-osdrv-gm8136/Config.in
```kconfig
config BR2_PACKAGE_GRAINMEDIA_OSDRV_GM8136
	bool "grainmedia-osdrv-gm8136"
	help
	  grainmedia-osdrv-gm8136 - Grainmedia kernel modules and libs

	  https://openipc.org
```

## general/package/herald/Config.in
```kconfig
#
# Copyright (c) OpenIPC  https://openipc.org  MIT License
#
# Config.in — Kconfig entry for the herald package
#

config BR2_PACKAGE_HERALD
	bool "herald"
	depends on BR2_USE_MMU
	help
	  Herald is a compact mDNS/DNS-SD stack (RFC 6762 / RFC 6763)
	  built for the OpenIPC project.

	  Ships two small standalone utilities:
	    herald-server  — announces a service on the local network
	                     and responds to mDNS queries
	    herald-client  — scans the network and lists discovered
	                     services

	  Designed for OpenIPC IP cameras, routers, and other
	  resource-constrained embedded Linux targets (uClibc/musl/glibc).
	  No external libraries required.

	  https://openipc.org
```

## general/package/hifb-demo/Config.in
```kconfig
config BR2_PACKAGE_HIFB_DEMO
	bool "hifb-demo"
	depends on BR2_PACKAGE_HISILICON_OSDRV_HI3520DV200
	help
	  Standalone demo program for the Hisilicon hifb framebuffer
	  driver on hi3520dv200. Brings up the MPP system (SAMPLE_COMM_SYS_Init
	  bootstrap ported from the upstream vendor MPP sample tree), enables
	  the VO HD device, opens /dev/fb0, mmaps it, and draws SMPTE color
	  bars plus an animated rectangle so the wired display output (HDMI,
	  VGA or CVBS depending on board) can be visually verified.

	  Run on the camera as:
	    LD_PRELOAD=/usr/lib/libjpeg.so:/usr/lib/libVoiceEngine.so:\
	    /usr/lib/libanr.so:/usr/lib/libaec.so:/usr/lib/libresampler.so:\
	    /usr/lib/libvqev2.so:/usr/lib/libmem.so:/usr/lib/libtde.so \
	    hifb_demo

	  https://github.com/OpenIPC/firmware
```

## general/package/hisi-gpio/Config.in
```kconfig
config BR2_PACKAGE_HISI_GPIO
	bool "hisi-gpio"
	default n
	help
	  Utility for diagnosing, displaying GPIO statuses and running
	  commands.

	  https://openipc.org
```

## general/package/hisi_gpio/Config.in
```kconfig
config BR2_PACKAGE_HISI_GPIO
	bool "hisi_gpio"
	default n
	help
	  Utility for diagnosing, displaying GPIO statuses and running
	  commands.

	  https://openipc.org
```

## general/package/hisilicon-opensdk/Config.in
```kconfig
config BR2_PACKAGE_HISILICON_OPENSDK
	bool "hisilicon-opensdk"
	default n
	depends on BR2_LINUX_KERNEL
	help
	  Opensource Hisilicon SoCs SDK

	  https://github.com/OpenIPC/openhisilicon

comment "HISILICON_OPENSDK needs a Linux kernel to be built"
	depends on !BR2_LINUX_KERNEL
```

## general/package/hisilicon-osdrv-hi3516av100/Config.in
```kconfig
config BR2_PACKAGE_HISILICON_OSDRV_HI3516AV100
	bool "hisilicon-osdrv-hi3516av100"
	help
	  hisilicon-osdrv-hi3516av100 - Hisilicon kernel modules
	  and libs.

	  https://openipc.org
```

## general/package/hisilicon-osdrv-hi3516cv100/Config.in
```kconfig
config BR2_PACKAGE_HISILICON_OSDRV_HI3516CV100
	bool "hisilicon-osdrv-hi3516cv100"
	help
	  hisilicon-osdrv-hi3516cv100 - Hisilicon kernel modules
	  and libs.

	  https://openipc.org
```
