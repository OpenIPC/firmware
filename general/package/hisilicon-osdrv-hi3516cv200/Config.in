## general/package/hisilicon-osdrv-hi3516cv200/Config.in
```kconfig
config BR2_PACKAGE_HISILICON_OSDRV_HI3516CV200
	bool "hisilicon-osdrv-hi3516cv200"
	help
	  hisilicon-osdrv-hi3516cv200 - Hisilicon kernel modules
	  and libs.

	  https://openipc.org
```

## general/package/hisilicon-osdrv-hi3516cv300/Config.in
```kconfig
config BR2_PACKAGE_HISILICON_OSDRV_HI3516CV300
	bool "hisilicon-osdrv-hi3516cv300"
	help
	  hisilicon-osdrv-hi3516cv300 - Hisilicon kernel modules
	  and libs.

	  https://openipc.org
```

## general/package/hisilicon-osdrv-hi3516cv500/Config.in
```kconfig
config BR2_PACKAGE_HISILICON_OSDRV_HI3516CV500
	bool "hisilicon-osdrv-hi3516cv500"
	help
	  hisilicon-osdrv-hi3516cv500 - Hisilicon kernel modules
	  and libs.

	  https://openipc.org
```

## general/package/hisilicon-osdrv-hi3516cv6xx/Config.in
```kconfig
config BR2_PACKAGE_HISILICON_OSDRV_HI3516CV6XX
	bool "hisilicon-osdrv-hi3516cv6xx"
	help
	  hisilicon-osdrv-hi3516cv6xx - Hisilicon kernel modules
	  and libs.

	  https://openipc.org
```

## general/package/hisilicon-osdrv-hi3516ev200/Config.in
```kconfig
config BR2_PACKAGE_HISILICON_OSDRV_HI3516EV200
	bool "hisilicon-osdrv-hi3516ev200"
	help
	  hisilicon-osdrv-hi3516ev200 - Hisilicon kernel modules
	  and libs.

	  https://openipc.org
```

## general/package/hisilicon-osdrv-hi3516ev300/Config.in
```kconfig
config BR2_PACKAGE_HISILICON_OSDRV_HI3516EV300
	bool "hisilicon-osdrv-hi3516ev300"
	help
	  hisilicon-osdrv-hi3516ev300 - Hisilicon kernel modules
	  and libs.

	  https://openipc.org
```

## general/package/hisilicon-osdrv-hi3519dv500/Config.in
```kconfig
config BR2_PACKAGE_HISILICON_OSDRV_HI3519DV500
	bool "hisilicon-osdrv-hi3519dv500"
	help
	  hisilicon-osdrv-hi3519dv500 - Hisilicon kernel modules
	  and libs.

	  https://openipc.org
```

## general/package/hisilicon-osdrv-hi3519v101/Config.in
```kconfig
config BR2_PACKAGE_HISILICON_OSDRV_HI3519V101
	bool "hisilicon-osdrv-hi3519v101"
	help
	  hisilicon-osdrv-hi3519v101 - Hisilicon kernel modules and libs

	  https://openipc.org
```

## general/package/hisilicon-osdrv-hi3520dv200/Config.in
```kconfig
config BR2_PACKAGE_HISILICON_OSDRV_HI3520DV200
	bool "hisilicon-osdrv-hi3520dv200"
	help
	  hisilicon-osdrv-hi3520dv200 - Hisilicon kernel modules
	  and libs for the Hi3520DV200 DVR/NVR SoC.

	  https://openipc.org
```

## general/package/hisilicon-osdrv1-sources/Config.in
```kconfig
config BR2_PACKAGE_HISILICON_OSDRV1_SOURCES
    bool "hisilicon-osdrv1-sources"
	help
	  hisilicon-osdrv1-sources - Hisilicon kernel modules
	  and libs.

	  https://openipc.org
```

## general/package/i2c-telemetry/Config.in
```kconfig
config BR2_PACKAGE_I2C_TELEMETRY
	bool "i2c-telemetry"
	default n
	help
	  Simple I2C telemetry system

	  https://openipc.org
```

## general/package/ingenic-atbm603x-sdio-t31/Config.in
```kconfig
config BR2_PACKAGE_INGENIC_ATBM603X_SDIO_T31
	bool "ingenic-atbm603x-sdio-t31"
	help
	  ingenic-atbm603x-sdio-t31 - Ingenic kernel module for the ATBM603X, on SDIO bus.

comment "ATBM603X needs a Linux kernel to be built"
	depends on !BR2_PACKAGE_INGENIC_OSDRV_T31


if BR2_PACKAGE_INGENIC_ATBM603X_SDIO_T31

config BR2_PACKAGE_INGENIC_ATBM603X_SDIO_T31_MMC0
	bool "ingenic-atbm603x-sdio-t31-mmc0"
	default y
	help
	  ingenic-atbm603x-sdio-t31-mmc0 - Provide the driver that loads on bus MMC0.

config BR2_PACKAGE_INGENIC_ATBM603X_SDIO_T31_MMC1
	bool "ingenic-atbm603x-sdio-t31-mmc1"
	default y
	help
	  ingenic-atbm603x-sdio-t31-mmc1 - Provide the driver that loads on bus MMC1.

endif
```

## general/package/ingenic-audiodaemon/Config.in
```kconfig
config BR2_PACKAGE_INGENIC_AUDIODAEMON
	bool "ingenic-audiodaemon"
	help
	  Userspace program for interfacing with Audio on the Ingenic platform using IMP
```

## general/package/ingenic-diag-tools/Config.in
```kconfig
config BR2_PACKAGE_INGENIC_DIAG_TOOLS
	bool "ingenic-diag-tools"
	help
	  Userspace program for manipulating GPIOs
```

## general/package/ingenic-libimp-control/Config.in
```kconfig
config BR2_PACKAGE_INGENIC_LIBIMP_CONTROL
	bool "libimp_control"
	help
	  Library for on the fly adjustments to the IMP Library
```

## general/package/ingenic-motors-t31/Config.in
```kconfig
config BR2_PACKAGE_INGENIC_MOTORS_T31
	bool "ingenic-motors-t31"
	depends on BR2_LINUX_KERNEL
	help
	  Motor driver for Ingenic T31 using TCU2.2.

comment "ingenic-motors-t31 needs a Linux kernel to be built"
	depends on !BR2_LINUX_KERNEL
```

## general/package/ingenic-opensdk/Config.in
```kconfig
config BR2_PACKAGE_INGENIC_OPENSDK
	bool "ingenic-opensdk"
	default n
	depends on BR2_LINUX_KERNEL
	help
	  Opensource Ingenic SoCs SDK

comment "INGENIC_OPENSDK needs a Linux kernel to be built"
	depends on !BR2_LINUX_KERNEL
```

## general/package/ingenic-osdrv-t20/Config.in
```kconfig
config BR2_PACKAGE_INGENIC_OSDRV_T20
	bool "ingenic-osdrv-t20"
	select BR2_PACKAGE_INGENIC_OPENSDK
	help
	  ingenic-osdrv-t20 - Ingenic kernel modules and libs

	  https://openipc.org
```

## general/package/ingenic-osdrv-t21/Config.in
```kconfig
config BR2_PACKAGE_INGENIC_OSDRV_T21
	bool "ingenic-osdrv-t21"
	select BR2_PACKAGE_INGENIC_OPENSDK
	help
	  ingenic-osdrv-t21 - Ingenic kernel modules and libs
	  https://openipc.org
```

## general/package/ingenic-osdrv-t23/Config.in
```kconfig
config BR2_PACKAGE_INGENIC_OSDRV_T23
	bool "ingenic-osdrv-t23"
	select BR2_PACKAGE_INGENIC_OPENSDK
	help
	  Ingenic T23 kernel modules and libraries
	  https://openipc.org
```

## general/package/ingenic-osdrv-t30/Config.in
```kconfig
config BR2_PACKAGE_INGENIC_OSDRV_T30
	bool "ingenic-osdrv-t30"
        select BR2_PACKAGE_INGENIC_OPENSDK
	help
	  ingenic-osdrv-t30 - Ingenic kernel modules and libs

	  https://openipc.org
```

## general/package/ingenic-osdrv-t31/Config.in
```kconfig
config BR2_PACKAGE_INGENIC_OSDRV_T31
	bool "ingenic-osdrv-t31"
	select BR2_PACKAGE_INGENIC_OPENSDK
	help
	  ingenic-osdrv-t31 - Ingenic kernel modules and libs

	  https://openipc.org
```

## general/package/ingenic-osdrv-t40/Config.in
```kconfig
config BR2_PACKAGE_INGENIC_OSDRV_T40
	bool "ingenic-osdrv-t40"
	select BR2_PACKAGE_INGENIC_OPENSDK
	help
	  ingenic-osdrv-t40 - Ingenic kernel modules and libs

	  https://openipc.org
```

## general/package/ingenic-pwm/Config.in
```kconfig
config BR2_PACKAGE_INGENIC_PWM
	bool "ingenic-pwm"
	help
	  Userspace program for controlling PWM channels on the Ingenic platform
```
