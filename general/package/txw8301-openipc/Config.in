## general/package/txw8301-openipc/Config.in
```kconfig
config BR2_PACKAGE_TXW8301_OPENIPC
	bool "txw8301-openipc"
	depends on BR2_LINUX_KERNEL
	help
	  Taixin TXW8301 802.11ah (HaLow) FMAC driver for Linux.
	  Supports SDIO, USB, and UART interface modules.

	  Firmware blob is required at /lib/firmware/taixin/hgicf.bin
	  (installed via modprobe.d fw_file override).
	  Runtime config at /etc/hgicf.conf.

	  https://github.com/TXW8301/TXW8301-FMAC-linux-driver

if BR2_PACKAGE_TXW8301_OPENIPC

choice
	prompt "Interface type"
	default BR2_PACKAGE_TXW8301_OPENIPC_USB

config BR2_PACKAGE_TXW8301_OPENIPC_SDIO
	bool "SDIO/SPI"
	help
	  Select for SDIO or SPI-connected TXW8301 modules.

config BR2_PACKAGE_TXW8301_OPENIPC_USB
	bool "USB"
	help
	  Select for USB-connected TXW8301 modules.

endchoice
endif

comment "txw8301-openipc needs a Linux kernel to be built"
	depends on !BR2_LINUX_KERNEL
```

## general/package/uclibc-compat/Config.in
```kconfig
config BR2_PACKAGE_UCLIBC_COMPAT
	bool "uclibc-compat"
	help
	  Compatibility shim for vendor binaries built against uclibc or
	  old glibc that must run on musl.  Provides ABI translation for
	  struct stat (96B uclibc vs 152B musl), mmap off_t (4B vs 8B),
	  and missing symbols (__ctype_b, __assert, memcpy_s, etc).

	  Executables that load vendor .so files should link with
	  -luclibc-compat (static archive) so the shim symbols appear
	  in the executable's scope before musl's.

	  https://github.com/OpenIPC/firmware/issues/1992
```

## general/package/uqmi-openipc/Config.in
```kconfig
config BR2_PACKAGE_UQMI_OPENIPC
	bool "uqmi-openipc"
	select BR2_PACKAGE_JSON_C
	select BR2_PACKAGE_LIBUBOX
	help
	  This command line tool originates from the OpenWrt project
	  to configure LTE modem in QMI mode for WAN connection.

	  https://git.openwrt.org/project/uqmi.git
```

## general/package/uqmi/Config.in
```kconfig
config BR2_PACKAGE_UQMI_OPENIPC
	bool "uqmi-openipc"
	help
	  This command line tool originates from the OpenWrt project
	  to configure LTE modem in QMI mode for WAN connection.

	  https://git.openwrt.org/project/uqmi.git
```

## general/package/vdec-openipc/Config.in
```kconfig
config BR2_PACKAGE_VDEC_OPENIPC
	bool "vdec decoder"
	select BR2_PACKAGE_DATALINK
	help
	  Yet another video decoder for FPV projects.

	  https://github.com/OpenIPC/silicon_research
```

## general/package/venc-openipc/Config.in
```kconfig
config BR2_PACKAGE_VENC_OPENIPC
	bool "venc streamer"
	select BR2_PACKAGE_DATALINK
	help
	  Yet another streamer for FPV projects.

	  https://github.com/OpenIPC/silicon_research
```

## general/package/vendor-patcher/Config.in
```kconfig
config BR2_PACKAGE_VENDOR_PATCHER
	bool "vendor patcher"
	default y if BR2_LINUX_KERNEL
	help
	  Linux patcher for OpenIPC
```

## general/package/vtund-lite/Config.in
```kconfig
config BR2_PACKAGE_VTUND_LITE
	bool "vtund-lite"
	depends on BR2_USE_MMU # fork()
	help
	  Tool for easily creating Virtual Tunnels over TCP/IP networks
	  with traffic shaping, compression, and encryption.

	  It supports IP, PPP, SLIP, Ethernet and other tunnel types.

	  http://vtun.sourceforge.net/
```

## general/package/vtund-openipc/Config.in
```kconfig
config BR2_PACKAGE_VTUND_OPENIPC
	bool "vtund-openipc"
	depends on BR2_USE_MMU # fork()
	help
	  Tool for easily creating Virtual Tunnels over TCP/IP networks
	  with traffic shaping, compression, and encryption.

	  It supports IP, PPP, SLIP, Ethernet and other tunnel types.

	  No LZO/SSL/ZLIB version

	  http://vtun.sourceforge.net/
```

## general/package/w1-ds18b20/Config.in
```kconfig
config BR2_PACKAGE_W1_DS18B20
	bool "w1-ds18b20"
	help
	  OneWire DS18B20 GPIO bitbang app
```

## general/package/webface/Config.in
```kconfig
#
# Copyright (c) OpenIPC  https://openipc.org  MIT License
#
# Config.in — Kconfig entry for the webface package
#

config BR2_PACKAGE_WEBFACE
	bool "webface"
	select BR2_PACKAGE_HASERL
	help
	  Example of Cookie-based Session Authentication
	  https://openipc.org
```

## general/package/webui-next/Config.in
```kconfig
config BR2_PACKAGE_WEBUI_NEXT
	bool "webui-next"
	select BR2_PACKAGE_HASERL
	help
	  Simple web interface.
	  https://openipc.org
```

## general/package/webui/Config.in
```kconfig
config BR2_PACKAGE_WEBUI
	bool "webui"
	select BR2_PACKAGE_HASERL
	help
	  The simplest web interface constructor based on
	  httpd and haserl.

	  https://openipc.org
```

## general/package/wifibroadcast-ext/Config.in
```kconfig
config BR2_PACKAGE_WIFIBROADCAST_EXT
	bool "wifibroadcast-ext"
	help
	  Additional scripts for wifibroadcast-ng
```

## general/package/wifibroadcast/Config.in
```kconfig
config BR2_PACKAGE_WIFIBROADCAST
	bool "wifibroadcast"
	help
	  Transmit hd video over wifi for the UAV.

	  https://github.com/svpcom/wifibroadcast
```

## general/package/wireless-configuration/Config.in
```kconfig
config BR2_PACKAGE_WIRELESS_CONFIGURATION
	bool "wireless-configuration"
	help
	  wireless-configuration - add wireless configuration scripts
```

## general/package/wq9001/Config.in
```kconfig
config BR2_PACKAGE_WQ9001
	bool "wq9001"
	depends on BR2_LINUX_KERNEL
	help
	  Wireless driver WQ9001
```

## general/package/xiongmai-osdrv-xm530/Config.in
```kconfig
config BR2_PACKAGE_XIONGMAI_OSDRV_XM530
	bool "xiongmai-osdrv-xm530"
	help
	  xiongmai-osdrv-xm530 - XiongMai kernel modules and libs

	  https://openipc.org
```

## general/package/xmdp/Config.in
```kconfig
config BR2_PACKAGE_XMDP
	bool "xmdp"
	default n
	help
	  Utility for finding devices that support the NETIP protocol

	  https://openipc.org
```

## general/package/yaml-cli-multi/Config.in
```kconfig
config BR2_PACKAGE_YAML_CLI_MULTI
	bool "Yaml parser"
	help
	  Parses yaml files.
	  https://github.com/vertexodessa/yaml-cli-multi
```

## general/package/yaml-cli/Config.in
```kconfig
config BR2_PACKAGE_YAML_CLI
	bool "yaml-cli"
	select BR2_PACKAGE_LIBYAML
	help
	  yaml-cli - console configurator for YAML files

	  https://github.com/openipc/yaml-cli/
```

## general/package/zerotier-one/Config.in
```kconfig
config BR2_PACKAGE_ZEROTIER_ONE
	bool "zerotier-one"
	depends on BR2_INSTALL_LIBSTDCPP
	depends on BR2_TOOLCHAIN_HAS_THREADS
	select BR2_PACKAGE_LIBMINIUPNPC
	select BR2_PACKAGE_LIBNATPMP
	help
	  ZeroTier One lets you join ZeroTier virtual networks and have
	  them appear as tun/tap ports on your system.

	  https://www.zerotier.com/

comment "zerotier-one needs a toolchain w/ C++, threads"
	depends on !BR2_INSTALL_LIBSTDCPP || !BR2_TOOLCHAIN_HAS_THREADS
```
