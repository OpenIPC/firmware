## general/package/rtl8189fs-openipc/Config.in
```kconfig
config BR2_PACKAGE_RTL8189FS_OPENIPC
	bool "rtl8189fs-openipc"
	depends on BR2_LINUX_KERNEL
	help
	  A driver for the RTL8189FS

	  https://github.com/jwrdegoede/rtl8189ES_linux

comment "rtl8189fs needs a Linux kernel to be built"
	depends on !BR2_LINUX_KERNEL
```

## general/package/rtl8192eu-openipc/Config.in
```kconfig
config BR2_PACKAGE_RTL8192EU_OPENIPC
	bool "rtl8192eu-openipc"
	depends on BR2_LINUX_KERNEL
	help
	  A standalone driver for the RTL8192EU USB Wi-Fi adapter.

	  Make sure your target kernel has the CONFIG_WIRELESS_EXT
	  config option enabled.

	  Note: this package needs a firmware loading mechanism to
	  load the binary blob for the chip to work.

	  https://github.com/Mange/rtl8192eu-linux-driver

comment "rtl8192eu needs a Linux kernel to be built"
	depends on !BR2_LINUX_KERNEL
```

## general/package/rtl8733bu-openipc/Config.in
```kconfig
config BR2_PACKAGE_RTL8733BU_OPENIPC
	bool "rtl8733bu-openipc"
	depends on BR2_LINUX_KERNEL
	help
	  RTL8733BU wireless driver
```

## general/package/rtl8733bu/Config.in
```kconfig
config BR2_PACKAGE_RTL8733BU
	bool "rtl8733bu"
	depends on BR2_LINUX_KERNEL
	help
	  RTL8733BU wireless driver
```

## general/package/rtl8811cu-openipc/Config.in
```kconfig
config BR2_PACKAGE_RTL8811CU_OPENIPC
	bool "rtl8811cu-openipc"
	help
	  Standalone driver for the RTL8811CU.
```

## general/package/rtl8812au-openipc/Config.in
```kconfig
config BR2_PACKAGE_RTL8812AU_OPENIPC
	bool "rtl8812au-openipc"
	depends on BR2_LINUX_KERNEL
	help
	  A standalone driver for the RTL8812AU / RTL8821AU Dual Band
	  USB Wi-Fi adapter.

	  Make sure your target kernel has the CONFIG_WIRELESS_EXT
	  config option enabled.

	  Note: this package needs a firmware loading mechanism to
	  load the binary blob for the chip to work.

	  https://github.com/aircrack-ng/rtl8812au/

comment "rtl8812au needs a Linux kernel to be built"
	depends on !BR2_LINUX_KERNEL
```

## general/package/rtl8812au/Config.in
```kconfig
config BR2_PACKAGE_RTL8812AU
	bool "rtl8812au"
	help
	  Standalone driver for the RTL8812AU.
```

## general/package/rtl88x2eu-openipc/Config.in
```kconfig
config BR2_PACKAGE_RTL88X2EU_OPENIPC
	bool "rtl88x2eu-openipc"
	depends on BR2_LINUX_KERNEL
	help
	  A standalone driver for the RTL88X2EU Dual Band
	  USB Wi-Fi adapter.

	  Make sure your target kernel has the CONFIG_WIRELESS_EXT
	  config option enabled.

	  Note: this package needs a firmware loading mechanism to
	  load the binary blob for the chip to work.


comment "rtl88x2eu needs a Linux kernel to be built"
	depends on !BR2_LINUX_KERNEL
```

## general/package/rubyfpv/Config.in
```kconfig
config BR2_PACKAGE_RUBYFPV
	bool "rubyfpv"
	select BR2_PACKAGE_IW
	help
	  Ruby package

	  https://rubyfpv.com
```

## general/package/sigmastar-osdrv-infinity6/Config.in
```kconfig
config BR2_PACKAGE_SIGMASTAR_OSDRV_INFINITY6
	bool "sigmastar-osdrv-infinity6"
	help
	  Sigmastar infinity6 kernel modules
```

## general/package/sigmastar-osdrv-infinity6b0/Config.in
```kconfig
config BR2_PACKAGE_SIGMASTAR_OSDRV_INFINITY6B0
	bool "sigmastar-osdrv-infinity6b0"
	help
	  Sigmastar infinity6b0 kernel modules
```

## general/package/sigmastar-osdrv-infinity6c/Config.in
```kconfig
config BR2_PACKAGE_SIGMASTAR_OSDRV_INFINITY6C
	bool "sigmastar-osdrv-infinity6c"
	help
	  Sigmastar infinity6c kernel modules
```

## general/package/sigmastar-osdrv-sensor/Config.in
```kconfig
config BR2_PACKAGE_SIGMASTAR_OSDRV_SENSOR
	bool "sigmastar-osdrv-sensor"
	help
	  Sigmastar sensor kernel driver
```

## general/package/sigmastar-osdrv-sensors/Config.in
```kconfig
config BR2_PACKAGE_SIGMASTAR_OSDRV_SENSORS
	bool "sigmastar-osdrv-sensors"
	help
	  Sigmastar sensor kernel driver
```

## general/package/sigmastar-osdrv-ssc335/Config.in
```kconfig
config BR2_PACKAGE_SIGMASTAR_OSDRV_SSC335
	bool "sigmastar-osdrv-ssc335"
	help
	  sigmastar-osdrv-ssc335 - SigmaStar kernel modules and libs

	  https://openipc.org
```

## general/package/sigmastar-osdrv-ultimate/Config.in
```kconfig
config BR2_PACKAGE_SIGMASTAR_OSDRV_ULTIMATE
	bool "sigmastar-osdrv-ultimate"
	help
	  Additional Sigmastar libraries
```

## general/package/siproxd-openipc/Config.in
```kconfig
#
# Copyright (c) OpenIPC  https://openipc.org  MIT License
#
# Config.in — Buildroot package Kconfig menu
#
config BR2_PACKAGE_SIPROXD_OPENIPC
	bool "siproxd-openipc"
	depends on BR2_USE_MMU
	depends on BR2_TOOLCHAIN_HAS_THREADS
	select BR2_PACKAGE_LIBOSIP2
	help
	  Siproxd is a proxy/masquerading daemon for SIP (Session
	  Initiation Protocol), which is used in IP telephony. It
	  handles registrations of SIP clients on a private IP network
	  and performs rewriting of the SIP message bodies to make SIP
	  connections work via a masquerading firewall (NAT). It allows
	  SIP software clients (like kphone, linphone) or SIP hardware
	  clients (Voice over IP phones which are SIP-compatible, such
	  as those from Cisco, Grandstream or Snom) to work behind an IP
	  masquerading firewall or NAT router.

	  http://siproxd.sourceforge.net/
```

## general/package/ssv6155-openipc/Config.in
```kconfig
config BR2_PACKAGE_SSV6155_OPENIPC
	bool "ssv6155-openipc"
	depends on BR2_LINUX_KERNEL
	help
	  SV6155 wireless driver
```

## general/package/ssv615x-openipc/Config.in
```kconfig
config BR2_PACKAGE_SSV615X_OPENIPC
	bool "ssv615x-openipc"
	help
	  SV615X wireless driver
```

## general/package/ssv635x-openipc/Config.in
```kconfig
config BR2_PACKAGE_SSV635X_OPENIPC
	bool "ssv635x-openipc"
	help
	  SV635X wireless driver
```

## general/package/ssv6x5x-openipc/Config.in
```kconfig
config BR2_PACKAGE_SSV6X5X_OPENIPC
	bool "ssv6x5x-openipc"
	depends on BR2_LINUX_KERNEL
	help
	  SV6X5X wireless driver
```

## general/package/ssw101b/Config.in
```kconfig
config BR2_PACKAGE_SSW101B
	bool "ssw101b"
	depends on BR2_LINUX_KERNEL
	help
	  Wireless driver ssw101b.

	  SigmaStar ssw101b WiFi driver

comment "SSW101B needs a Linux kernel to be built"
	depends on !BR2_LINUX_KERNEL
```

## general/package/thermal-throttle-db/Config.in
```kconfig
config BR2_PACKAGE_THERMAL_THROTTLE_DB
	bool "thermal-throttle-db"
	help
	  Thermal stuff
```
