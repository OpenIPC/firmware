## general/package/atbm6441-openipc/Config.in
```kconfig
config BR2_PACKAGE_ATBM6441_OPENIPC
	bool "atbm6441-openipc"
	depends on BR2_LINUX_KERNEL
	help
	  Driver for the AltoBeam ATBM6441 SDIO Wi-Fi in IoT mode, the
	  chip of battery doorbells such as the Merkury MI-CW074-125W.
	  The chip runs its own Wi-Fi stack and DHCP; the host module
	  only bridges frames and passes AT commands through
	  /dev/atbm_ioctl. Builds atbm6441_wifi_sdio.ko; needs the
	  kernel's cfg80211.

	  https://github.com/openipc/atbm6441
```

## general/package/axera-osdrv-ax620e/Config.in
```kconfig
config BR2_PACKAGE_AXERA_OSDRV_AX620E
	bool "axera-osdrv-ax620e"
	help
	  Axera AX620E (AX630C/AX620E, Cortex-A53) kernel modules. VIN/CSI2
	  capture, the VC8000E encoder and Hantro decoder, and EIP-130
	  crypto build from source as part of the axera-ax620e kernel
	  branch; the ISP 3A (ax_proton.ko), NPU (ax_npu.ko) and the rest of
	  the vendor codec stack are closed binaries shipped in this
	  package at kernel 5.15.73's vermagic. See this package's README
	  for provenance.
```

## general/package/axera-osdrv-ax620u/Config.in
```kconfig
config BR2_PACKAGE_AXERA_OSDRV_AX620U
	bool "axera-osdrv-ax620u"
	help
	  Axera AX620U (Cortex-A7 x4, AArch32) closed kernel modules,
	  shipped in this package at kernel 4.19.125's vermagic. Unlike
	  AX620E, AX620U has no existing open-source driver starting point
	  for anything else (clock, pinctrl, platform code); see this
	  package's README.
```

## general/package/cpu-models/Config.in
```kconfig
config BR2_PACKAGE_CPU_MODELS
	bool "cpu-models"
	default n
	help
	  The int8 networks majestic's own engine runs on the CPU, in
	  /usr/share/majestic. Each is chosen below. MIT.

	  https://github.com/OpenIPC/cpu-models

if BR2_PACKAGE_CPU_MODELS

config BR2_PACKAGE_CPU_MODELS_PERSON
	bool "person detector"
	default y
	help
	  person.qnet, the person detector majestic's object detection runs
	  on cameras without an NPU, with the thresholds of its three presets
	  beside it in person.json. Only the HiSilicon/Goke parts with the IVE
	  motion backend use it. 84 KB.

config BR2_PACKAGE_CPU_MODELS_DRUM
	bool "meter drum reader"
	default y
	help
	  drum.qnet, which majestic's meter reading reads the drums of a
	  water, gas or electricity meter with, on any camera majestic can
	  hold a frame on (HiSilicon, SigmaStar). 49 KB.

endif
```

## general/package/divinus/Config.in
```kconfig
config BR2_PACKAGE_DIVINUS
	bool "Divinus streamer"
	select BR2_PACKAGE_ALSA_LIB if BR2_PACKAGE_FULLHAN_OSDRV_FH8626
	help
	  Multi-platform open source streamer
	  https://github.com/openipc/divinus
```

## general/package/exfat-nofuse-openipc/Config.in
```kconfig
config BR2_PACKAGE_EXFAT_NOFUSE_OPENIPC
	bool "exfat-nofuse-openipc"
	depends on BR2_LINUX_KERNEL
	depends on !BR2_PACKAGE_EXFAT_OPENIPC # both build exfat.ko
	help
	  exFAT kernel module for kernels older than exfat-openipc supports
	  (3.x, e.g. the SigmaStar infinity3 3.18 kernel). Built as
	  exfat.ko, which the shared /etc/modules loads at boot like
	  exfat-openipc's.

	  https://github.com/dorimanx/exfat-nofuse
```

## general/package/fh8626-3ad/Config.in
```kconfig
config BR2_PACKAGE_FH8626_3AD
	bool "fh8626-3ad"
	depends on BR2_LINUX_KERNEL
	help
	  Automatic exposure and white balance for the FH8626V100 ISP.
	  The daemon reads the ISP's zone statistics through its V4L2
	  subdevice and drives the sensor and ISP controls, alongside
	  whichever application streams from the capture device.
```

## general/package/fh8626-arc-firmware/Config.in
```kconfig
config BR2_PACKAGE_FH8626_ARC_FIRMWARE
	bool "fh8626-arc-firmware"
	select BR2_PACKAGE_HOST_ARC_BINUTILS
	help
	  Firmware for the FH8626V100's ARC coprocessor, loaded by the
	  kernel's fh8626-arc remoteproc driver from
	  /lib/firmware/fh8626-arc.elf. It answers on one RPMsg echo
	  endpoint, rpmsg-arc-echo, and does nothing else yet.

	  Built from source in this package.
```

## general/package/fullhan-osdrv-fh8626/Config.in
```kconfig
config BR2_PACKAGE_FULLHAN_OSDRV_FH8626
	bool "fullhan-osdrv-fh8626"
	help
	  FH8626V100 driver loading. The drivers are modules of the kernel
	  itself; this loads the ones the device tree calls for and keeps
	  the kernel's memory size in the U-Boot environment.

	  https://openipc.org
```

## general/package/fullhan-osdrv-fh8626v100/Config.in
```kconfig
config BR2_PACKAGE_FULLHAN_OSDRV_FH8626V100
	bool "fullhan-osdrv-fh8626v100"
	help
	  fullhan-osdrv-fh8626v100 - Fullhan FH8626V100 kernel modules and libs

	  https://openipc.org
```

## general/package/fullhan-osdrv-fh865x/Config.in
```kconfig
config BR2_PACKAGE_FULLHAN_OSDRV_FH865X
	bool "fullhan-osdrv-fh865x"
	depends on BR2_LINUX_KERNEL
	help
	  fullhan-osdrv-fh865x - Fullhan FH8652/FH8656/FH8658 media
	  drivers, linked against this kernel from the FH885XV200_IPC_V1.1.0
	  SDK objects (FP13), with the fullhan-osdrv-fh8852v200 libraries,
	  sensors and ARC firmware from the same SDK.

	  https://openipc.org
```

## general/package/gk7201-fixup/Config.in
```kconfig
config BR2_PACKAGE_GK7201_FIXUP
	bool "gk7201-fixup"
	depends on BR2_LINUX_KERNEL
	help
	  Runtime fixups for the GK7201V200 (XiongMai xm72010200) die, where an
	  Apr-2023 libxmedia userspace runs on Sep-2023 vendor kernel modules.

	  gk7201_fixup.ko (kernel):
	    - suppresses the orphaned ISP-FE interrupt that otherwise storms irq39
	    - builds the VPSS group-0 contexts the VI-VPSS online bind leaves
	      missing (the early-line VI IRQ would Oops on them)
	    - clears the stale h264 encoder channel context so VENC chn0 creates

	  libgk_shim.so (LD_PRELOAD for Majestic):
	    - opens the SetVIVPSSMode gate the Sep-2023 xm_sys keeps shut
	    - answers the two libxmedia liveness probes the new drivers reject
	    - accepts the VPSS group create the online bind already performed

	  Enabled automatically by load_goke -> load_xm on this SoC; the shim is
	  activated from /etc/default/majestic only when /dev/vpss_ctx_fix exists.

comment "gk7201-fixup needs a Linux kernel to be built"
	depends on !BR2_LINUX_KERNEL
```

## general/package/glibc-compat/Config.in
```kconfig
config BR2_PACKAGE_GLIBC_COMPAT
	bool "glibc-compat"
	depends on BR2_TOOLCHAIN_USES_MUSL
	help
	  ABI shim for vendor binaries linked against libc.so.6 (glibc) that
	  must run on a musl rootfs. Provides a libglibc-compat.so with the
	  glibc-only entry points (__xstat, __isoc99_sscanf, ...) that musl
	  does not export, plus rootfs symlinks for libc.so.6 / libm.so.6 /
	  ld-linux.so.3 -> musl libc.

	  Used by Hi3520DV200 (vendor MPP for V200 only ships glibc-linked
	  .so, while glibc cannot run on the SoC's 3.0.8 kernel) and by the
	  SigmaStar infinity3 (MSC313E) SDK libs.

	  The executable that loads the vendor libs links -lglibc-compat
	  ahead of libc: musl has its own __xstat family, and the first
	  library in load order wins. Hi3520DV200 SDK builds also link
	  -lglibc-compat-static, whose mmap guesses the caller's off_t width.

	  A call neither can bridge for both ABIs at once is redirected per
	  vendor library at install time with rename-import.py, to a
	  glibc-compat wrapper of the same name length: lseek -> lse32, and
	  on infinity3 mmap -> mm32 (a 32-bit off_t). Those wrappers live in
	  libglibc-compat.so, so any executable that loads the infinity3
	  vendor libraries (libmi, libMTE_LINUX, libCam*, libOMX_*, ...)
	  must link -lglibc-compat, or it fails to load with an unresolved
	  mm32.
```

## general/package/gpiostep-openipc/Config.in
```kconfig
config BR2_PACKAGE_GPIOSTEP_OPENIPC
	bool "gpiostep-openipc"
	depends on BR2_LINUX_KERNEL
	help
	  In-kernel GPIO half-step pan/tilt stepper driver plus a small
	  userspace CLI (gpiostep-ctl). A clean reimplementation of the
	  vendor gpioStep/motor behaviour seen on Goke GK7205V510 PTZ
	  cameras: two 4-wire stepper coils driven over GPIO from kernel
	  context, avoiding the per-write syscall cost of the userspace
	  gpio-motors tool. Sub-tick step delays busy-wait, because the
	  kernels that ship this package have no high-resolution timers
	  and would otherwise round every sleep up to a whole 10ms tick.

	  Pin map defaults to the GK7205V510 (NC-IPTC2200_DL) layout and is
	  overridable via module params, e.g.
	  insmod gpiostep.ko pan_gpios=3,4,72,73 tilt_gpios=69,59,58,57

	  https://openipc.org

comment "gpiostep-openipc needs a Linux kernel to be built"
	depends on !BR2_LINUX_KERNEL
```

## general/package/hisilicon-osdrv-hi3536dv100/Config.in
```kconfig
config BR2_PACKAGE_HISILICON_OSDRV_HI3536DV100
	bool "hisilicon-osdrv-hi3536dv100"
	depends on BR2_LINUX_KERNEL
	select BR2_PACKAGE_HISILICON_OPENSDK
	help
	  hisilicon-osdrv-hi3536dv100 - Hisilicon libraries and the
	  load_hisilicon script. The kernel modules come from
	  hisilicon-opensdk, which this selects.

	  https://openipc.org
```

## general/package/legacy/sigmastar-osdrv-msc313e/Config.in
```kconfig
config BR2_PACKAGE_SIGMASTAR_OSDRV_MSC313E
	bool "sigmastar-osdrv-msc313e"
	depends on BR2_TOOLCHAIN_USES_MUSL
	select BR2_PACKAGE_GLIBC_COMPAT
	help
	  sigmastar-osdrv-msc313e - SigmaStar kernel modules and libs

	  https://openipc.org
```

## general/package/libevent-openipc/Config.in
```kconfig
config BR2_PACKAGE_LIBEVENT_OPENIPC
	bool "libevent-openipc"
	help
	  Userspace library for handling asynchronous notifications.

	  Built from the OpenIPC fork, which carries build toggles and
	  fixes upstream libevent has not taken yet.

	  https://github.com/OpenIPC/libevent
```

## general/package/majestic-af/Config.in
```kconfig
config BR2_PACKAGE_MAJESTIC_AF
	bool "majestic-af"
	depends on BR2_PACKAGE_MAJESTIC
	help
	  Out-of-core motor driver and autofocus engine for majestic, compiled
	  from source. majestic loads /usr/lib/majestic-af.so at runtime when a
	  motorized lens is declared and the majestic binary exports the plugin
	  HAL seams; the contrast search, the motorized-lens actuators, and the
	  worker threads live here. Two actuator families are implemented: a UART
	  wire for the XiongMai near-Pelco and standard Pelco-D lenses, and an
	  MS41908M SPI stepper (isp.autofocus.actuator=ms41908) for the Hi3516A/D
	  V100 boards whose zoom/focus lens is on SPI with no UART lens MCU.

	  For the UART families it is the ONLY writer on that tty, and it is now
	  required for manual PTZ as well as autofocus: the WebUI asks majestic
	  for a verb over its HTTP API rather than shipping its own Pelco scripts,
	  which used to open the same tty behind the daemon's back. A camera with
	  ptz_control=pelco-d or pelco-xm and no driver keeps its pad but says
	  what is missing, rather than claiming the camera has no PTZ.

	  https://github.com/OpenIPC/majestic-af
```

## general/package/majestic-webui/Config.in
```kconfig
config BR2_PACKAGE_MAJESTIC_WEBUI
	bool "majestic-webui"
	select BR2_PACKAGE_HASERL
	help
	  Simple web interface.
	  https://openipc.org

if BR2_PACKAGE_MAJESTIC_WEBUI

config BR2_PACKAGE_MAJESTIC_WEBUI_SMS
	bool "SMS page"
	help
	  The SMS page: the inbox a cellular modem keeps, sending, USSD
	  balance and package codes, and forwarding new messages to
	  Telegram. Only of use on a board with a USB cellular modem, so it
	  is left out unless a device profile asks for it.

config BR2_PACKAGE_MAJESTIC_WEBUI_PTZ
	bool "PTZ controls"
	default y if BR2_PACKAGE_GPIO_MOTORS || BR2_PACKAGE_MAJESTIC_AF
	help
	  The Live page's pan/tilt pad, zoom and focus buttons and
	  follow mode. They move motors through gpio-motors or the
	  majestic-af plugin, so the option is on wherever either is in
	  the image; a board whose driver comes from elsewhere selects it.

config BR2_PACKAGE_MAJESTIC_WEBUI_COUNTING
	bool "Counting page"
	default y if BR2_PACKAGE_XMNPU_MODELS || BR2_PACKAGE_CPU_MODELS_PERSON
	help
	  The Counting page: people crossing lines in and out, who is in
	  each zone and for how long, by the hour and by the day. Counting
	  runs on majestic's object detection, so the option is on wherever
	  the image carries a detection model (xmnpu-models for the NPU,
	  cpu-models' person detector for the CPU); without one there is
	  nothing to count with. cpu-models' drum reader alone is not one.

config BR2_PACKAGE_MAJESTIC_WEBUI_FPV
	bool "FPV (wfb-ng) settings page"
	default y if BR2_OPENIPC_VARIANT = "fpv" || BR2_OPENIPC_VARIANT = "wfbng"
	help
	  The WFB settings page for wfb-ng video links. On by default for
	  the fpv and wfbng variants, which are what carry wfb-ng.

endif
```

## general/package/mbedtls-openipc/Config.in
```kconfig
config BR2_PACKAGE_MBEDTLS_OPENIPC
	bool "mbedtls-openipc"
	help
	  mbed TLS (formerly known as PolarSSL) makes it trivially easy
	  for developers to include cryptographic and SSL/TLS
	  capabilities in their (embedded) products, facilitating this
	  functionality with a minimal coding footprint.

	  https://tls.mbed.org/

if BR2_PACKAGE_MBEDTLS_OPENIPC

config BR2_PACKAGE_MBEDTLS_OPENIPC_PROGRAMS
	bool "mbedtls-openipc programs"
	depends on BR2_USE_MMU # fork()
	help
	  This option enables the installation and the build of
	  mbed TLS companion programs.

endif
```

## general/package/nt98513-diagnostics/Config.in
```kconfig
config BR2_PACKAGE_NT98513_DIAGNOSTICS
	bool "nt98513-diagnostics"
	depends on BR2_mipsel
	depends on BR2_MIPS_CPU_MIPS32R2
	depends on BR2_MIPS_OABI32
	help
	  Optional manual diagnostics for the recovered NT98513 stock
	  Linux userspace ABI. Builds three freestanding static MIPS32r2
	  O32 soft-float tools; the rootfs libc float ABI is not used.
	  Requires a GNU/Clang compiler accepting the checked target flags.
	  No services, device nodes, firmware or board support are installed.
	  Build success does not establish compatible hardware or drivers.

	  https://github.com/OpenIPC/ipctool
```
