## general/package/libsrt-openipc/Config.in
```kconfig
config BR2_PACKAGE_LIBSRT_OPENIPC
	bool "libsrt-openipc"
	help
	  Secure Reliable Transport (SRT) is an open source transport
	  technology that optimizes streaming performance across
	  unpredictable networks, such as the Internet.

	  SRT is applied to contribution and distribution endpoints
	  as part of a video stream workflow to deliver the best
	  quality and lowest latency video at all times.

	  https://github.com/Haivision/srt
```

## general/package/libsrt/Config.in
```kconfig
config BR2_PACKAGE_LIBSRT
	bool "libsrt"
	help
	  Tool for easily creating Virtual Tunnels over TCP/IP networks
	  with traffic shaping, compression, and encryption.

	  It supports IP, PPP, SLIP, Ethernet and other tunnel types.

	  No LZO/SSL/ZLIB version

	  http://vtun.sourceforge.net/
```

## general/package/libwebsockets-openipc/Config.in
```kconfig
config BR2_PACKAGE_LIBWEBSOCKETS_OPENIPC
	bool "libwebsockets-openipc"
	select BR2_PACKAGE_ZLIB
	help
	  Libwebsockets is a lightweight pure C library built to use
	  minimal CPU and memory resources, and provide fast throughput
	  in both directions.

	  https://libwebsockets.org/
```

## general/package/linux-firmware-openipc/Config.in
```kconfig
config BR2_PACKAGE_LINUX_FIRMWARE_OPENIPC
	bool "linux-firmware-openipc"
	help
	  This package provides various binary firmware files (closed
	  binary blobs) for such devices like LAN, WLAN cards etc.

	  https://git.kernel.org/?p=linux/kernel/git/firmware/linux-firmware.git

if BR2_PACKAGE_LINUX_FIRMWARE_OPENIPC

menu "WiFi firmware"

config BR2_PACKAGE_LINUX_FIRMWARE_OPENIPC_ATHEROS_9271
	bool "Atheros 9271"
	help
	  Firmware files for the Atheros 9271 module

config BR2_PACKAGE_LINUX_FIRMWARE_OPENIPC_MEDIATEK_MT7601U
	bool "MediaTek MT7601U"
	select BR2_PACKAGE_WPA_SUPPLICANT_WEXT
	help
	  MediaTek MT7601U

config BR2_PACKAGE_LINUX_FIRMWARE_OPENIPC_RTL_8188EU
	bool "Realtek RTL8188EU"
	help
	  Realtek 8188EU

config BR2_PACKAGE_LINUX_FIRMWARE_OPENIPC_XRADIOTECH_XR829
	bool "Xradiotech XR829"
	help
	  Xradiotech XR829

endmenu

endif
```

## general/package/linux-patcher/Config.in
```kconfig
config BR2_PACKAGE_LINUX_PATCHER
	bool "linux patcher"
	default y if BR2_LINUX_KERNEL
	help
	  Linux patcher for OpenIPC

config BR2_PACKAGE_LINUX_PATCHER_ATHEROS
	bool "linux patcher atheros"
	help
	  Atheros wireless driver
```

## general/package/logcat-openipc/Config.in
```kconfig
config BR2_PACKAGE_LOGCAT_OPENIPC
	bool "logcat-openipc"
	help
	  Logcat tool for Ingenic
```

## general/package/majestic-fh8852v200/Config.in
```kconfig
config BR2_PACKAGE_MAJESTIC_FH8852V200
	bool "Tiny but powerful IPC streaming software"
	default n
	help
	  Tiny but powerful IPC streaming software

	  https://openipc.org
```

## general/package/majestic-fonts/Config.in
```kconfig
config BR2_PACKAGE_MAJESTIC_FONTS
	bool "majestic-fonts"
	default n
	help
	  Minimized TTF fonts for Majestic streamer

	  https://openipc.org
```

## general/package/majestic-gk7205v200/Config.in
```kconfig
config BR2_PACKAGE_MAJESTIC_GK7205V200
	bool "Tiny but powerful IPC streaming software"
	default n
	help
	  Tiny but powerful IPC streaming software

	  https://openipc.org

config BR2_PACKAGE_MAJESTIC_ULTIMATE
        bool "Use this option for the ultimate build"
        default n
```

## general/package/majestic-hi3516cv100/Config.in
```kconfig
config BR2_PACKAGE_MAJESTIC_HI3516CV100
	bool "Tiny but powerful IPC streaming software"
	default n
	help
	  Tiny but powerful IPC streaming software

	  https://openipc.org
```

## general/package/majestic-hi3516cv200/Config.in
```kconfig
config BR2_PACKAGE_MAJESTIC_HI3516CV200
	bool "Tiny but powerful IPC streaming software"
	default n
	help
	  Tiny but powerful IPC streaming software

	  https://openipc.org
```

## general/package/majestic-hi3516cv300/Config.in
```kconfig
config BR2_PACKAGE_MAJESTIC_HI3516CV300
	bool "Tiny but powerful IPC streaming software"
	default n
	help
	  Tiny but powerful IPC streaming software

	  https://openipc.org

config BR2_PACKAGE_MAJESTIC_ULTIMATE
        bool "Use this option for the ultimate build"
        default n
```

## general/package/majestic-hi3516ev300/Config.in
```kconfig
config BR2_PACKAGE_MAJESTIC_HI3516EV300
	bool "Tiny but powerful IPC streaming software"
	default n
	help
	  Tiny but powerful IPC streaming software

	  https://openipc.org

config BR2_PACKAGE_MAJESTIC_ULTIMATE
 	bool "Use this option for the ultimate build"
	default n

config BR2_PACKAGE_MAJESTIC_FPV
        bool "Use this option for the fpv build"
        default n
```

## general/package/majestic-hi3519v101/Config.in
```kconfig
config BR2_PACKAGE_MAJESTIC_HI3519V101
	bool "Tiny but powerful IPC streaming software"
	default n
	help
	  Tiny but powerful IPC streaming software

	  https://openipc.org
```

## general/package/majestic-plugins/Config.in
```kconfig
config BR2_PACKAGE_SIGMASTAR_MOTORS
	bool "majestic-plugins"
	help
	  Sample for Majestic plugins.
```

## general/package/majestic-ssc335/Config.in
```kconfig
config BR2_PACKAGE_MAJESTIC_SSC335
	bool "Tiny but powerful IPC streaming software"
	default n
	help
	  Tiny but powerful IPC streaming software

	  https://openipc.org
```

## general/package/matter/Config.in
```kconfig
#
# Copyright (c) OpenIPC  https://openipc.org  MIT License
#
# Config.in — Kconfig entry for the matter package
#

config BR2_PACKAGE_MATTER
	bool "matter"
	depends on BR2_USE_MMU
	depends on BR2_TOOLCHAIN_HAS_THREADS
	help
	  OpenIPC Matter-compatible IP camera server.

	  Implements a subset of the Matter 1.2 specification sufficient
	  to make an IP camera discoverable and controllable by Matter
	  controllers (Apple Home, Google Home, Amazon Alexa, etc.):

	    - Clusters: OnOff, LevelControl, BasicInformation,
	                OccupancySensing, Identify
	    - WriteAttribute support
	    - mDNS announcement (PTR + SRV + TXT records)
	    - TCP commissioning stub (PASE / PBKDFParamRequest)
	    - RTSP stream URL as a Matter attribute
	    - Client connection limit and 30 s receive timeout

	  Designed for OpenIPC IP cameras and other resource-constrained
	  embedded Linux targets (uClibc / musl / glibc).
	  No external libraries required — pure C99 / POSIX.

	  https://openipc.org

if BR2_PACKAGE_MATTER

config BR2_PACKAGE_MATTER_RTSP_URL
	string "Default RTSP stream URL"
	default "rtsp://127.0.0.1:554/stream"
	help
	  RTSP URL written into /etc/matter.conf as the default stream
	  source.  Can be overridden at runtime by editing that file or
	  by passing the URL as the first argument to matter-server.

config BR2_PACKAGE_MATTER_PORT
	int "Matter TCP port"
	range 1 65535
	default 5540
	help
	  TCP port the Matter server listens on.  5540 is the default
	  port defined by the Matter specification.
	  Written into /etc/matter.conf; can be overridden at runtime.

config BR2_PACKAGE_MATTER_INIT_STARTLEVEL
	int "Init script start level"
	range 10 99
	default 90
	help
	  Numeric prefix of the SysV-style init script installed under
	  /etc/init.d.  Higher numbers start later in the boot sequence.
	  90 ensures the network is up before the Matter server starts.

endif
```

## general/package/mavfwd/Config.in
```kconfig
config BR2_PACKAGE_MAVFWD
	bool "mavfwd"
	help
	  Simple mavlink forwarder.

	  https://github.com/OpenIPC/mavfwd
```

## general/package/mcom/Config.in
```kconfig
config BR2_PACKAGE_MCOM
    bool "mcom"
    help
      Microcom version for Tetiva V2
```

## general/package/mdnsd-openipc/Config.in
```kconfig
#
# Copyright (c) OpenIPC  https://openipc.org  MIT License
#
# Config.in — Buildroot package Kconfig menu
#
config BR2_PACKAGE_MDNSD_OPENIPC
	bool "mdnsd-openipc"
	depends on BR2_USE_MMU # fork()
	help
	  Small mDNS-SD daemon for advertising services and device
	  discovery, similar to Avahi and Bonjour.

	  By default, mdnsd runs on all interfaces that support
	  multicast.  It reads services to announce from
	  /etc/mdns.d/*.service, a few common services are included
	  below.  To override the defaults, e.g., path to services,
	  TTL of multicast frames, or the default interface, set
	  MDNSD_ARGS in /etc/default/mdnsd

	  Note: currently no NSS integration with GLIBC.

	  https://github.com/troglobit/mdnsd

if BR2_PACKAGE_MDNSD_OPENIPC

config BR2_PACKAGE_MDNSD_MQUERY_OPENIPC
	bool "mquery-openipc"
	help
	  Scan a LAN for mDNS capable devices, or query specific
	  records, similar to the mdns-scan tool.  Useful for
	  verifying multicast connectivity or locating neighbors with
	  link-local address.

endif
```

## general/package/microbe-web/Config.in
```kconfig
config BR2_PACKAGE_MICROBE_WEB
	bool "microbe-web"
	select BR2_PACKAGE_HASERL
	help
	  The simplest web interface constructor based on
	  httpd and haserl.

	  https://openipc.org
```

## general/package/microsnander/Config.in
```kconfig
config BR2_PACKAGE_MICROSNANDER
	bool "microsnander"
	default n
	help
	  tripped down and modified version of Serial Nor/nAND/Eeprom programmeR

	  https://openipc.org
```

## general/package/mini/Config.in
```kconfig
config BR2_PACKAGE_MINI
	bool "Mini streamer"
	help
	  Open-source video streamer for HiSilicon gen 2-3 IPC
	  (GPL-3.0 license)

	  https://github.com/openipc/mini
```

## general/package/motors/Config.in
```kconfig
config BR2_PACKAGE_MOTORS
	bool "motors"
	help
	  Various code to manage motor hardware

	  https://openipc.org
```
