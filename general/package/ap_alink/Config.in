## general/package/ap_alink/Config.in
```kconfig
config BR2_PACKAGE_APALINK
    bool "ap_alink"
    help
      apalink adaptive link vers 1.2 for apfpv
      and other wifi link application
    
```

## general/package/apfpv-greg-msposd/Config.in
```kconfig
config BR2_PACKAGE_APFPV_GREG_MSPOSD
	bool "apfpv-greg-msposd"
	default n
	select BR2_PACKAGE_LIBEVENT_OPENIPC
	help
	  Builds the custom APFPV Greg msposd binary from the public
	  sickgreg/msposd repo and installs it as /usr/bin/msposd together
	  with its fonts, config, runtime libraries, and service script.
```

## general/package/apfpv-greg-payload/Config.in
```kconfig
config BR2_PACKAGE_APFPV_GREG_PAYLOAD
	bool "apfpv-greg-payload"
	default n
	help
	  Installs the shared APFPV Greg payload from the public payload repo.
	  This package provides APFPV-specific files that are not owned by a
	  single source repo, including CGI glue, helper scripts, shared
	  assets, modules, and sensor blobs.
```

## general/package/apfpv-greg/Config.in
```kconfig
config BR2_PACKAGE_APFPV_GREG
	bool "apfpv-greg"
	default n
	select BR2_PACKAGE_AALINK
	select BR2_PACKAGE_AALINK_IDR5
	select BR2_PACKAGE_AIR_MAN_AP
	select BR2_PACKAGE_APFPV_GREG_MSPOSD
	select BR2_PACKAGE_APFPV_GREG_PAYLOAD
	help
	  Meta-package for the APFPV Greg firmware stack. Selecting this
	  package enables the APFPV Greg userspace components and shared
	  payload while keeping the final-override files in the device
	  overlays.
```

## general/package/apfpv-greg10/Config.in
```kconfig
config BR2_PACKAGE_APFPV_GREG10
	bool "apfpv-greg10"
	default n
	select BR2_PACKAGE_LIBEVENT_OPENIPC
	help
	  Builds the custom APFPV Greg10 user-space stack from the configured
	  GitHub repos and installs the matching init scripts.
	  Local testing with private repos uses the authenticated gh CLI.
```

## general/package/atbm-wifi/Config.in
```kconfig
config BR2_PACKAGE_ATBM_WIFI
	bool "atbm_wifi"
	depends on BR2_LINUX_KERNEL
	help
	  Wireless driver atbm-wifi

if BR2_PACKAGE_ATBM_WIFI
choice
	prompt "ATBM_WIFI Model"
	help
	Select the ATBM_WIFI model

config BR2_PACKAGE_ATBM_WIFI_MODEL_6012B
	bool "ATBM6012b"

config BR2_PACKAGE_ATBM_WIFI_MODEL_603X
	bool "ATBM603x"

config BR2_PACKAGE_ATBM_WIFI_MODEL_6132
	bool "ATBM6132"

endchoice

if BR2_PACKAGE_ATBM_WIFI_MODEL_6012B || BR2_PACKAGE_ATBM_WIFI_MODEL_603X || BR2_PACKAGE_ATBM_WIFI_MODEL_6132
choice
	prompt "Interface type for selected ATBM-WIFI model"
	help
	Select the interface type for the selected ATBM-WIFI model

config BR2_PACKAGE_ATBM_WIFI_INTERFACE_USB
	bool "USB"

config BR2_PACKAGE_ATBM_WIFI_INTERFACE_SDIO
	bool "SDIO"

endchoice

endif
endif
```

## general/package/atbm603x/Config.in
```kconfig
config BR2_PACKAGE_ATBM603X
	bool "atbm603x"
	depends on BR2_LINUX_KERNEL
	help
	  Wireless driver atbm603x.

	  Allwinner atbm603x WiFi driver

comment "ATBM603X needs a Linux kernel to be built"
	depends on !BR2_LINUX_KERNEL
```

## general/package/atbm60xx/Config.in
```kconfig
config BR2_PACKAGE_ATBM60XX
	bool "atbm60xx"
	depends on BR2_LINUX_KERNEL
	help
	  Wireless driver atbm60xx

if BR2_PACKAGE_ATBM60XX
choice
	prompt "ATBM60XX Model"
	help
	Select the ATBM60XX model

config BR2_PACKAGE_ATBM60XX_MODEL_601X
	bool "ATBM601x"

config BR2_PACKAGE_ATBM60XX_MODEL_602X
	bool "ATBM602x"

config BR2_PACKAGE_ATBM60XX_MODEL_603X
	bool "ATBM603x"

config BR2_PACKAGE_ATBM60XX_MODEL_6041
	bool "ATBM6041"

endchoice

if BR2_PACKAGE_ATBM60XX_MODEL_601X || BR2_PACKAGE_ATBM60XX_MODEL_602X || BR2_PACKAGE_ATBM60XX_MODEL_603X || BR2_PACKAGE_ATBM60XX_MODEL_6041
choice
	prompt "Interface type for selected ATBM60XX model"
	help
	Select the interface type for the selected ATBM60XX model

config BR2_PACKAGE_ATBM60XX_INTERFACE_USB
	bool "USB"

config BR2_PACKAGE_ATBM60XX_INTERFACE_SDIO
	bool "SDIO"

endchoice

endif
endif
```

## general/package/atbm6441/Config.in
```kconfig
config BR2_PACKAGE_ATBM6441
	bool "atbm6441"
	depends on BR2_LINUX_KERNEL
	help
	  Wireless driver atbm6441
```

## general/package/aura-httpd/Config.in
```kconfig
config BR2_PACKAGE_AURA_HTTPD
	bool "aura-httpd"
	help
	  aura-httpd provides a simple way to bring aura to the world of
	  the WEB automatically creating a fun, easy to use REST API out
	  of the methods you've exported from an aura node.
	  It's still WIP and not yet usable.

	  https://github.com/nekromant/aura-httpd
```

## general/package/autonight/Config.in
```kconfig
config BR2_PACKAGE_AUTONIGHT
	bool "autonight"
	help
	  Automatic day/night mode switcher for Ingenic devices.
```

## general/package/aws-producer/Config.in
```kconfig
config BR2_PACKAGE_AWS_PRODUCER
	bool "aws-producer"
	help
	  Amazon Kinesis Video Streams C Producer
```

## general/package/aws-webrtc/Config.in
```kconfig
config BR2_PACKAGE_AWS_WEBRTC
	bool "aws-webrtc"
	help
	  Amazon Kinesis Video Streams C WebRTC SDK
```

## general/package/ax-agent/Config.in
```kconfig
config BR2_PACKAGE_AX_AGENT
	bool "ax-agent"
	default n
	help
	  Simple daemon

	  https://openipc.org
```

## general/package/baresip-openipc/Config.in
```kconfig
config BR2_PACKAGE_BARESIP_OPENIPC
	bool "baresip-openipc"
	help
	  Baresip is a portable and modular SIP User-Agent with audio
	  and video support. Copyright (c) 2010 - 2024 Alfred E. Heggestad
	  and Contributors Distributed under BSD license.

	  https://github.com/baresip/baresip
```

## general/package/canaan_k230_sdk/Config.in
```kconfig
menuconfig BR2_PACKAGE_CANAAN_K230_SDK
	bool "canaan k230 sdk"
	default n
	help
	  canaan k230 SoCs SDK

	  https://github.com/kendryte/k230_linux_sdk/

if  BR2_PACKAGE_CANAAN_K230_SDK
config BR2_PACKAGE_CANAAN_K230_SDK_BUILD_FROM_SRC
	bool "k230 sdk build from source"
	default n
	help
	  canaan k230 SoCs SDK

	  https://github.com/kendryte/k230_linux_sdk/

config BR2_PACKAGE_CANAAN_K230_SDK_CONF
	string "k230 sdk config"
	default "k230_canmv_01studio_defconfig"
	help
	  canaan k230 SoCs SDK

	  https://github.com/kendryte/k230_linux_sdk/
endif
```

## general/package/comgt/Config.in
```kconfig
config BR2_PACKAGE_COMGT
	bool "comgt"
	default n
	help
	  Comgt is a command line tool for controlling, configuring
	  and interacting with Option Wireless 3G and 2G ( HSDPA, UMTS,
	  EDGE, GPRS, GSM) data devices within the Linux environment.

	  https://sourceforge.net/projects/comgt/
```

## general/package/df_sdwan_edge/Config.in
```kconfig
config BR2_PACKAGE_DF_SDWAN_EDGE
	bool "DataFlow SDWAN Edge"
	depends on BR2_INSTALL_LIBSTDCPP
	depends on BR2_TOOLCHAIN_HAS_THREADS
	default n
	help
	  Edge for Software Defined WAN by DataFlow.

	  https://getdataflow.com/sdwan
	  
comment "DataFlow SDWAN needs a toolchain w/ C++, threads"
	depends on !BR2_INSTALL_LIBSTDCPP || !BR2_TOOLCHAIN_HAS_THREADS
```

## general/package/dropbear-openipc/Config.in
```kconfig
config BR2_PACKAGE_DROPBEAR_OPENIPC
	bool "dropbear-openipc"
	select BR2_PACKAGE_ZLIB if !BR2_PACKAGE_DROPBEAR_OPENIPC_SMALL
	select BR2_PACKAGE_LIBTOMCRYPT if !BR2_PACKAGE_DROPBEAR_OPENIPC_SMALL
	help
	  A small SSH 2 server designed for small memory environments.

	  Note that dropbear requires a per-device unique host key. The
	  key will be generated when dropbear starts, but it is not
	  persistent over reboot (if you have a read-only rootfs) or
	  upgrade (if you have a read-write rootfs). To make the key
	  persistent, replace /etc/dropbear with a symlink to a
	  directory on a persistent, writeable filesystem.
	  Alternatively, mount a persistent unionfs over your root
	  filesystem.

	  https://matt.ucc.asn.au/dropbear/dropbear.html

if BR2_PACKAGE_DROPBEAR_OPENIPC

config BR2_PACKAGE_DROPBEAR_OPENIPC_CLIENT
	bool "client programs"
	default y
	help
	  Provides the programs: dbclient, ssh

	  Note that the following programs are also used server-side
	  and are therefore always build regardless this setting:
	  dropbear, dropbearkey, dropbearconvert, scp

config BR2_PACKAGE_DROPBEAR_OPENIPC_DISABLE_REVERSEDNS
	bool "disable reverse DNS lookups"
	help
	  Disable reverse DNS lookups on connection. This can be handy
	  on systems without working DNS, as connections otherwise
	  stall until DNS times out.

config BR2_PACKAGE_DROPBEAR_OPENIPC_SMALL
	bool "optimize for size"
	default y
	help
	  Compile dropbear for the smallest possible binary size.

	  Tradeoffs are slower hashes and ciphers, and disabling of the
	  blowfish cipher and zlib.

config BR2_PACKAGE_DROPBEAR_OPENIPC_WTMP
	bool "log dropbear access to wtmp"
	help
	  Enable logging of dropbear access to wtmp. Notice that
	  Buildroot does not generate wtmp by default.

config BR2_PACKAGE_DROPBEAR_OPENIPC_LASTLOG
	bool "log dropbear access to lastlog"
	help
	  Enable logging of dropbear access to lastlog. Notice that
	  Buildroot does not generate lastlog by default.

config BR2_PACKAGE_DROPBEAR_OPENIPC_LEGACY_CRYPTO
	bool "enable legacy crypto"
	help
	  Enable legacy and possibly insecure algorithms:
	    3DES encryption
	    SHA1-96 message integrity
	    CBC encryption mode
	    DSA public keys
	    Diffie-Hellman Group1 key exchange

config BR2_PACKAGE_DROPBEAR_OPENIPC_LOCALOPTIONS_FILE
	string "path to custom localoptions.h definitions file"
	help
	  Path to a file whose contents will be appended to Dropbear
	  localoptions.h. It can be used to tweak the Dropbear
	  configuration.

endif
```

## general/package/exfat-openipc/Config.in
```kconfig
config BR2_PACKAGE_EXFAT_OPENIPC
	bool "exfat-openipc"
	help
	  exFAT kernel module

comment "exFAT needs a Linux kernel to be built"
	depends on !BR2_LINUX_KERNEL
```

## general/package/faceter-agent/Config.in
```kconfig
#
# Copyright (c) OpenIPC  https://openipc.org  MIT License
#
# Config.in — Buildroot package Kconfig menu
#
config BR2_PACKAGE_FACETER_AGENT
	bool "Faceter agent"
	help
	  A daemon from Faceter for infrastructure support
```

## general/package/faceter-detector/Config.in
```kconfig
#
# Copyright (c) OpenIPC  https://openipc.org  MIT License
#
# Config.in — Buildroot package Kconfig menu
#
config BR2_PACKAGE_FACETER_DETECTOR
	bool "Faceter detector"
	help
	  A daemon from Faceter for searching humanoids
```

## general/package/fake-hwclock-openipc/Config.in
```kconfig
config BR2_PACKAGE_FAKE_HWCLOCK_OPENIPC
	bool "fake-hwclock-openipc"
	help
	  Restores system time from a file on boot, saves the current time, or periodically updates a timestamp file to maintain time on systems without a hardware RTC.
```

## general/package/fake-hwclock/Config.in
```kconfig
config BR2_PACKAGE_FAKE_HWCLOCK
	bool "fake-hwclock"
	help
	  Restores system time from a file on boot, saves the current time, or periodically updates a timestamp file to maintain time on systems without a hardware RTC.
```

## general/package/fdk-aac-openipc/Config.in
```kconfig
# These are the architectures supported by FDK AAC
config BR2_PACKAGE_FDK_AAC_OPENIPC_ARCH_SUPPORTS
	bool
	default y if BR2_aarch64
	default y if BR2_arm || BR2_armeb
	default y if BR2_i386 || BR2_x86_64
	default y if BR2_mips || BR2_mipsel || BR2_mips64 || BR2_mips64el
	default y if BR2_powerpc
	default y if BR2_sh

config BR2_PACKAGE_FDK_AAC_OPENIPC
	bool "fdk-aac-openipc"
	depends on BR2_PACKAGE_FDK_AAC_OPENIPC_ARCH_SUPPORTS
	depends on BR2_INSTALL_LIBSTDCPP
	help
	  The Fraunhofer FDK AAC Codec Library for Android ("FDK AAC
	  Codec") is software that implements the MPEG Advanced Audio
	  Coding ("AAC") encoding and decoding scheme for digital audio

	  https://github.com/mstorsjo/fdk-aac

comment "fdk-aac needs a toolchain w/ C++"
	depends on BR2_PACKAGE_FDK_AAC_OPENIPC_ARCH_SUPPORTS
	depends on !BR2_INSTALL_LIBSTDCPP
```
