## br-ext-chip-sigmastar/configs/unknown_unknown_msc313e_openipc_defconfig
```kconfig
# OpenIPC configuration
BR2_TOOLCHAIN_BUILDROOT_VENDOR="openipc"
BR2_TARGET_GENERIC_ISSUE="Welcome to OpenIPC v2.2"
BR2_TARGET_GENERIC_HOSTNAME="openipc-msc313e"
BR2_GLOBAL_PATCH_DIR="$(TOPDIR)/../general/package/all-patches"
BR2_ROOTFS_POST_BUILD_SCRIPT="$(TOPDIR)/../scripts/executing_commands_for_$(BR2_TOOLCHAIN_BUILDROOT_LIBC).sh"
```

## br-ext-chip-sigmastar/configs/unknown_unknown_ssc313e_openipc_defconfig
```kconfig
# OpenIPC configuration
BR2_TOOLCHAIN_BUILDROOT_VENDOR="openipc"
BR2_TARGET_GENERIC_ISSUE="Welcome to OpenIPC v2.1.05.12"
BR2_TARGET_GENERIC_HOSTNAME="ipcam"
BR2_GLOBAL_PATCH_DIR="$(TOPDIR)/../general/package/all-patches"
```

## br-ext-chip-sigmastar/configs/unknown_unknown_ssc335_dev_defconfig
```kconfig
# Architecture
BR2_arm=y
BR2_cortex_a7=y
BR2_ARM_EABI=y
BR2_ARM_FPU_NEON_VFPV4=y
BR2_ARM_INSTRUCTIONS_THUMB2=y
BR2_KERNEL_HEADERS_VERSION=y
BR2_DEFAULT_KERNEL_VERSION="4.9.84"
BR2_PACKAGE_HOST_LINUX_HEADERS_CUSTOM_4_9=y

# Toolchain
BR2_GCC_VERSION_8_X=y
# BR2_TOOLCHAIN_USES_UCLIBC is not set
# BR2_TOOLCHAIN_BUILDROOT_UCLIBC is not set
# BR2_TOOLCHAIN_BUILDROOT_LIBC="uclibc"
BR2_TOOLCHAIN_USES_MUSL=y
BR2_TOOLCHAIN_BUILDROOT_MUSL=y
BR2_TOOLCHAIN_BUILDROOT_LIBC="musl"
BR2_TOOLCHAIN_BUILDROOT_LOCALE=y
BR2_TOOLCHAIN_BUILDROOT_USE_SSP=y

# U-Boot
# BR2_TARGET_UBOOT=y
# BR2_TARGET_UBOOT_BOARD_DEFCONFIG="x600"
# BR2_TARGET_UBOOT_BUILD_SYSTEM_KCONFIG=y
# #BR2_TARGET_UBOOT_CUSTOM_VERSION=y
# BR2_TARGET_UBOOT_CUSTOM_VERSION_VALUE="2015.01"
# BR2_TARGET_UBOOT_VERSION="2015.01"
# BR2_TARGET_UBOOT_FORMAT_BIN=y

# Kernel
BR2_LINUX_KERNEL=y
BR2_LINUX_KERNEL_CUSTOM_VERSION=y
BR2_LINUX_KERNEL_CUSTOM_VERSION_VALUE="4.9.84"
BR2_LINUX_KERNEL_USE_CUSTOM_CONFIG=y
BR2_LINUX_KERNEL_CUSTOM_CONFIG_FILE="$(BR2_EXTERNAL_SIGMASTAR_PATH)/board/infinity6b0/kernel/ssc335.generic.config"
BR2_LINUX_KERNEL_UIMAGE=y
BR2_LINUX_KERNEL_XZ=y
BR2_LINUX_KERNEL_EXT_SIGMASTAR_PATCHER=y
BR2_LINUX_KERNEL_EXT_SIGMASTAR_PATCHER_LIST="$(BR2_EXTERNAL_SIGMASTAR_PATH)/board/infinity6b0/kernel/patches/ $(BR2_EXTERNAL_SIGMASTAR_PATH)/board/infinity6b0/kernel/overlay"

# Filesystem
# BR2_TARGET_TZ_INFO is not set
BR2_TARGET_ROOTFS_SQUASHFS=y
BR2_TARGET_ROOTFS_SQUASHFS4_XZ=y
BR2_ROOTFS_OVERLAY="$(TOPDIR)/../general/overlay"

# OpenIPC configuration
BR2_TOOLCHAIN_BUILDROOT_VENDOR="openipc"
BR2_TARGET_GENERIC_ISSUE="Welcome to OpenIPC v21.04.25.1"
BR2_TARGET_GENERIC_HOSTNAME="ipcam"
BR2_GLOBAL_PATCH_DIR="$(TOPDIR)/../general/package/all-patches"

# Packages
BR2_PACKAGE_BUSYBOX_CONFIG="$(TOPDIR)/../general/package/busybox/busybox.config"
BR2_PACKAGE_DROPBEAR=y
BR2_PACKAGE_FWPRINTENV_NG=y
BR2_PACKAGE_SIGMASTAR_OSDRV_SSC335=y
BR2_PACKAGE_IPCTOOL=y
BR2_PACKAGE_JSON_C=y
BR2_PACKAGE_LAME=y
BR2_PACKAGE_LIBEVENT_MINI=y
# BR2_PACKAGE_MAJESTIC is not set
BR2_PACKAGE_MINI_SNMPD=y

# Unused
# BR2_SHARED_STATIC_LIBS is not set
# BR2_PACKAGE_JPEG_TURBO is not set
# BR2_PACKAGE_MINIHTTP is not set
# BR2_PACKAGE_MXML is not set
# BR2_PACKAGE_SSHPASS is not set
# BR2_PACKAGE_RTL8188EU is not set

# Experimental
BR2_PER_PACKAGE_DIRECTORIES=y
BR2_PACKAGE_WIRELESS_TOOLS=y
BR2_PACKAGE_WPA_SUPPLICANT=y
BR2_PACKAGE_WPA_SUPPLICANT_CLI=y
BR2_PACKAGE_WPA_SUPPLICANT_NL80211=y
BR2_PACKAGE_WPA_SUPPLICANT_PASSPHRASE=y

# Firmware
BR2_PACKAGE_LINUX_FIRMWARE=y
BR2_PACKAGE_LINUX_FIRMWARE_MEDIATEK_MT7601U=y
```

## br-ext-chip-sigmastar/package/majestic-ssc335/Config.in
```kconfig
config BR2_PACKAGE_MAJESTIC_SSC335
	bool "Tiny but powerful IPC streaming software"
	default y
	help
	  Tiny but powerful IPC streaming software

	  https://openipc.org
```

## br-ext-chip-xiongmai/configs/unknown_unknown_xm530_unknown_defconfig
```kconfig
# Architecture
BR2_arm=y
BR2_cortex_a5=y
BR2_ARM_INSTRUCTIONS_THUMB2=y
BR2_KERNEL_HEADERS_VERSION=y
BR2_DEFAULT_KERNEL_VERSION="3.10.103"
BR2_PACKAGE_HOST_LINUX_HEADERS_CUSTOM_3_10=y

# Toolchain
# BR2_GCC_VERSION_7_X is not set
# BR2_TOOLCHAIN_USES_UCLIBC is not set
# BR2_TOOLCHAIN_BUILDROOT_UCLIBC is not set
# BR2_TOOLCHAIN_BUILDROOT_LIBC="uclibc"
BR2_TOOLCHAIN_USES_MUSL=y
BR2_TOOLCHAIN_BUILDROOT_MUSL=y
BR2_TOOLCHAIN_BUILDROOT_LIBC="musl"
BR2_TOOLCHAIN_BUILDROOT_LOCALE=y
BR2_TOOLCHAIN_BUILDROOT_USE_SSP=y

# Kernel
BR2_LINUX_KERNEL=y
BR2_LINUX_KERNEL_CUSTOM_VERSION=y
BR2_LINUX_KERNEL_CUSTOM_VERSION_VALUE="3.10.103"
BR2_LINUX_KERNEL_USE_CUSTOM_CONFIG=y
BR2_LINUX_KERNEL_CUSTOM_CONFIG_FILE="$(BR2_EXTERNAL_XIONGMAI_PATH)/board/xm530/kernel/xm530.generic.config"
BR2_LINUX_KERNEL_UIMAGE=y
BR2_LINUX_KERNEL_XZ=y
BR2_LINUX_KERNEL_EXT_XIONGMAI_PATCHER=y
BR2_LINUX_KERNEL_EXT_XIONGMAI_PATCHER_LIST="$(BR2_EXTERNAL_XIONGMAI_PATH)/board/xm530/kernel/patches/ $(BR2_EXTERNAL_XIONGMAI_PATH)/board/xm530/kernel/overlay"

# Filesystem
# BR2_TARGET_TZ_INFO is not set
BR2_TARGET_ROOTFS_SQUASHFS=y
BR2_TARGET_ROOTFS_SQUASHFS4_XZ=y
BR2_ROOTFS_OVERLAY="$(TOPDIR)/../general/overlay"

# OpenIPC configuration
BR2_TOOLCHAIN_BUILDROOT_VENDOR="openipc"
BR2_TARGET_GENERIC_ISSUE="Welcome to OpenIPC v21.04.18.1"
BR2_TARGET_GENERIC_HOSTNAME="ipcam"
BR2_GLOBAL_PATCH_DIR="$(TOPDIR)/../general/package/patches"

# Packages
BR2_PACKAGE_BUSYBOX_CONFIG="$(TOPDIR)/../general/package/configs/busybox.config"
BR2_PACKAGE_DROPBEAR=y
BR2_PACKAGE_FWPRINTENV_NG=y
# BR2_PACKAGE_XIONGMAI_OSDRV_XM530 is not set
BR2_PACKAGE_IPCTOOL=y
BR2_PACKAGE_JSON_C=y
BR2_PACKAGE_LAME=y
BR2_PACKAGE_LIBEVENT_MINI=y
BR2_PACKAGE_MAJESTIC=y
BR2_PACKAGE_MINI_SNMPD=y

# Unused
# BR2_SHARED_STATIC_LIBS is not set
# BR2_PACKAGE_JPEG_TURBO is not set
# BR2_PACKAGE_MINIHTTP is not set
# BR2_PACKAGE_MXML is not set
# BR2_PACKAGE_SSHPASS is not set
# BR2_PACKAGE_RTL8188EU is not set

# Experimental
BR2_PER_PACKAGE_DIRECTORIES=y
BR2_PACKAGE_WIRELESS_TOOLS=y
BR2_PACKAGE_WPA_SUPPLICANT=y
BR2_PACKAGE_WPA_SUPPLICANT_NL80211=y
```

## br-ext-chip-xiongmai/package/majestic-xm510/Config.in
```kconfig
config BR2_PACKAGE_MAJESTIC_XM510
	bool "Tiny but powerful IPC streaming software"
	default y
	help
	  Tiny but powerful IPC streaming software

	  https://openipc.org
```

## br-ext-chip-xiongmai/package/majestic/Config.in
```kconfig
config BR2_PACKAGE_MAJESTIC
	bool "Tiny but powerful IPC streaming software"
	default y
	help
	  Tiny but powerful IPC streaming software

	  https://openipc.org
```

## br-ext-chip-xiongmai/package/xiongmai-osdrv-xm510/Config.in
```kconfig
config BR2_PACKAGE_XIONGMAI_OSDRV_XM510
	bool "xiongmai-osdrv-xm510"
	help
	  xiongmai-osdrv-xm510 - XiongMai kernel modules and libs

	  https://openipc.org
```

## br-ext-chip-xiongmai/package/xiongmai-osdrv2/Config.in
```kconfig
config BR2_PACKAGE_XIONGMAI_OSDRV2
	bool "xiongmai-osdrv2"
	help
	  xiongmai-osdrv2 - XiongMai kernel modules and libs

	  https://openipc.org
```

## general/linux/Config.in
```kconfig
config BR2_LINUX_KERNEL_EXT_VENDOR_PATCHER
	bool "Vendor kernel patcher"
	select BR2_PACKAGE_VENDOR_PATCHER
	help
	  Patch Kernel for vendor boards
```
