## general/package/Config.in
```kconfig
source "$BR2_EXTERNAL_GENERAL_PATH/package/adaptive-link/Config.in"
source "$BR2_EXTERNAL_GENERAL_PATH/package/aic8800-openipc/Config.in"
source "$BR2_EXTERNAL_GENERAL_PATH/package/allwinner-osdrv-v83x/Config.in"
source "$BR2_EXTERNAL_GENERAL_PATH/package/allwinner-osdrv-v85x/Config.in"
source "$BR2_EXTERNAL_GENERAL_PATH/package/atbm-wifi/Config.in"
source "$BR2_EXTERNAL_GENERAL_PATH/package/atbm60xx/Config.in"
source "$BR2_EXTERNAL_GENERAL_PATH/package/aura-httpd/Config.in"
source "$BR2_EXTERNAL_GENERAL_PATH/package/aws-producer/Config.in"
source "$BR2_EXTERNAL_GENERAL_PATH/package/aws-webrtc/Config.in"
source "$BR2_EXTERNAL_GENERAL_PATH/package/baresip-openipc/Config.in"
source "$BR2_EXTERNAL_GENERAL_PATH/package/comgt/Config.in"
source "$BR2_EXTERNAL_GENERAL_PATH/package/divinus/Config.in"
source "$BR2_EXTERNAL_GENERAL_PATH/package/dropbear-openipc/Config.in"
source "$BR2_EXTERNAL_GENERAL_PATH/package/exfat-openipc/Config.in"
source "$BR2_EXTERNAL_GENERAL_PATH/package/f2fs-tools-openipc/Config.in"
source "$BR2_EXTERNAL_GENERAL_PATH/package/fdk-aac-openipc/Config.in"
source "$BR2_EXTERNAL_GENERAL_PATH/package/ffmpeg-openipc/Config.in"
source "$BR2_EXTERNAL_GENERAL_PATH/package/fullhan-osdrv-fh8852v100/Config.in"
source "$BR2_EXTERNAL_GENERAL_PATH/package/fullhan-osdrv-fh8852v200/Config.in"
source "$BR2_EXTERNAL_GENERAL_PATH/package/gdbserver-lite/Config.in"
source "$BR2_EXTERNAL_GENERAL_PATH/package/go2rtc/Config.in"
source "$BR2_EXTERNAL_GENERAL_PATH/package/goke-osdrv-gk710x/Config.in"
source "$BR2_EXTERNAL_GENERAL_PATH/package/goke-osdrv-gk7205v200/Config.in"
source "$BR2_EXTERNAL_GENERAL_PATH/package/goke-osdrv-gk7205v500/Config.in"
source "$BR2_EXTERNAL_GENERAL_PATH/package/gpio-motors/Config.in"
source "$BR2_EXTERNAL_GENERAL_PATH/package/grainmedia-osdrv-gm8136/Config.in"
source "$BR2_EXTERNAL_GENERAL_PATH/package/hisi-gpio/Config.in"
source "$BR2_EXTERNAL_GENERAL_PATH/package/hisilicon-opensdk/Config.in"
source "$BR2_EXTERNAL_GENERAL_PATH/package/hisilicon-osdrv-hi3516av100/Config.in"
source "$BR2_EXTERNAL_GENERAL_PATH/package/hisilicon-osdrv-hi3516cv100/Config.in"
source "$BR2_EXTERNAL_GENERAL_PATH/package/hisilicon-osdrv-hi3516cv200/Config.in"
source "$BR2_EXTERNAL_GENERAL_PATH/package/hisilicon-osdrv-hi3516cv300/Config.in"
source "$BR2_EXTERNAL_GENERAL_PATH/package/hisilicon-osdrv-hi3516cv500/Config.in"
source "$BR2_EXTERNAL_GENERAL_PATH/package/hisilicon-osdrv-hi3516ev200/Config.in"
source "$BR2_EXTERNAL_GENERAL_PATH/package/hisilicon-osdrv-hi3519v101/Config.in"
source "$BR2_EXTERNAL_GENERAL_PATH/package/hisilicon-osdrv-hi3536dv100/Config.in"
source "$BR2_EXTERNAL_GENERAL_PATH/package/i2c-telemetry/Config.in"
source "$BR2_EXTERNAL_GENERAL_PATH/package/ingenic-opensdk/Config.in"
source "$BR2_EXTERNAL_GENERAL_PATH/package/ingenic-osdrv-t20/Config.in"
source "$BR2_EXTERNAL_GENERAL_PATH/package/ingenic-osdrv-t21/Config.in"
source "$BR2_EXTERNAL_GENERAL_PATH/package/ingenic-osdrv-t23/Config.in"
source "$BR2_EXTERNAL_GENERAL_PATH/package/ingenic-osdrv-t30/Config.in"
source "$BR2_EXTERNAL_GENERAL_PATH/package/ingenic-osdrv-t31/Config.in"
source "$BR2_EXTERNAL_GENERAL_PATH/package/ingenic-osdrv-t40/Config.in"
source "$BR2_EXTERNAL_GENERAL_PATH/package/ipctool/Config.in"
source "$BR2_EXTERNAL_GENERAL_PATH/package/jsonfilter/Config.in"
source "$BR2_EXTERNAL_GENERAL_PATH/package/lame-openipc/Config.in"
source "$BR2_EXTERNAL_GENERAL_PATH/package/libcurl-openipc/Config.in"
source "$BR2_EXTERNAL_GENERAL_PATH/package/libevent-openipc/Config.in"
source "$BR2_EXTERNAL_GENERAL_PATH/package/libhv-openipc/Config.in"
source "$BR2_EXTERNAL_GENERAL_PATH/package/libjpeg-openipc/Config.in"
source "$BR2_EXTERNAL_GENERAL_PATH/package/libogg-openipc/Config.in"
source "$BR2_EXTERNAL_GENERAL_PATH/package/libre-openipc/Config.in"
source "$BR2_EXTERNAL_GENERAL_PATH/package/libsrt-openipc/Config.in"
source "$BR2_EXTERNAL_GENERAL_PATH/package/libsrtp-openipc/Config.in"
source "$BR2_EXTERNAL_GENERAL_PATH/package/libwebsockets-openipc/Config.in"
source "$BR2_EXTERNAL_GENERAL_PATH/package/linux-firmware-openipc/Config.in"
source "$BR2_EXTERNAL_GENERAL_PATH/package/linux-patcher/Config.in"
source "$BR2_EXTERNAL_GENERAL_PATH/package/majestic-fonts/Config.in"
source "$BR2_EXTERNAL_GENERAL_PATH/package/majestic-webui/Config.in"
source "$BR2_EXTERNAL_GENERAL_PATH/package/majestic/Config.in"
source "$BR2_EXTERNAL_GENERAL_PATH/package/mavfwd/Config.in"
source "$BR2_EXTERNAL_GENERAL_PATH/package/mbedtls-openipc/Config.in"
source "$BR2_EXTERNAL_GENERAL_PATH/package/mini/Config.in"
source "$BR2_EXTERNAL_GENERAL_PATH/package/motors/Config.in"
source "$BR2_EXTERNAL_GENERAL_PATH/package/msposd/Config.in"
source "$BR2_EXTERNAL_GENERAL_PATH/package/mt7601u-openipc/Config.in"
source "$BR2_EXTERNAL_GENERAL_PATH/package/nabto/Config.in"
source "$BR2_EXTERNAL_GENERAL_PATH/package/node-exporter/Config.in"
source "$BR2_EXTERNAL_GENERAL_PATH/package/novatek-osdrv-nt9856x/Config.in"
source "$BR2_EXTERNAL_GENERAL_PATH/package/onvif-simple-server/Config.in"
source "$BR2_EXTERNAL_GENERAL_PATH/package/opus-openipc/Config.in"
source "$BR2_EXTERNAL_GENERAL_PATH/package/osd-openipc/Config.in"
source "$BR2_EXTERNAL_GENERAL_PATH/package/quirc-openipc/Config.in"
source "$BR2_EXTERNAL_GENERAL_PATH/package/rockchip-osdrv-rv11xx/Config.in"
source "$BR2_EXTERNAL_GENERAL_PATH/package/rtl8188eus-openipc/Config.in"
source "$BR2_EXTERNAL_GENERAL_PATH/package/rtl8188fu-openipc/Config.in"
source "$BR2_EXTERNAL_GENERAL_PATH/package/rtl8188fu-openipc/Config.in"
source "$BR2_EXTERNAL_GENERAL_PATH/package/rtl8189es-openipc/Config.in"
source "$BR2_EXTERNAL_GENERAL_PATH/package/rtl8189fs-openipc/Config.in"
source "$BR2_EXTERNAL_GENERAL_PATH/package/rtl8192eu-openipc/Config.in"
source "$BR2_EXTERNAL_GENERAL_PATH/package/rtl8733bu-openipc/Config.in"
source "$BR2_EXTERNAL_GENERAL_PATH/package/rtl8811cu-openipc/Config.in"
source "$BR2_EXTERNAL_GENERAL_PATH/package/rtl8812au-openipc/Config.in"
source "$BR2_EXTERNAL_GENERAL_PATH/package/rtl8812au/Config.in"
source "$BR2_EXTERNAL_GENERAL_PATH/package/rtl88x2eu-openipc/Config.in"
source "$BR2_EXTERNAL_GENERAL_PATH/package/rtw-hostapd/Config.in"
source "$BR2_EXTERNAL_GENERAL_PATH/package/rubyfpv/Config.in"
source "$BR2_EXTERNAL_GENERAL_PATH/package/sigmastar-osdrv-infinity6/Config.in"
source "$BR2_EXTERNAL_GENERAL_PATH/package/sigmastar-osdrv-infinity6b0/Config.in"
source "$BR2_EXTERNAL_GENERAL_PATH/package/sigmastar-osdrv-infinity6c/Config.in"
source "$BR2_EXTERNAL_GENERAL_PATH/package/sigmastar-osdrv-infinity6e/Config.in"
source "$BR2_EXTERNAL_GENERAL_PATH/package/sigmastar-osdrv-sensors/Config.in"
source "$BR2_EXTERNAL_GENERAL_PATH/package/ssv615x-openipc/Config.in"
source "$BR2_EXTERNAL_GENERAL_PATH/package/ssv635x-openipc/Config.in"
source "$BR2_EXTERNAL_GENERAL_PATH/package/ssw101b/Config.in"
source "$BR2_EXTERNAL_GENERAL_PATH/package/uacme-openipc/Config.in"
source "$BR2_EXTERNAL_GENERAL_PATH/package/uqmi-openipc/Config.in"
source "$BR2_EXTERNAL_GENERAL_PATH/package/usrsctp/Config.in"
source "$BR2_EXTERNAL_GENERAL_PATH/package/vdec-openipc/Config.in"
source "$BR2_EXTERNAL_GENERAL_PATH/package/venc-openipc/Config.in"
source "$BR2_EXTERNAL_GENERAL_PATH/package/vtund-openipc/Config.in"
source "$BR2_EXTERNAL_GENERAL_PATH/package/w1-ds18b20/Config.in"
source "$BR2_EXTERNAL_GENERAL_PATH/package/webrtc-audio-processing-openipc/Config.in"
source "$BR2_EXTERNAL_GENERAL_PATH/package/wifibroadcast-ng/Config.in"
source "$BR2_EXTERNAL_GENERAL_PATH/package/wq9001/Config.in"
source "$BR2_EXTERNAL_GENERAL_PATH/package/xiongmai-opensdk-xm510/Config.in"
source "$BR2_EXTERNAL_GENERAL_PATH/package/xiongmai-osdrv-xm510/Config.in"
source "$BR2_EXTERNAL_GENERAL_PATH/package/xiongmai-osdrv-xm530/Config.in"
source "$BR2_EXTERNAL_GENERAL_PATH/package/xmdp/Config.in"
source "$BR2_EXTERNAL_GENERAL_PATH/package/yaml-cli/Config.in"
source "$BR2_EXTERNAL_GENERAL_PATH/package/zerotier-one/Config.in"

# Legacy
source "$BR2_EXTERNAL_GENERAL_PATH/package/legacy/ambarella-osdrv-s3l/Config.in"
source "$BR2_EXTERNAL_GENERAL_PATH/package/legacy/autonight/Config.in"
source "$BR2_EXTERNAL_GENERAL_PATH/package/legacy/capjpeg/Config.in"
source "$BR2_EXTERNAL_GENERAL_PATH/package/legacy/datalink/Config.in"
source "$BR2_EXTERNAL_GENERAL_PATH/package/legacy/gk7205v200-motors/Config.in"
source "$BR2_EXTERNAL_GENERAL_PATH/package/legacy/gst1-plugins-bad-openipc/Config.in"
source "$BR2_EXTERNAL_GENERAL_PATH/package/legacy/hisilicon-osdrv-serdes/Config.in"
source "$BR2_EXTERNAL_GENERAL_PATH/package/legacy/hisilicon-osdrv1-sources/Config.in"
source "$BR2_EXTERNAL_GENERAL_PATH/package/legacy/lshell/Config.in"
source "$BR2_EXTERNAL_GENERAL_PATH/package/legacy/majestic-plugins/Config.in"
source "$BR2_EXTERNAL_GENERAL_PATH/package/legacy/mavlink-router/Config.in"
source "$BR2_EXTERNAL_GENERAL_PATH/package/legacy/microsnander/Config.in"
source "$BR2_EXTERNAL_GENERAL_PATH/package/legacy/mini-snmpd-openipc/Config.in"
source "$BR2_EXTERNAL_GENERAL_PATH/package/legacy/rcjoystick/Config.in"
source "$BR2_EXTERNAL_GENERAL_PATH/package/legacy/sigmastar-motors/Config.in"
source "$BR2_EXTERNAL_GENERAL_PATH/package/legacy/sigmastar-osdrv-msc313e/Config.in"
source "$BR2_EXTERNAL_GENERAL_PATH/package/legacy/webui/Config.in"
source "$BR2_EXTERNAL_GENERAL_PATH/package/legacy/wifibroadcast/Config.in"
```

## general/package/aalink-idr5/Config.in
```kconfig
config BR2_PACKAGE_AALINK_IDR5
	bool "aalink-idr5"
	default n
	help
	  Builds the aalink IDR helper from the public sickgreg/aalink_idr5
	  repo and installs the helper binary and service script.
```

## general/package/aalink/Config.in
```kconfig
config BR2_PACKAGE_AALINK
	bool "aalink"
	default n
	help
	  Builds the aalink daemon from the public sickgreg/aalink repo and
	  installs the aalink binary, config, and service script.
```

## general/package/aic8800-openipc/Config.in
```kconfig
config BR2_PACKAGE_AIC8800_OPENIPC
	bool "aic8800-openipc"
	depends on BR2_LINUX_KERNEL
	help
	  AIC8800 wireless driver
```

## general/package/air-man-ap/Config.in
```kconfig
config BR2_PACKAGE_AIR_MAN_AP
	bool "air-man-ap"
	default n
	help
	  Builds the air_man_ap daemon from the public sickgreg/air_man_ap
	  repo and installs its binary, sensor mode files, and service script.
```

## general/package/allwinner-osdrv-v83x/Config.in
```kconfig
config BR2_PACKAGE_ALLWINNER_OSDRV_V83X
	bool "allwinner-osdrv-v83x"
	help
	  allwinner-osdrv-v83x - Allwinner kernel modules and libs

	  https://openipc.org
```

## general/package/allwinner-osdrv-v85x/Config.in
```kconfig
config BR2_PACKAGE_ALLWINNER_OSDRV_V85X
	bool "allwinner-osdrv-v85x"
	help
	  Allwinner v85x libraries
```

## general/package/antmedia-gstreamer-webrtc/Config.in
```kconfig
config BR2_PACKAGE_ANTMEDIA_GSTREAMER_WEBRTC
	bool "antmedia-gstreamer-webrtc"
	help
	  This program will help you to connect AntMedia to Gstreamer.
```

## general/package/ap-alink/Config.in
```kconfig
config BR2_PACKAGE_AP_ALINK
    bool "ap-alink"
    help
      ap-alink is adaptive link vers 1.2 for apfpv
      and other wifi link application
    
```
