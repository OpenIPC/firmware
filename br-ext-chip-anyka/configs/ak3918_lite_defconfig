## general/Config.in
```kconfig
config BR2_OPENIPC_SOC_VENDOR
	string "SoC vendor"

config BR2_OPENIPC_SOC_MODEL
	string "SoC model"

config BR2_OPENIPC_SOC_ALIASES
	string "Interchangeable SoC ids served by this image"
	help
	  Space-separated retired/hardware-compatible SoC ids that this build's
	  SOC_MODEL also serves (e.g. "hi3516cv610 hi3516cv608" on the cv6xx
	  image, or "xm550" on the xm530 image). Read by
	  .github/scripts/enrich_manifest.py to emit @alias records so on-device
	  sysupgrade routes a camera still reporting the old id to the image
	  actually published under SOC_MODEL.

config BR2_OPENIPC_SOC_FAMILY
	string "SoC family"

config BR2_OPENIPC_SNS_MODEL
	string "Sensor model"

config BR2_OPENIPC_VARIANT
	string "OpenIPC variant"

config BR2_OPENIPC_FLASH_SIZE
	string "OpenIPC flash size"

config BR2_OPENIPC_NOR_FIRMWARE_OFFSET
	hex "Where the NOR firmware partition starts"
	default 0x50000
	help
	  The split NOR layout's "firmware" partition (firmware.bin: the uImage,
	  then the squashfs) starts here, after the boot area and the U-Boot
	  environment, and runs to the end of the chip. 0x50000 is 256K of
	  boot + 64K of environment; a SoC whose signed boot image is larger
	  sets its own (hi3519dv500: 512K + 256K, 0xC0000).

config BR2_OPENIPC_NOR_KERNEL_READ_SIZE
	hex "How much of the firmware partition a bootloader reads to boot"
	default 0x200000
	help
	  The split image boots under any bootloader that reads a uImage from
	  the start of the firmware partition and bootm's it, and the ones in
	  the field read a fixed amount there: 2 MiB, the fixed-slot kernel
	  slot (hi3516cv6xx's published U-Boot until it scanned the flash, and
	  vendor ones); 6 MiB on hi3519dv500's. A uImage larger than this is
	  read short by them and fails its CRC, so the build refuses it.

config BR2_OPENIPC_NOR_FIXED_PACKAGE
	bool "Also ship the fixed-slot NOR package"
	help
	  Next to the split package, ship uImage and rootfs.squashfs as the
	  plain fixed-slot package (a 2 MiB kernel slot, then the rootfs), for
	  cameras whose sysupgrade predates the split layout. Both must fit
	  their slots.

config BR2_OPENIPC_MAJESTIC
	string "OpenIPC Majestic"
	default "lite"

source "$BR2_EXTERNAL_GENERAL_PATH/package/Config.in"
```

## general/package/anyka-osdrv-ak3918av100/Config.in
```kconfig
config BR2_PACKAGE_ANYKA_OSDRV_AK3918AV100
	bool "anyka-osdrv-ak3918av100"
	depends on BR2_LINUX_KERNEL
	help
	  anyka-osdrv-ak3918av100 - Anyka AK3918AV100 family kernel
	  modules, prebuilt for the 4.4.282 kernel: ISP, video encoder,
	  ION, I2C, audio, SD, USB host, Ethernet and the sensor drivers,
	  and the load_anyka script that brings them up. The AK3918AV100
	  (N/P/X/XP, KM01N/KM01D) gets the AnyCloud39AV100 SDK V1.12's
	  modules, the AK3918EV300L those of an EV300L camera.

	  https://github.com/KD0000001/ak3918av100
```

## general/package/anyka-osdrv-ak3918av130/Config.in
```kconfig
config BR2_PACKAGE_ANYKA_OSDRV_AK3918AV130
	bool "anyka-osdrv-ak3918av130"
	depends on BR2_LINUX_KERNEL
	help
	  anyka-osdrv-ak3918av130 - Anyka AK3918AV130 kernel modules: ISP,
	  video encoder, audio, Ethernet, SD card and the sensor drivers,
	  as shipped prebuilt for 4.4.302-cip94 in the AnyCloud39AV130 SDK,
	  and the load_anyka script that brings them up.

	  https://openipc.org
```

## general/package/anyka-osdrv-ak3918ev200/Config.in
```kconfig
config BR2_PACKAGE_ANYKA_OSDRV_AK3918EV200
	bool "anyka-osdrv-ak3918ev200"
	depends on BR2_LINUX_KERNEL
	help
	  Anyka AK3918EV200 support files: the sensors' ISP tuning in
	  /etc/sensor, which the kernel's ISP driver loads by sensor name,
	  and the load_anyka script that keeps the bootloader's video
	  memory split (osmem, rmem) in the form the kernel expects.
	  The drivers themselves are built into the kernel.

	  https://openipc.org
```

## general/package/anyka-osdrv-ak3918ev300/Config.in
```kconfig
config BR2_PACKAGE_ANYKA_OSDRV_AK3918EV300
	bool "anyka-osdrv-ak3918ev300"
	depends on BR2_LINUX_KERNEL
	help
	  Anyka AK3918EV300 (and AK3916EV300) support files: the sensors'
	  ISP tuning in /etc/sensor, which the kernel's ISP driver loads by
	  sensor name. The drivers themselves are built into the kernel.

	  https://openipc.org
```

## general/package/arc-binutils/Config.in
```kconfig
config BR2_PACKAGE_HOST_ARC_BINUTILS
	bool
	help
	  GNU assembler and linker for bare-metal ARC (arc-elf32), to
	  build coprocessor firmware. Same sources as Buildroot's
	  binutils.

	  https://www.gnu.org/software/binutils/
```

## general/package/atbm603x-comb-openipc/Config.in
```kconfig
config BR2_PACKAGE_ATBM603X_COMB_OPENIPC
	bool "atbm603x-comb-openipc"
	depends on BR2_LINUX_KERNEL
	help
	  AltoBeam USB Wi-Fi driver for the ATBM6012B-X/Y and 6032-X
	  (AsmLite) and the ATBM603x (Ares-B), firmware built in;
	  binds 007a:888b and 007a:8888. Needs the kernel's cfg80211.
```

## general/package/atbm606x-openipc/Config.in
```kconfig
config BR2_PACKAGE_ATBM606X_OPENIPC
	bool "atbm606x-openipc"
	depends on BR2_LINUX_KERNEL
	help
	  AltoBeam Wi-Fi 6 USB driver for the ATBM6062, ATBM6062-C,
	  ATBM6162 and ATBM6132-C (Cronus, Oceanus, Cronus Lite), firmware
	  built in. It brings its own cfg80211 and mac80211, so the kernel's
	  CONFIG_CFG80211 and CONFIG_MAC80211 must be off.
```
