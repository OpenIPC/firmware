## br-ext-chip-anyka/configs/ak3918_lite_defconfig
```kconfig
# Architecture
BR2_arm=y

# Toolchain
BR2_TOOLCHAIN_EXTERNAL=y
BR2_TOOLCHAIN_EXTERNAL_CUSTOM=y
BR2_TOOLCHAIN_EXTERNAL_DOWNLOAD=y
BR2_TOOLCHAIN_EXTERNAL_URL="https://github.com/openipc/firmware/releases/download/$(OPENIPC_TOOLCHAIN).tgz"
BR2_TOOLCHAIN_EXTERNAL_CUSTOM_PREFIX="arm-openipc-linux-musleabi"
BR2_TOOLCHAIN_EXTERNAL_HEADERS_4_4=y
BR2_TOOLCHAIN_EXTERNAL_CUSTOM_MUSL=y
BR2_TOOLCHAIN_EXTERNAL_CXX=y

# Kernel
BR2_LINUX_KERNEL=y
BR2_LINUX_KERNEL_CUSTOM_TARBALL=y
BR2_LINUX_KERNEL_CUSTOM_TARBALL_LOCATION="https://github.com/openipc/linux/archive/$(OPENIPC_KERNEL).tar.gz"
BR2_LINUX_KERNEL_USE_CUSTOM_CONFIG=y
BR2_LINUX_KERNEL_CUSTOM_CONFIG_FILE="$(EXTERNAL_VENDOR)/board/$(OPENIPC_SOC_FAMILY)/ak3918.generic.config"
# The uImage is the zImage with the board's DTB appended
# (CONFIG_ARM_APPENDED_DTB), built by the kernel itself as on hisilicon.
BR2_LINUX_KERNEL_UIMAGE=y
BR2_LINUX_KERNEL_UIMAGE_LOADADDR="0x81008000"
BR2_LINUX_KERNEL_XZ=y

# Filesystem
BR2_PACKAGE_BUSYBOX_CONFIG="$(BR2_EXTERNAL)/package/busybox/busybox.config"
BR2_PACKAGE_UBOOT_TOOLS=y
BR2_PACKAGE_ZLIB=y
BR2_PACKAGE_LIBV4L=y
BR2_PACKAGE_LIBV4L_UTILS=y
# BR2_PACKAGE_IFUPDOWN_SCRIPTS is not set
BR2_PACKAGE_WIRELESS_TOOLS=y
BR2_PACKAGE_WPA_SUPPLICANT=y
BR2_PACKAGE_WPA_SUPPLICANT_CLI=y
BR2_PACKAGE_WPA_SUPPLICANT_PASSPHRASE=y
BR2_TARGET_ROOTFS_CPIO=y
BR2_TARGET_ROOTFS_SQUASHFS=y
BR2_TARGET_ROOTFS_SQUASHFS4_XZ=y

# OpenIPC
BR2_OPENIPC_SOC_VENDOR="anyka"
BR2_OPENIPC_SOC_MODEL="ak3918"
# The first AK39 generation (Aimer39). AK3916 is the same die in a smaller
# package and the SDK builds both from one board description.
BR2_OPENIPC_SOC_ALIASES="ak3916"
BR2_OPENIPC_SOC_FAMILY="ak3918ev300"
BR2_OPENIPC_VARIANT="lite"
BR2_OPENIPC_FLASH_SIZE="8"

# Packages
BR2_PACKAGE_DROPBEAR_OPENIPC=y
BR2_PACKAGE_IPCTOOL=y
BR2_PACKAGE_LIBCURL_OPENIPC=y
BR2_PACKAGE_LIBCURL_OPENIPC_CURL=y
# BR2_PACKAGE_LIBCURL_OPENIPC_PROXY_SUPPORT is not set
# BR2_PACKAGE_LIBCURL_OPENIPC_COOKIES_SUPPORT is not set
# BR2_PACKAGE_LIBCURL_OPENIPC_EXTRA_PROTOCOLS_FEATURES is not set
BR2_PACKAGE_LIBEVENT_OPENIPC=y
BR2_PACKAGE_LIBOGG_OPENIPC=y
BR2_PACKAGE_LINUX_FIRMWARE_OPENIPC=y
BR2_PACKAGE_LINUX_FIRMWARE_OPENIPC_MEDIATEK_MT7601U=y
BR2_PACKAGE_LINUX_FIRMWARE_OPENIPC_RTL_8188EU=y
BR2_PACKAGE_MAJESTIC_WEBUI=y
BR2_PACKAGE_MBEDTLS_OPENIPC=y
BR2_PACKAGE_MOTORS=y
BR2_PACKAGE_OPUS_OPENIPC=y
# USB RTL8188FU (0bda:f179), which r8188eu binds but cannot tune.
BR2_PACKAGE_RTL8188FU_OPENIPC=y
BR2_PACKAGE_RDA5995_OPENIPC=y
BR2_PACKAGE_VTUND_OPENIPC=y
BR2_PACKAGE_YAML_CLI=y
```

## br-ext-chip-anyka/configs/ak3918ev200_lite_defconfig
```kconfig
# Architecture
BR2_arm=y

# Toolchain
BR2_TOOLCHAIN_EXTERNAL=y
BR2_TOOLCHAIN_EXTERNAL_CUSTOM=y
BR2_TOOLCHAIN_EXTERNAL_DOWNLOAD=y
BR2_TOOLCHAIN_EXTERNAL_URL="https://github.com/openipc/firmware/releases/download/$(OPENIPC_TOOLCHAIN).tgz"
BR2_TOOLCHAIN_EXTERNAL_CUSTOM_PREFIX="arm-openipc-linux-musleabi"
BR2_TOOLCHAIN_EXTERNAL_HEADERS_4_4=y
BR2_TOOLCHAIN_EXTERNAL_CUSTOM_MUSL=y
BR2_TOOLCHAIN_EXTERNAL_CXX=y

# Kernel
BR2_LINUX_KERNEL=y
BR2_LINUX_KERNEL_CUSTOM_TARBALL=y
BR2_LINUX_KERNEL_CUSTOM_TARBALL_LOCATION="https://github.com/openipc/linux/archive/$(OPENIPC_KERNEL).tar.gz"
BR2_LINUX_KERNEL_USE_CUSTOM_CONFIG=y
BR2_LINUX_KERNEL_CUSTOM_CONFIG_FILE="$(EXTERNAL_VENDOR)/board/$(OPENIPC_SOC_FAMILY)/ak3918ev200.generic.config"
# The uImage is the zImage with the board's DTB appended
# (CONFIG_ARM_APPENDED_DTB), built by the kernel itself as on hisilicon.
BR2_LINUX_KERNEL_UIMAGE=y
BR2_LINUX_KERNEL_UIMAGE_LOADADDR="0x81808000"
BR2_LINUX_KERNEL_XZ=y

# Filesystem
BR2_PACKAGE_BUSYBOX_CONFIG="$(BR2_EXTERNAL)/package/busybox/busybox.config"
BR2_PACKAGE_UBOOT_TOOLS=y
BR2_PACKAGE_ZLIB=y
# BR2_PACKAGE_IFUPDOWN_SCRIPTS is not set
BR2_PACKAGE_WIRELESS_TOOLS=y
BR2_PACKAGE_WPA_SUPPLICANT=y
BR2_PACKAGE_WPA_SUPPLICANT_CLI=y
BR2_PACKAGE_WPA_SUPPLICANT_PASSPHRASE=y
BR2_TARGET_ROOTFS_CPIO=y
BR2_TARGET_ROOTFS_SQUASHFS=y
BR2_TARGET_ROOTFS_SQUASHFS4_XZ=y

# OpenIPC
BR2_OPENIPC_SOC_VENDOR="anyka"
BR2_OPENIPC_SOC_MODEL="ak3918ev200"
# What ipcinfo -c reports here: the kernel's Hardware line is the board
# name, Cloud39EV2_AK3918E80PIN_MNBD.
BR2_OPENIPC_SOC_ALIASES="ak3918e80pin"
BR2_OPENIPC_SOC_FAMILY="ak3918ev300"
BR2_OPENIPC_VARIANT="lite"
BR2_OPENIPC_FLASH_SIZE="8"

# Packages
BR2_PACKAGE_DROPBEAR_OPENIPC=y
BR2_PACKAGE_IPCTOOL=y
BR2_PACKAGE_LIBCURL_OPENIPC=y
BR2_PACKAGE_LIBCURL_OPENIPC_CURL=y
# BR2_PACKAGE_LIBCURL_OPENIPC_PROXY_SUPPORT is not set
# BR2_PACKAGE_LIBCURL_OPENIPC_COOKIES_SUPPORT is not set
# BR2_PACKAGE_LIBCURL_OPENIPC_EXTRA_PROTOCOLS_FEATURES is not set
BR2_PACKAGE_LIBEVENT_OPENIPC=y
BR2_PACKAGE_LIBOGG_OPENIPC=y
BR2_PACKAGE_LINUX_FIRMWARE_OPENIPC=y
BR2_PACKAGE_LINUX_FIRMWARE_OPENIPC_MEDIATEK_MT7601U=y
BR2_PACKAGE_LINUX_FIRMWARE_OPENIPC_RTL_8188EU=y
BR2_PACKAGE_MAJESTIC_WEBUI=y
BR2_PACKAGE_MBEDTLS_OPENIPC=y
BR2_PACKAGE_MOTORS=y
BR2_PACKAGE_OPUS_OPENIPC=y
# Anyka cameras without Ethernet, the TECKIN TC100 among them, carry an
# RTL8188FU (0bda:f179), which r8188eu binds but cannot tune (#2639).
BR2_PACKAGE_RTL8188FU_OPENIPC=y
BR2_PACKAGE_VTUND_OPENIPC=y
BR2_PACKAGE_YAML_CLI=y
```

## br-ext-chip-axera/configs/ax620e_lite_defconfig
```kconfig
# OpenIPC
#
# Axera AX620E / AX630C (Cortex-A53, aarch64).
#
BR2_OPENIPC_SOC_VENDOR="axera"
BR2_OPENIPC_SOC_MODEL="ax620e"
BR2_OPENIPC_SOC_FAMILY="ax620e"
BR2_OPENIPC_VARIANT="lite"
BR2_OPENIPC_FLASH_SIZE="16"

# Architecture (aarch64 Cortex-A53)
BR2_aarch64=y
BR2_cortex_a53=y

# Toolchain -- aarch64 musl, 5.15 kernel headers
BR2_TOOLCHAIN_EXTERNAL=y
BR2_TOOLCHAIN_EXTERNAL_CUSTOM=y
BR2_TOOLCHAIN_EXTERNAL_DOWNLOAD=y
BR2_TOOLCHAIN_EXTERNAL_URL="https://github.com/openipc/firmware/releases/download/$(OPENIPC_TOOLCHAIN).tgz"
BR2_TOOLCHAIN_EXTERNAL_CUSTOM_PREFIX="aarch64-openipc-linux-musl"
BR2_TOOLCHAIN_EXTERNAL_HEADERS_5_15=y
BR2_TOOLCHAIN_EXTERNAL_CUSTOM_MUSL=y
BR2_GCC_VERSION_13_X=y
BR2_TOOLCHAIN_EXTERNAL_CXX=y

# Kernel
BR2_LINUX_KERNEL=y
BR2_LINUX_KERNEL_CUSTOM_TARBALL=y
BR2_LINUX_KERNEL_CUSTOM_TARBALL_LOCATION="https://github.com/openipc/linux/archive/$(OPENIPC_KERNEL).tar.gz"
BR2_LINUX_KERNEL_USE_CUSTOM_CONFIG=y
BR2_LINUX_KERNEL_CUSTOM_CONFIG_FILE="$(EXTERNAL_VENDOR)/board/$(OPENIPC_SOC_FAMILY)/ax620e.lite.config"
BR2_LINUX_KERNEL_IMAGE=y
BR2_LINUX_KERNEL_XZ=y

# Filesystem
BR2_PACKAGE_BUSYBOX_CONFIG="$(BR2_EXTERNAL)/package/busybox/busybox.config"
BR2_PACKAGE_EXFATPROGS=y
BR2_PACKAGE_UBOOT_TOOLS=y
BR2_PACKAGE_ZLIB=y
BR2_TARGET_ROOTFS_CPIO=y
BR2_TARGET_ROOTFS_SQUASHFS=y
BR2_TARGET_ROOTFS_SQUASHFS4_XZ=y

# Packages
BR2_PACKAGE_AXERA_OSDRV_AX620E=y
BR2_PACKAGE_DROPBEAR_OPENIPC=y
BR2_PACKAGE_IPCTOOL=y
BR2_PACKAGE_LIBCURL_OPENIPC=y
BR2_PACKAGE_LIBEVENT_OPENIPC=y
BR2_PACKAGE_MAJESTIC_FONTS=y
BR2_PACKAGE_MAJESTIC_WEBUI=y
BR2_PACKAGE_MAJESTIC=y
BR2_PACKAGE_MBEDTLS_OPENIPC=y
BR2_PACKAGE_YAML_CLI=y
```

## br-ext-chip-axera/configs/ax620u_lite_defconfig
```kconfig
# OpenIPC
#
# Axera AX620U (Cortex-A7 x4, AArch32).
#
BR2_OPENIPC_SOC_VENDOR="axera"
BR2_OPENIPC_SOC_MODEL="ax620u"
BR2_OPENIPC_SOC_FAMILY="ax620u"
BR2_OPENIPC_VARIANT="lite"
BR2_OPENIPC_FLASH_SIZE="16"

# Architecture (Cortex-A7, AArch32)
BR2_arm=y
BR2_cortex_a7=y
BR2_ARM_FPU_NEON_VFPV4=y
BR2_ARM_INSTRUCTIONS_THUMB2=y

# Toolchain -- arm musleabihf, 4.19 kernel headers
BR2_TOOLCHAIN_EXTERNAL=y
BR2_TOOLCHAIN_EXTERNAL_CUSTOM=y
BR2_TOOLCHAIN_EXTERNAL_DOWNLOAD=y
BR2_TOOLCHAIN_EXTERNAL_URL="https://github.com/openipc/firmware/releases/download/$(OPENIPC_TOOLCHAIN).tgz"
BR2_TOOLCHAIN_EXTERNAL_CUSTOM_PREFIX="arm-openipc-linux-musleabihf"
BR2_TOOLCHAIN_EXTERNAL_HEADERS_4_19=y
BR2_TOOLCHAIN_EXTERNAL_CUSTOM_MUSL=y
BR2_TOOLCHAIN_EXTERNAL_CXX=y

# Kernel
BR2_LINUX_KERNEL=y
BR2_LINUX_KERNEL_CUSTOM_TARBALL=y
BR2_LINUX_KERNEL_CUSTOM_TARBALL_LOCATION="https://github.com/openipc/linux/archive/$(OPENIPC_KERNEL).tar.gz"
BR2_LINUX_KERNEL_USE_CUSTOM_CONFIG=y
BR2_LINUX_KERNEL_CUSTOM_CONFIG_FILE="$(EXTERNAL_VENDOR)/board/$(OPENIPC_SOC_FAMILY)/ax620u.lite.config"
BR2_LINUX_KERNEL_UIMAGE=y
BR2_LINUX_KERNEL_XZ=y

# Filesystem
BR2_PACKAGE_BUSYBOX_CONFIG="$(BR2_EXTERNAL)/package/busybox/busybox.config"
BR2_PACKAGE_EXFATPROGS=y
BR2_PACKAGE_UBOOT_TOOLS=y
BR2_PACKAGE_ZLIB=y
BR2_TARGET_ROOTFS_CPIO=y
BR2_TARGET_ROOTFS_SQUASHFS=y
BR2_TARGET_ROOTFS_SQUASHFS4_XZ=y

# Packages
BR2_PACKAGE_AXERA_OSDRV_AX620U=y
BR2_PACKAGE_DROPBEAR_OPENIPC=y
BR2_PACKAGE_IPCTOOL=y
BR2_PACKAGE_LIBCURL_OPENIPC=y
BR2_PACKAGE_LIBEVENT_OPENIPC=y
BR2_PACKAGE_MAJESTIC_FONTS=y
BR2_PACKAGE_MAJESTIC_WEBUI=y
BR2_PACKAGE_MAJESTIC=y
BR2_PACKAGE_MBEDTLS_OPENIPC=y
BR2_PACKAGE_YAML_CLI=y
```

## br-ext-chip-fullhan/configs/fh8626v100_lite_defconfig
```kconfig
# Architecture
BR2_arm=y
BR2_arm1176jzf_s=y
BR2_ARM_EABI=y

# Toolchain
BR2_TOOLCHAIN_EXTERNAL=y
BR2_TOOLCHAIN_EXTERNAL_DOWNLOAD=y
BR2_TOOLCHAIN_EXTERNAL_URL="https://github.com/openipc/firmware/releases/download/$(OPENIPC_TOOLCHAIN).tgz"
BR2_TOOLCHAIN_EXTERNAL_CUSTOM_PREFIX="arm-openipc-linux-musleabi"
BR2_TOOLCHAIN_EXTERNAL_HEADERS_4_19=y
BR2_TOOLCHAIN_EXTERNAL_CUSTOM_MUSL=y
BR2_TOOLCHAIN_EXTERNAL_CXX=y

# Kernel
BR2_LINUX_KERNEL=y
BR2_LINUX_KERNEL_CUSTOM_TARBALL=y
BR2_LINUX_KERNEL_CUSTOM_TARBALL_LOCATION="https://github.com/openipc/linux/archive/$(OPENIPC_KERNEL).tar.gz"
BR2_LINUX_KERNEL_USE_CUSTOM_CONFIG=y
BR2_LINUX_KERNEL_CUSTOM_CONFIG_FILE="$(EXTERNAL_VENDOR)/board/$(OPENIPC_SOC_FAMILY)/fh8626v100.generic.config"
# The uImage is the zImage with the board's DTB appended
# (CONFIG_BUILD_ARM_APPENDED_DTB_IMAGE_NAMES), built by the kernel itself.
BR2_LINUX_KERNEL_UIMAGE=y
BR2_LINUX_KERNEL_UIMAGE_LOADADDR="0xa0008000"
BR2_LINUX_KERNEL_XZ=y

# Filesystem
# aplay alone: qrscan beeps its onboarding cues through it
BR2_PACKAGE_ALSA_UTILS=y
BR2_PACKAGE_ALSA_UTILS_APLAY=y
# BR2_PACKAGE_ALSA_UTILS_ALSACTL is not set
# BR2_PACKAGE_ALSA_UTILS_ALSAMIXER is not set
BR2_PACKAGE_BUSYBOX_CONFIG="$(BR2_EXTERNAL)/package/busybox/busybox.config"
BR2_PACKAGE_UBOOT_TOOLS=y
BR2_PACKAGE_ZLIB=y
# BR2_PACKAGE_IFUPDOWN_SCRIPTS is not set
BR2_PACKAGE_WIREGUARD_LINUX_COMPAT=y
BR2_PACKAGE_WIREGUARD_TOOLS=y
BR2_PACKAGE_WIRELESS_TOOLS=y
BR2_PACKAGE_WPA_SUPPLICANT=y
BR2_PACKAGE_WPA_SUPPLICANT_CLI=y
BR2_PACKAGE_WPA_SUPPLICANT_PASSPHRASE=y
BR2_TARGET_ROOTFS_CPIO=y
BR2_TARGET_ROOTFS_SQUASHFS=y
BR2_TARGET_ROOTFS_SQUASHFS4_XZ=y

# OpenIPC
BR2_OPENIPC_SOC_VENDOR="fullhan"
BR2_OPENIPC_SOC_MODEL="fh8626v100"
BR2_OPENIPC_SOC_FAMILY="fh8626"
BR2_OPENIPC_VARIANT="lite"
BR2_OPENIPC_FLASH_SIZE="8"

# Packages
# The media drivers are V4L2 and ALSA drivers in the kernel, and divinus
# streams from them; there is no vendor media stack for majestic.
BR2_PACKAGE_DIVINUS=y
BR2_PACKAGE_DROPBEAR_OPENIPC=y
BR2_PACKAGE_FH8626_3AD=y
BR2_PACKAGE_FH8626_ARC_FIRMWARE=y
BR2_PACKAGE_FULLHAN_OSDRV_FH8626=y
BR2_PACKAGE_IPCTOOL=y
BR2_PACKAGE_LIBCURL_OPENIPC=y
BR2_PACKAGE_LIBCURL_OPENIPC_CURL=y
# BR2_PACKAGE_LIBCURL_OPENIPC_PROXY_SUPPORT is not set
# BR2_PACKAGE_LIBCURL_OPENIPC_COOKIES_SUPPORT is not set
# BR2_PACKAGE_LIBCURL_OPENIPC_EXTRA_PROTOCOLS_FEATURES is not set
BR2_PACKAGE_MBEDTLS_OPENIPC=y
BR2_PACKAGE_MOTORS=y
BR2_PACKAGE_OPENIPC_FAILSAFE=y
BR2_PACKAGE_QUIRC_OPENIPC=y
BR2_PACKAGE_RDA5995_OPENIPC=y
BR2_PACKAGE_RDA5995_OPENIPC_RDAWLAN_RDA5995=y
BR2_PACKAGE_VTUND_OPENIPC=y
BR2_PACKAGE_YAML_CLI=y
```

## br-ext-chip-goke/board/gk7205v200/nor-fit.its
```
/dts-v1/;

/*
 * Kernel of the gk7205v200-family NOR image: the zImage and its DTB, each
 * hashed so U-Boot refuses a kernel the flash has corrupted instead of booting
 * it. post-image.sh builds it from the kernel tree and packs firmware.bin: this
 * FIT, then the squashfs at the next 64 KiB boundary. The kernel splits the
 * one "firmware" partition U-Boot passes into kernel, rootfs and rootfs_data
 * (CONFIG_MTD_SPLIT_FIT_FW, CONFIG_MTD_SPLIT_SQUASHFS_ROOT), so neither image
 * has a slot of its own to fit.
 *
 * No fdt load address: U-Boot relocates the DTB under bootm_size, inside the
 * kernel's lowmem.
 */
/ {
	/* "OpenIPC <soc>": sysupgrade's SoC check reads it (fit_soc). */
	description = "OpenIPC @SOC@";
	#address-cells = <1>;

	images {
		kernel {
			description = "Linux";
			data = /incbin/("zImage");
			type = "kernel";
			arch = "arm";
			os = "linux";
			compression = "none";
			load = <0x40008000>;
			entry = <0x40008000>;
			hash-1 { algo = "crc32"; };
			hash-2 { algo = "sha1"; };
		};

		fdt {
			description = "@DTB@";
			data = /incbin/("@DTB@");
			type = "flat_dt";
			arch = "arm";
			compression = "none";
			hash-1 { algo = "crc32"; };
			hash-2 { algo = "sha1"; };
		};
	};

	configurations {
		default = "conf-1";
		conf-1 {
			description = "Linux + @DTB@";
			kernel = "kernel";
			fdt = "fdt";
		};
	};
};
```

## br-ext-chip-goke/board/gk7205v500/nand-fit.its
```
/dts-v1/;

/*
 * Kernel of the gk7205v500-family NAND image: the zImage and its DTB,
 * each hashed so U-Boot refuses a kernel that NAND has corrupted instead of
 * booting it. Built by general/scripts/rootfs_script.sh (the "NAND FIT" step)
 * from the kernel tree; external.mk puts it in the UBIFS rootfs as
 * /boot/fitImage.
 *
 * No fdt load address: u-boot-xmedia relocates the DTB under bootm_size,
 * inside the kernel's lowmem.
 */
/ {
	/* "OpenIPC <soc>": sysupgrade's SoC check reads it (fit_soc). @SOC@ is
	   filled in from OPENIPC_SOC_MODEL when the FIT is built. */
	description = "OpenIPC @SOC@";
	#address-cells = <1>;

	images {
		kernel {
			description = "Linux";
			data = /incbin/("zImage");
			type = "kernel";
			arch = "arm";
			os = "linux";
			compression = "none";
			load = <0x40008000>;
			entry = <0x40008000>;
			hash-1 { algo = "crc32"; };
			hash-2 { algo = "sha1"; };
		};

		fdt {
			description = "xm720xxx-demb";
			data = /incbin/("xm720xxx-demb.dtb");
			type = "flat_dt";
			arch = "arm";
			compression = "none";
			hash-1 { algo = "crc32"; };
			hash-2 { algo = "sha1"; };
		};
	};

	configurations {
		default = "conf-1";
		conf-1 {
			description = "Linux + xm720xxx-demb";
			kernel = "kernel";
			fdt = "fdt";
		};
	};
};
```

## br-ext-chip-hisilicon/board/hi3516ev200/nand-fit.its
```
/dts-v1/;

/*
 * Kernel of the hi3516ev200-family NAND image (hi3516ev200, hi3516ev300,
 * hi3518ev300): the zImage and its DTB, each hashed so U-Boot refuses a kernel
 * that NAND has corrupted instead of booting it. Built by
 * general/scripts/rootfs_script.sh (the "NAND FIT" step) from the kernel
 * tree; external.mk puts it in the UBIFS rootfs as /boot/fitImage.
 *
 * Each model's kernel builds only its own <model>-demb.dtb, so the DTB name is
 * a placeholder filled in per build, like the SoC name.
 *
 * Load and entry are CONFIG_HI_ZRELADDR. No fdt load address: u-boot-xmedia
 * relocates the DTB under bootm_size, inside the kernel's lowmem.
 */
/ {
	/* "OpenIPC <soc>": sysupgrade's SoC check reads it (fit_soc). @SOC@ is
	   filled in from OPENIPC_SOC_MODEL when the FIT is built. */
	description = "OpenIPC @SOC@";
	#address-cells = <1>;

	images {
		kernel {
			description = "Linux";
			data = /incbin/("zImage");
			type = "kernel";
			arch = "arm";
			os = "linux";
			compression = "none";
			load = <0x40008000>;
			entry = <0x40008000>;
			hash-1 { algo = "crc32"; };
			hash-2 { algo = "sha1"; };
		};

		fdt {
			description = "@DTB@";
			data = /incbin/("@DTB@");
			type = "flat_dt";
			arch = "arm";
			compression = "none";
			hash-1 { algo = "crc32"; };
			hash-2 { algo = "sha1"; };
		};
	};

	configurations {
		default = "conf-1";
		conf-1 {
			description = "Linux + @DTB@";
			kernel = "kernel";
			fdt = "fdt";
		};
	};
};
```
