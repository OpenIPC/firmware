## br-ext-chip-axera/board/ax620u/nand-fit.its
```
/dts-v1/;

/*
 * Kernel of the AX620U NAND image: the zImage and its DTB, each hashed so
 * U-Boot refuses a kernel that NAND has corrupted instead of booting it.
 * Built by general/scripts/rootfs_script.sh (the "NAND FIT" step) from the
 * kernel tree; external.mk puts it in the UBIFS rootfs as /boot/fitImage.
 * Load addresses as in the stock AX620U FIT.
 */
/ {
	/* "OpenIPC <soc>": sysupgrade's SoC check reads it (fit_soc). */
	description = "OpenIPC @SOC@";
	#address-cells = <1>;

	images {
		kernel {
			description = "Linux";
			data = /incbin/("zImage");
			type = "kernel";
			arch = "arm";
			os = "linux";
			compression = "none";
			load = <0x40008000>;
			entry = <0x40008000>;
			hash-1 { algo = "crc32"; };
			hash-2 { algo = "sha1"; };
		};

		fdt {
			description = "ax620u";
			data = /incbin/("ax620u.dtb");
			type = "flat_dt";
			arch = "arm";
			compression = "none";
			load = <0x42008000>;
			hash-1 { algo = "crc32"; };
			hash-2 { algo = "sha1"; };
		};
	};

	configurations {
		default = "conf-1";
		conf-1 {
			description = "Linux + ax620u";
			kernel = "kernel";
			fdt = "fdt";
		};
	};
};
```

## br-ext-chip-hisilicon/board/hi3519dv500/nand-fit.its
```
/dts-v1/;

/*
 * Kernel of the hi3519dv500 NAND image: the gzipped arm64 Image and its DTB,
 * each hashed so U-Boot refuses a kernel that NAND has corrupted instead of
 * booting it. Built by general/scripts/rootfs_script.sh (the "NAND FIT" step)
 * from the kernel tree; external.mk puts it in the UBIFS rootfs as
 * /boot/fitImage. U-Boot's bootm starts it through the secure loader and BL31.
 *
 * The DTB is demb-flash: demb with the eMMC controller disabled. Its pins are
 * the SPI flash's (CLK, CMD, D0-D3, RSTn at iocfg 0x34-0x4c), and an enabled
 * mmc0 switches them to eMMC at probe, after which every NAND read returns a
 * bit pattern.
 */
/ {
	/* "OpenIPC <soc>": sysupgrade's SoC check reads it (fit_soc). */
	description = "OpenIPC @SOC@";
	/* The build's BUILD_PLATFORM, as /usr/lib/os-release has it (fit_platform). */
	openipc,platform = "BUILD_PLATFORM=@PLATFORM@";
	#address-cells = <1>;

	images {
		kernel {
			description = "Linux";
			data = /incbin/("Image.gz");
			type = "kernel";
			arch = "arm64";
			os = "linux";
			compression = "gzip";
			load = <0x40080000>;
			entry = <0x40080000>;
			hash-1 { algo = "crc32"; };
			hash-2 { algo = "sha1"; };
		};

		fdt {
			description = "hi3519dv500-demb-flash";
			data = /incbin/("vendor/hi3519dv500-demb-flash.dtb");
			type = "flat_dt";
			arch = "arm64";
			compression = "none";
			hash-1 { algo = "crc32"; };
			hash-2 { algo = "sha1"; };
		};
	};

	configurations {
		default = "conf-1";
		conf-1 {
			description = "Linux + hi3519dv500-demb-flash";
			kernel = "kernel";
			fdt = "fdt";
		};
	};
};
```

## br-ext-chip-ingenic/configs/t23_v4l2_lite_defconfig
```kconfig
# Architecture
BR2_mipsel=y
BR2_mips_xburst=y
# BR2_MIPS_SOFT_FLOAT is not set
BR2_MIPS_FP32_MODE_32=y

# Toolchain
BR2_TOOLCHAIN_EXTERNAL=y
BR2_TOOLCHAIN_EXTERNAL_CUSTOM=y
BR2_TOOLCHAIN_EXTERNAL_DOWNLOAD=y
BR2_TOOLCHAIN_EXTERNAL_URL="https://github.com/openipc/firmware/releases/download/toolchain/toolchain.ingenic-t31.tgz"
BR2_TOOLCHAIN_EXTERNAL_CUSTOM_PREFIX="mipsel-openipc-linux-musl"
BR2_TOOLCHAIN_EXTERNAL_HEADERS_3_10=y
BR2_TOOLCHAIN_EXTERNAL_CUSTOM_MUSL=y
BR2_TOOLCHAIN_EXTERNAL_CXX=y

# Kernel
BR2_LINUX_KERNEL=y
BR2_LINUX_KERNEL_CUSTOM_TARBALL=y
BR2_LINUX_KERNEL_CUSTOM_TARBALL_LOCATION="https://github.com/openipc/linux/archive/ingenic-t23-6.12.tar.gz"
BR2_LINUX_KERNEL_USE_CUSTOM_CONFIG=y
BR2_LINUX_KERNEL_CUSTOM_CONFIG_FILE="$(EXTERNAL_VENDOR)/board/$(OPENIPC_SOC_FAMILY)/t23.v4l2_lite.config"
BR2_LINUX_KERNEL_VMLINUX_BIN=y
BR2_LINUX_KERNEL_DTS_SUPPORT=y
BR2_LINUX_KERNEL_INTREE_DTS_NAME="ingenic/t23-openipc"

# Skip legacy 3.x/4.9 kernel patches (not needed for 6.12)
BR2_GLOBAL_PATCH_DIR="$(BR2_EXTERNAL)/package/all-patches-neo"

# Filesystem
BR2_PACKAGE_ALSA_UTILS=y
BR2_PACKAGE_ALSA_UTILS_APLAY=y
# BR2_PACKAGE_ALSA_UTILS_ALSACTL is not set
# BR2_PACKAGE_ALSA_UTILS_ALSAMIXER is not set
BR2_PACKAGE_BUSYBOX_CONFIG="$(BR2_EXTERNAL)/package/busybox/busybox.config"
BR2_PACKAGE_UBOOT_TOOLS=y
BR2_PACKAGE_ZLIB=y
# BR2_PACKAGE_IFUPDOWN_SCRIPTS is not set
# WireGuard is in-tree in Linux 6.12 (CONFIG_WIREGUARD=m); wireguard-tools-openipc builds against 3.10 headers.
# BR2_PACKAGE_WIREGUARD_LINUX_COMPAT is not set
BR2_PACKAGE_WIREGUARD_TOOLS_OPENIPC=y
BR2_PACKAGE_WIRELESS_TOOLS=y
BR2_PACKAGE_WPA_SUPPLICANT=y
BR2_PACKAGE_WPA_SUPPLICANT_CLI=y
BR2_PACKAGE_WPA_SUPPLICANT_PASSPHRASE=y
BR2_TARGET_ROOTFS_CPIO=y
BR2_TARGET_ROOTFS_SQUASHFS=y
BR2_TARGET_ROOTFS_SQUASHFS4_XZ=y

# OpenIPC
BR2_OPENIPC_SOC_VENDOR="ingenic"
BR2_OPENIPC_SOC_MODEL="t23"
BR2_OPENIPC_SOC_FAMILY="t23"
BR2_OPENIPC_VARIANT="v4l2_lite"
BR2_OPENIPC_FLASH_SIZE="8"

# Packages
BR2_PACKAGE_DIVINUS=y
BR2_PACKAGE_DROPBEAR_OPENIPC=y
BR2_PACKAGE_INGENIC_OSDRV_T23_V4L2=y
BR2_PACKAGE_IPCTOOL=y
BR2_PACKAGE_LIBCURL_OPENIPC=y
BR2_PACKAGE_LIBCURL_OPENIPC_CURL=y
# BR2_PACKAGE_LIBCURL_OPENIPC_PROXY_SUPPORT is not set
# BR2_PACKAGE_LIBCURL_OPENIPC_COOKIES_SUPPORT is not set
# BR2_PACKAGE_LIBCURL_OPENIPC_EXTRA_PROTOCOLS_FEATURES is not set
BR2_PACKAGE_MBEDTLS_OPENIPC=y
BR2_PACKAGE_MOTORS=y
BR2_PACKAGE_OPENIPC_FAILSAFE=y
BR2_PACKAGE_QUIRC_OPENIPC=y
BR2_PACKAGE_T23_IPA=y
BR2_PACKAGE_VTUND_OPENIPC=y
BR2_PACKAGE_YAML_CLI=y
BR2_ROOTFS_POST_IMAGE_SCRIPT="$(EXTERNAL_VENDOR)/board/$(OPENIPC_SOC_FAMILY)/v4l2-post-image.sh $(BR2_EXTERNAL_GENERAL_PATH)/scripts/post-image-split.sh"
```

## br-ext-chip-novatek/configs/nt98566_ultimate_defconfig
```kconfig
# Architecture
BR2_arm=y
BR2_cortex_a9=y
BR2_ARM_ENABLE_NEON=y
BR2_ARM_ENABLE_VFP=y
BR2_ARM_FPU_VFPV3=y
BR2_ARM_INSTRUCTIONS_THUMB2=y

# Toolchain
BR2_TOOLCHAIN_EXTERNAL=y
BR2_TOOLCHAIN_EXTERNAL_CUSTOM=y
BR2_TOOLCHAIN_EXTERNAL_DOWNLOAD=y
BR2_TOOLCHAIN_EXTERNAL_URL="https://github.com/openipc/firmware/releases/download/$(OPENIPC_TOOLCHAIN).tgz"
BR2_TOOLCHAIN_EXTERNAL_CUSTOM_PREFIX="arm-openipc-linux-musleabihf"
BR2_TOOLCHAIN_EXTERNAL_HEADERS_4_19=y
BR2_TOOLCHAIN_EXTERNAL_CUSTOM_MUSL=y
BR2_TOOLCHAIN_EXTERNAL_CXX=y

# Kernel
BR2_LINUX_KERNEL=y
BR2_LINUX_KERNEL_CUSTOM_TARBALL=y
BR2_LINUX_KERNEL_CUSTOM_TARBALL_LOCATION="https://github.com/openipc/linux/archive/$(OPENIPC_KERNEL).tar.gz"
BR2_LINUX_KERNEL_USE_CUSTOM_CONFIG=y
BR2_LINUX_KERNEL_CUSTOM_CONFIG_FILE="$(EXTERNAL_VENDOR)/board/$(OPENIPC_SOC_FAMILY)/nt98566.nand.config"
BR2_LINUX_KERNEL_UIMAGE=y
BR2_LINUX_KERNEL_XZ=y

# Filesystem
BR2_PACKAGE_BUSYBOX_CONFIG="$(BR2_EXTERNAL)/package/busybox/busybox.config"
BR2_PACKAGE_DOSFSTOOLS=y
BR2_PACKAGE_DOSFSTOOLS_FSCK_FAT=y
BR2_PACKAGE_EXFATPROGS=y
BR2_PACKAGE_MTD=y
BR2_PACKAGE_MTD_UBIUTILS=y
BR2_PACKAGE_UBOOT_TOOLS=y
BR2_PACKAGE_ZLIB=y
# BR2_PACKAGE_IFUPDOWN_SCRIPTS is not set
BR2_PACKAGE_WIREGUARD_LINUX_COMPAT=y
BR2_PACKAGE_WIREGUARD_TOOLS=y
BR2_TARGET_ROOTFS_CPIO=y
# 128 MiB SPI NAND, OpenIPC's NAND layout: one UBI partition, volumes rootfs
# (UBIFS, /boot/uImage inside) and rootfs_data (overlay). 128 KiB PEB, 2 KiB page.
BR2_TARGET_ROOTFS_UBI=y
BR2_TARGET_ROOTFS_UBI_SUBSIZE=2048
BR2_TARGET_ROOTFS_UBI_USE_CUSTOM_CONFIG=y
BR2_TARGET_ROOTFS_UBI_CUSTOM_CONFIG_FILE="$(EXTERNAL_VENDOR)/board/$(OPENIPC_SOC_FAMILY)/ubinize-nand.cfg"
BR2_TARGET_ROOTFS_UBIFS_LEBSIZE=0x1f000

# OpenIPC
BR2_OPENIPC_SOC_VENDOR="novatek"
BR2_OPENIPC_SOC_MODEL="nt98566"
BR2_OPENIPC_SOC_FAMILY="nt9856x"
BR2_OPENIPC_VARIANT="ultimate"
BR2_OPENIPC_FLASH_SIZE="128"

# Packages
BR2_PACKAGE_DROPBEAR_OPENIPC=y
BR2_PACKAGE_EXFAT_OPENIPC=y
BR2_PACKAGE_IPCTOOL=y
BR2_PACKAGE_LAME_OPENIPC=y
BR2_PACKAGE_LIBCURL_OPENIPC=y
BR2_PACKAGE_LIBCURL_OPENIPC_CURL=y
# BR2_PACKAGE_LIBCURL_OPENIPC_PROXY_SUPPORT is not set
# BR2_PACKAGE_LIBCURL_OPENIPC_COOKIES_SUPPORT is not set
# BR2_PACKAGE_LIBCURL_OPENIPC_EXTRA_PROTOCOLS_FEATURES is not set
BR2_PACKAGE_LIBEVENT_OPENIPC=y
BR2_PACKAGE_LIBOGG_OPENIPC=y
BR2_PACKAGE_MAJESTIC_FONTS=y
BR2_PACKAGE_MAJESTIC_WEBUI=y
BR2_PACKAGE_MAJESTIC=y
BR2_PACKAGE_MBEDTLS_OPENIPC=y
BR2_PACKAGE_MOTORS=y
BR2_PACKAGE_NOVATEK_OSDRV_NT9856X=y
BR2_PACKAGE_NOVATEK_OPENSDK=y
BR2_PACKAGE_OPUS_OPENIPC=y
BR2_PACKAGE_OPUS_OPENIPC_FIXED_POINT=y
BR2_PACKAGE_VTUND_OPENIPC=y
BR2_PACKAGE_YAML_CLI=y
BR2_PACKAGE_ZEROTIER_ONE=y
```

## br-ext-chip-rockchip/board/rv1106/nand-fit.its
```
/dts-v1/;

/* The NAND kernel: see general/scripts/rootfs_script.sh, the "NAND FIT" step. */
/ {
	/* "OpenIPC <soc>": sysupgrade's SoC check reads it (fit_soc). */
	description = "OpenIPC @SOC@";
	#address-cells = <1>;

	images {
		kernel {
			description = "Linux";
			data = /incbin/("zImage");
			type = "kernel";
			arch = "arm";
			os = "linux";
			compression = "none";
			load = <0x00208000>;
			entry = <0x00208000>;
			hash-1 { algo = "crc32"; };
			hash-2 { algo = "sha1"; };
		};

		fdt {
			description = "nand";
			data = /incbin/("@SOC@-nand.dtb");
			type = "flat_dt";
			arch = "arm";
			compression = "none";
			hash-1 { algo = "crc32"; };
			hash-2 { algo = "sha1"; };
		};
	};

	configurations {
		default = "conf-1";
		conf-1 {
			description = "Linux + nand";
			kernel = "kernel";
			fdt = "fdt";
		};
	};
};
```

## br-ext-chip-rockchip/configs/rv1103_lite_defconfig
```kconfig
# Architecture
BR2_arm=y
BR2_cortex_a7=y
BR2_ARM_FPU_NEON_VFPV4=y

# Toolchain
BR2_TOOLCHAIN_EXTERNAL=y
BR2_TOOLCHAIN_EXTERNAL_CUSTOM=y
BR2_TOOLCHAIN_EXTERNAL_DOWNLOAD=y
BR2_TOOLCHAIN_EXTERNAL_URL="https://github.com/openipc/firmware/releases/download/$(OPENIPC_TOOLCHAIN).tgz"
BR2_TOOLCHAIN_EXTERNAL_CUSTOM_PREFIX="arm-openipc-linux-gnueabihf"
BR2_TOOLCHAIN_EXTERNAL_HEADERS_5_10=y
BR2_TOOLCHAIN_EXTERNAL_CUSTOM_GLIBC=y
# BR2_TOOLCHAIN_EXTERNAL_INET_RPC is not set
BR2_TOOLCHAIN_EXTERNAL_CXX=y
BR2_TOOLCHAIN_EXTERNAL_OPENMP=y

# Kernel
BR2_LINUX_KERNEL=y
BR2_LINUX_KERNEL_CUSTOM_TARBALL=y
BR2_LINUX_KERNEL_CUSTOM_TARBALL_LOCATION="https://github.com/openipc/linux/archive/$(OPENIPC_KERNEL).tar.gz"
BR2_LINUX_KERNEL_USE_CUSTOM_CONFIG=y
BR2_LINUX_KERNEL_CUSTOM_CONFIG_FILE="$(EXTERNAL_VENDOR)/board/$(OPENIPC_SOC_FAMILY)/rv1106.generic.config"
# NOR: zImage + rv1103-nor.dtb as the uImage in firmware.bin. NAND: zImage +
# rv1103-nand.dtb as /boot/fitImage inside the UBIFS rootfs.
BR2_LINUX_KERNEL_ZIMAGE=y
BR2_LINUX_KERNEL_XZ=y
BR2_LINUX_KERNEL_UIMAGE_LOADADDR="0x00208000"
BR2_LINUX_KERNEL_DTS_SUPPORT=y
BR2_LINUX_KERNEL_CUSTOM_DTS_PATH="$(EXTERNAL_VENDOR)/board/$(OPENIPC_SOC_FAMILY)/dts/rv1103-nor.dts $(EXTERNAL_VENDOR)/board/$(OPENIPC_SOC_FAMILY)/dts/rv1103-nand.dts"
BR2_ROOTFS_POST_IMAGE_SCRIPT="$(BR2_EXTERNAL_GENERAL_PATH)/scripts/post-image-split.sh"

# Filesystem
BR2_PACKAGE_BUSYBOX_CONFIG="$(BR2_EXTERNAL)/package/busybox/busybox.config"
BR2_PACKAGE_MTD=y
BR2_PACKAGE_UBOOT_TOOLS=y
BR2_PACKAGE_ZLIB=y
# BR2_PACKAGE_IFUPDOWN_SCRIPTS is not set
BR2_PACKAGE_WIREGUARD_LINUX_COMPAT=y
BR2_PACKAGE_WIREGUARD_TOOLS=y
BR2_TARGET_ROOTFS_CPIO=y
BR2_TARGET_ROOTFS_SQUASHFS=y
BR2_TARGET_ROOTFS_SQUASHFS4_XZ=y
BR2_TARGET_ROOTFS_UBI=y
BR2_TARGET_ROOTFS_UBI_SUBSIZE=2048
BR2_TARGET_ROOTFS_UBI_USE_CUSTOM_CONFIG=y
BR2_TARGET_ROOTFS_UBI_CUSTOM_CONFIG_FILE="$(EXTERNAL_VENDOR)/board/$(OPENIPC_SOC_FAMILY)/ubinize-nand.cfg"
BR2_TARGET_ROOTFS_UBIFS_LEBSIZE=0x1f000

# OpenIPC
BR2_OPENIPC_SOC_VENDOR="rockchip"
BR2_OPENIPC_SOC_MODEL="rv1103"
BR2_OPENIPC_SOC_FAMILY="rv1106"
BR2_OPENIPC_VARIANT="lite"
BR2_OPENIPC_FLASH_SIZE="16"
BR2_OPENIPC_NOR_KERNEL_READ_SIZE=0x300000

# Packages
BR2_PACKAGE_ROCKCHIP_OSDRV_RV11XX=y
BR2_PACKAGE_DROPBEAR_OPENIPC=y
BR2_PACKAGE_IPCTOOL=y
BR2_PACKAGE_LIBCURL_OPENIPC=y
BR2_PACKAGE_LIBCURL_OPENIPC_CURL=y
# BR2_PACKAGE_LIBCURL_OPENIPC_PROXY_SUPPORT is not set
# BR2_PACKAGE_LIBCURL_OPENIPC_COOKIES_SUPPORT is not set
# BR2_PACKAGE_LIBCURL_OPENIPC_EXTRA_PROTOCOLS_FEATURES is not set
BR2_PACKAGE_LIBEVENT_OPENIPC=y
BR2_PACKAGE_LIBOGG_OPENIPC=y
BR2_PACKAGE_MAJESTIC_FONTS=y
BR2_PACKAGE_MAJESTIC_WEBUI=y
BR2_PACKAGE_MAJESTIC=y
BR2_PACKAGE_MBEDTLS_OPENIPC=y
BR2_PACKAGE_OPUS_OPENIPC=y
BR2_PACKAGE_OPUS_OPENIPC_FIXED_POINT=y
BR2_PACKAGE_VTUND_OPENIPC=y
BR2_PACKAGE_YAML_CLI=y
```

## br-ext-chip-sigmastar/configs/ssr621q_lite_defconfig
```kconfig
# Architecture
BR2_arm=y
BR2_cortex_a7=y
BR2_ARM_FPU_NEON_VFPV4=y
BR2_ARM_INSTRUCTIONS_THUMB2=y

# Toolchain
# infinity6e's: the same Cortex-A7, glibc and 4.9 headers
BR2_TOOLCHAIN_EXTERNAL=y
BR2_TOOLCHAIN_EXTERNAL_CUSTOM=y
BR2_TOOLCHAIN_EXTERNAL_DOWNLOAD=y
BR2_TOOLCHAIN_EXTERNAL_URL="https://github.com/openipc/firmware/releases/download/toolchain/toolchain.sigmastar-infinity6e.tgz"
BR2_TOOLCHAIN_EXTERNAL_CUSTOM_PREFIX="arm-openipc-linux-gnueabihf"
BR2_TOOLCHAIN_EXTERNAL_HEADERS_4_9=y
BR2_TOOLCHAIN_EXTERNAL_CUSTOM_GLIBC=y
# BR2_TOOLCHAIN_EXTERNAL_INET_RPC is not set
BR2_TOOLCHAIN_EXTERNAL_CXX=y

# Kernel
BR2_LINUX_KERNEL=y
BR2_LINUX_KERNEL_CUSTOM_TARBALL=y
BR2_LINUX_KERNEL_CUSTOM_TARBALL_LOCATION="https://github.com/openipc/linux/archive/$(OPENIPC_KERNEL).tar.gz"
BR2_LINUX_KERNEL_USE_CUSTOM_CONFIG=y
BR2_LINUX_KERNEL_CUSTOM_CONFIG_FILE="$(EXTERNAL_VENDOR)/board/$(OPENIPC_SOC_FAMILY)/infinity2m-ssc010a.config"
BR2_LINUX_KERNEL_UIMAGE=y
BR2_LINUX_KERNEL_XZ=y
BR2_LINUX_KERNEL_UIMAGE_LOADADDR="0x20008000"

# Filesystem
BR2_PACKAGE_BUSYBOX_CONFIG="$(BR2_EXTERNAL)/package/busybox/busybox.config"
BR2_PACKAGE_E2FSPROGS=y
# BR2_PACKAGE_E2FSPROGS_FSCK is not set
BR2_PACKAGE_EXFATPROGS=y
BR2_PACKAGE_UBOOT_TOOLS=y
BR2_PACKAGE_ZLIB=y
# BR2_PACKAGE_IFUPDOWN_SCRIPTS is not set
BR2_TARGET_ROOTFS_CPIO=y
BR2_TARGET_ROOTFS_SQUASHFS=y
BR2_TARGET_ROOTFS_SQUASHFS4_XZ=y

# OpenIPC
BR2_OPENIPC_SOC_VENDOR="sigmastar"
BR2_OPENIPC_SOC_MODEL="ssr621q"
BR2_OPENIPC_SOC_FAMILY="infinity2m"
BR2_OPENIPC_VARIANT="lite"
BR2_OPENIPC_FLASH_SIZE="16"

# Packages
BR2_PACKAGE_DROPBEAR_OPENIPC=y
BR2_PACKAGE_EXFAT_OPENIPC=y
BR2_PACKAGE_IPCTOOL=y
BR2_PACKAGE_LIBCURL_OPENIPC=y
BR2_PACKAGE_LIBCURL_OPENIPC_CURL=y
# BR2_PACKAGE_LIBCURL_OPENIPC_PROXY_SUPPORT is not set
# BR2_PACKAGE_LIBCURL_OPENIPC_COOKIES_SUPPORT is not set
# BR2_PACKAGE_LIBCURL_OPENIPC_EXTRA_PROTOCOLS_FEATURES is not set
BR2_PACKAGE_LIBEVENT_OPENIPC=y
BR2_PACKAGE_MBEDTLS_OPENIPC=y
BR2_PACKAGE_SIGMASTAR_OPENSDK=y
BR2_PACKAGE_SIGMASTAR_OSDRV_INFINITY2M=y
BR2_PACKAGE_VTUND_OPENIPC=y
BR2_PACKAGE_YAML_CLI=y
BR2_ROOTFS_POST_IMAGE_SCRIPT="$(BR2_EXTERNAL_GENERAL_PATH)/scripts/post-image-split.sh"
BR2_PACKAGE_VIGIL=y
```

## general/package/axera-osdrv-ax620e/Config.in
```kconfig
config BR2_PACKAGE_AXERA_OSDRV_AX620E
	bool "axera-osdrv-ax620e"
	help
	  Axera AX620E (AX630C/AX620E, Cortex-A53) kernel modules. VIN/CSI2
	  capture, the VC8000E encoder and Hantro decoder, and EIP-130
	  crypto build from source as part of the axera-ax620e kernel
	  branch; the ISP 3A (ax_proton.ko), NPU (ax_npu.ko) and the rest of
	  the vendor codec stack are closed binaries shipped in this
	  package at kernel 5.15.73's vermagic. See this package's README
	  for provenance.

config BR2_PACKAGE_AXERA_OSDRV_AX620E_AI_ISP
	bool "AI-ISP model"
	depends on BR2_PACKAGE_AXERA_OSDRV_AX620E
	help
	  Install the stock firmware's AI-ISP (NPU denoise) model for the
	  SC450AI, 4.4 MB (about 1.3 MB in the xz squashfs), under
	  /etc/sensors/ai_isp with /mnt/custom/ai_isp linked to it. Off by
	  default: it would leave the 16 MB NOR lite image's 5 MB rootfs
	  slot too little room for a streamer. The tuning bins work
	  without it, with AI-ISP off.
```

## general/package/divinus/Config.in
```kconfig
config BR2_PACKAGE_DIVINUS
	bool "Divinus streamer"
	select BR2_PACKAGE_ALSA_LIB if BR2_PACKAGE_FULLHAN_OSDRV_FH8626 || BR2_PACKAGE_INGENIC_OSDRV_T23_V4L2
	help
	  Multi-platform open source streamer
	  https://github.com/openipc/divinus
```

## general/package/fullhan-opensdk/Config.in
```kconfig
config BR2_PACKAGE_FULLHAN_OPENSDK
	bool "fullhan-opensdk"
	default n
	depends on BR2_PACKAGE_FULLHAN_OSDRV_FH8852V100
	help
	  Fullhan sensor libraries built from source, for sensors the
	  vendor SDK ships no library for (GalaxyCore GC4653 on the
	  FH885x V100).

	  https://github.com/OpenIPC/openfullhan
```
