## general/package/grainmedia-osdrv-gm8126/Config.in
```kconfig
config BR2_PACKAGE_GRAINMEDIA_OSDRV_GM8126
	bool "grainmedia-osdrv-gm8126"
	help
	  grainmedia-osdrv-gm8126 - loads the GM8126's mainline media drivers

	  https://openipc.org
```

## general/package/ingenic-osdrv-t23-v4l2/Config.in
```kconfig
config BR2_PACKAGE_INGENIC_OSDRV_T23_V4L2
	bool "ingenic-osdrv-t23-v4l2"
	depends on BR2_LINUX_KERNEL
	help
	  Load the Ingenic T23 Linux 6.12 device-tree kernel modules
	  and adjust the U-Boot osmem environment for the mainline
	  V4L2 and Media Controller stack.

	  https://openipc.org
```

## general/package/ingenic-osdrv-t41/Config.in
```kconfig
config BR2_PACKAGE_INGENIC_OSDRV_T41
	bool "ingenic-osdrv-t41"
	select BR2_PACKAGE_INGENIC_OPENSDK
	help
	  ingenic-osdrv-t41 - Ingenic kernel modules and libs

	  https://openipc.org
```

## general/package/novatek-opensdk/Config.in
```kconfig
config BR2_PACKAGE_NOVATEK_OPENSDK
	bool "novatek-opensdk"
	default n
	depends on BR2_LINUX_KERNEL
	help
	  Opensource Novatek SoCs SDK: sensor drivers (nvt_sen_*.ko) built
	  from source against the firmware kernel.

	  https://github.com/OpenIPC/opennovatek

comment "NOVATEK_OPENSDK needs a Linux kernel to be built"
	depends on !BR2_LINUX_KERNEL
```

## general/package/novatek-osdrv-nt9856x/Config.in
```kconfig
config BR2_PACKAGE_NOVATEK_OSDRV_NT9856X
	bool "novatek-osdrv-nt9856x"
	depends on BR2_LINUX_KERNEL
	select BR2_PACKAGE_NOVATEK_OPENSDK
	help
	  novatek-osdrv-nt9856x - Novatek kernel modules and libs. The
	  sensor drivers come from novatek-opensdk, which this selects.

	  https://openipc.org
```

## general/package/sgsnpu-models/Config.in
```kconfig
config BR2_PACKAGE_SGSNPU_MODELS
	bool "sgsnpu-models"
	default n
	help
	  YOLOv8n object detector compiled for the NPU ("IPU") of SigmaStar's
	  infinity6c (SSC377x/SSC378x), for majestic's object detection. Eight
	  classes: person, bicycle, car, motorcycle, bus, truck, cat and dog
	  (majestic reports them as human, vehicle and animal), and the
	  licence-plate models majestic reads plates with (lpr.enabled):
	  three IPU networks and their decoder. 2.6 MB in a squashfs for the
	  detector, 2.9 MB for the plates. AGPL-3.0.

	  https://github.com/OpenIPC/sgsnpu-models
```

## general/package/sigmastar-opensdk/Config.in
```kconfig
config BR2_PACKAGE_SIGMASTAR_OPENSDK
	bool "sigmastar-opensdk"
	depends on BR2_LINUX_KERNEL
	depends on BR2_OPENIPC_SOC_FAMILY = "infinity2m"
	help
	  SigmaStar kernel modules for this kernel, from OpenIPC's
	  opensigmastar. On infinity2m, the whole media stack:
	  - open_mhal.ko, open_mi_*.ko and open_fbdev.ko: the i2m NVR SDK's
	    modules relinked (SigmaStar's code; open_mhal's display, panel
	    and region parts built from SigmaStar's source);
	  - open_hdmitx.ko (HDMI transmitter, from SigmaStar's source) and
	    open_hdmi.ko, which switches the output on from
	    /sys/kernel/open_hdmi.
	  Also provides the MI headers applications build against.

	  https://github.com/OpenIPC/opensigmastar

comment "SIGMASTAR_OPENSDK needs a Linux kernel to be built"
	depends on !BR2_LINUX_KERNEL
```

## general/package/sigmastar-osdrv-infinity2m/Config.in
```kconfig
config BR2_PACKAGE_SIGMASTAR_OSDRV_INFINITY2M
	bool "sigmastar-osdrv-infinity2m"
	depends on BR2_OPENIPC_SOC_FAMILY = "infinity2m"
	depends on BR2_LINUX_KERNEL
	select BR2_PACKAGE_SIGMASTAR_OPENSDK
	help
	  Sigmastar infinity2m (SSR621Q NVR) media stack from the i2m NVR
	  SDK: the MI libraries for decoding to HDMI and VGA and the decoder
	  firmware; config_tool, which mi_sys runs to load the memory map,
	  panel timings and PQ defaults (OpenIPC's, built from source);
	  the framebuffer's fbdev.ini; load_sigmastar; and the OpenIPC boot
	  logo JPEG. The modules (MHAL, MI, framebuffer, HDMI transmitter)
	  come from sigmastar-opensdk, built for this kernel.
```

## general/package/t23-ipa/Config.in
```kconfig
config BR2_PACKAGE_T23_IPA
	bool "t23-ipa"
	depends on BR2_LINUX_KERNEL
	help
	  Automatic exposure, white balance, colour correction, noise
	  reduction and day/night IR-cut control for the Ingenic T23 ISP.
	  The daemon reads hardware statistics and queues ISP parameters via
	  V4L2 metadata nodes and drives sensor exposure, gain and vblank
	  controls via the Media Controller topology, alongside whichever
	  application streams from the capture device.
```

## general/package/vigil/Config.in
```kconfig
config BR2_PACKAGE_VIGIL
	bool "vigil"
	# The platform's media stack, which the board's defconfig enables: a
	# vigil platform per osdrv package.
	depends on BR2_PACKAGE_HISILICON_OSDRV_HI3536DV100 || \
		BR2_PACKAGE_SIGMASTAR_OSDRV_INFINITY2M
	depends on BR2_LINUX_KERNEL
	depends on !BR2_PACKAGE_MAJESTIC
	depends on !BR2_PACKAGE_VDEC_OPENIPC
	select BR2_PACKAGE_LIBYAML
	select BR2_PACKAGE_MBEDTLS_OPENIPC
	help
	  vigil - DVR/NVR application: network cameras (RTSP, NETIP,
	  ONVIF) decoded to HDMI/VGA with an on-screen UI (mouse and
	  keyboard), and recorded without re-encoding.

	  Installs /usr/bin/vigild, /etc/init.d/S95vigil (started at
	  boot and restarted after a crash, as majestic is) and
	  /etc/vigil.yaml, a YAML file like majestic's, which vigild
	  keeps itself: it rewrites it when settings change, with each
	  setting explained in a comment (comments written by hand are
	  not kept).

	  It listens, by default on every interface:
	    8080   HTTP/WebSocket API
	    80     zero channel: the screen, mouse and keyboard in a
	           browser (web.enabled)
	    554    RTSP: the cameras' streams (rtsp_server)
	    8899   ONVIF, and WS-Discovery on UDP 3702 (onvif_server)
	    34567  NETIP for XM's CMS/XMEye, and its search on UDP
	           34569 (netip_server)
	  Each logs in vigil's users (and root) and can be turned off or
	  moved in Network > Ports or vigil.yaml. None is encrypted: the
	  API's and the zero channel's passwords cross the network in
	  clear, as with a camera's web UI, so use them on a trusted
	  network or through an SSH tunnel. root cannot log in to any of
	  them while it has no password (an unclaimed image). The
	  passwords vigild keeps are sealed under /etc/vigil.key
	  (AES-256-GCM).

	  An /etc/vigil.json from an earlier image is converted into
	  vigil.yaml once, and kept as vigil.json.migrated. vigild records
	  only onto a mounted disk, card or share, never onto the flash or
	  into RAM, and starts recording by itself once the disk is there.

	  https://github.com/OpenIPC/vigil
```
