// SPDX-License-Identifier: (GPL-2.0+ OR MIT)
/* The same board with SPI NOR in place of the SPI NAND. */
#include "rv1103g-luckfox-pico-plus.dts"

&sfc {
	flash@0 {
		compatible = "jedec,spi-nor";
	};
};
